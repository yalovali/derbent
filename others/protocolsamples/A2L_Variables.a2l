/* ASAP2 file: utku_v2.a2l */
/* Author : Sebnem Saliha Cakiroglu */ ASAP2_VERSION 1 6
/begin PROJECT ECEMTAG_CR8 ""
/begin MODULE DIM ""
/begin IF_DATA VISION /*
* Size cal par_start to checksum(not included)
* Application area : 0x80000-0x1A0000 (0x180000-0x1A0000 is default cal area)
* CAL_SEG area : 0x1C0000-0x1E0000
*/
 /begin MEMORY_REGION CAL_SEG 0x001A0000 0x9580 0x6 0 /end MEMORY_REGION
 /begin MEMORY_REGION APPL_FLASH 0x00080000 0x120000 0x1 0 /end MEMORY_REGION
 /begin MEMORY_REGION CAL_FLASH 0x001A0000 0x20000 0x1 0 /end MEMORY_REGION
 /* PROTOCOL_HEADER_START */ /*XCP_Header_Start*/ DEVICE_SETTING "XcpEcuOverrideFlags=0x10" DEVICE_SETTING "XcpNumSegments=3" DEVICE_SETTING "SkipPingAfterSync=TRUE" DEVICE_SETTING "XcpDaqPollingMode=0" DEVICE_SETTING "XcpCanIfDaqPollingMode=0" DEVICE_SETTING "EcuByteOrder=1" DEVICE_SETTING "XcpSegment1Page1=0,3,3,3,0" DEVICE_SETTING "XcpCanIfProtocolVersion=0x0100" DEVICE_SETTING "XcpSegment1Config=Code01,0,1,0,0" DEVICE_SETTING "XcpSegment2NumPages=1" DEVICE_SETTING "XcpSegment2Config=Code02,0,1,0,0" DEVICE_SETTING "XcpCanIfProtocolOptionalCmds=12,0xf8,0xf7,0xf6,0xf5,0xf3,0xda,0xd9,0xd8,0xd7,0xd0,0xd1,0xd2" DEVICE_SETTING "XcpCanIfConfig=1000000,75,1,9,1,1" DEVICE_SETTING "XcpSegment3Page1=0,3,3,3,0" DEVICE_SETTING "GroupSeparator=#" DEVICE_SETTING "XcpCanIfDaqConfig=0,10,10,0,0,0,0,1,10,2" DEVICE_SETTING "XcpDaqConfig=0,10,10,0,0,0,0,1,10,2" DEVICE_SETTING "XcpDaqConfigOptionsNumEvents=10" DEVICE_SETTING "XcpCanIfDaqConfigOptionsTimestamp=1,2,7,0" DEVICE_SETTING "XcpCanIfProtocolTiming=2000,3000,800,800,3000,800,3000" DEVICE_SETTING "XcpSegment3NumPages=1" DEVICE_SETTING "XcpCanIfDaqConfigOptionsNumEvents=10" DEVICE_SETTING "XcpProtocolConfig=8,8,0,1" DEVICE_SETTING "XcpStoreSuppport=1" DEVICE_SETTING "XcpProtocolVersion=0x0100" DEVICE_SETTING "XcpProtocolTiming=2000,3000,800,800,3000,800,3000" DEVICE_SETTING "XcpProtocolSeedAndKey=SeedDLL.dll" DEVICE_SETTING "SyncDownloadRegionsOnly=TRUE" DEVICE_SETTING "XcpSegment2Page1=0,3,3,3,0" DEVICE_SETTING "XcpPagConfig=1,0" DEVICE_SETTING "XcpCanIfProtocolConfig=8,8,0,1" DEVICE_SETTING "XcpCanIfDaqConfigOptions=1,1,0" DEVICE_SETTING "XcpCanIfDaqConfigOptionsDaqList1=0,1,10,0,0,0,0" DEVICE_SETTING "XcpCanIfDaqConfigOptionsDaqList2=1,1,10,0,10,0,0" DEVICE_SETTING "XcpCanIfDaqConfigOptionsDaqList3=2,1,10,0,20,0,0" DEVICE_SETTING "XcpCanIfDaqConfigOptionsDaqList4=3,1,10,0,30,0,0" DEVICE_SETTING "XcpCanIfDaqConfigOptionsDaqList5=4,1,10,0,40,0,0" DEVICE_SETTING "XcpCanIfDaqConfigOptionsDaqList6=5,1,10,0,50,0,0" DEVICE_SETTING "XcpCanIfDaqConfigOptionsDaqList7=6,1,10,0,60,0,0" DEVICE_SETTING "XcpCanIfDaqConfigOptionsDaqList8=7,1,10,0,70,0,0" DEVICE_SETTING "XcpCanIfDaqConfigOptionsDaqList9=8,1,10,0,80,0,0" DEVICE_SETTING "XcpCanIfDaqConfigOptionsDaqList10=9,1,10,0,90,0,0" DEVICE_SETTING "XcpDaqConfigOptionsDaqList1=0,1,10,0,0,0,0" DEVICE_SETTING "XcpDaqConfigOptionsDaqList2=1,1,10,0,10,0,0" DEVICE_SETTING "XcpDaqConfigOptionsDaqList3=2,1,10,0,20,0,0" DEVICE_SETTING "XcpDaqConfigOptionsDaqList4=3,1,10,0,30,0,0" DEVICE_SETTING "XcpDaqConfigOptionsDaqList5=4,1,10,0,40,0,0" DEVICE_SETTING "XcpDaqConfigOptionsDaqList6=5,1,10,0,50,0,0" DEVICE_SETTING "XcpDaqConfigOptionsDaqList7=6,1,10,0,60,0,0" DEVICE_SETTING "XcpDaqConfigOptionsDaqList8=7,1,10,0,70,0,0" DEVICE_SETTING "XcpDaqConfigOptionsDaqList9=8,1,10,0,80,0,0" DEVICE_SETTING "XcpDaqConfigOptionsDaqList10=9,1,10,0,90,0,0" DEVICE_SETTING "XcpCanIfDaqConfigOptionsNumDaqLists=10" DEVICE_SETTING "XcpDaqConfigOptions=1,0,0" DEVICE_SETTING "XcpDaqConfigOptionsNumDaqLists=10" DEVICE_SETTING "XcpCanIfCanIds=0x0100,1,0x771,0x777,8" DEVICE_SETTING "XcpCanIfDaqConfigOptionsEvent1=10_ms_task,10 ms,0,1,1,1,7,0xFF" DEVICE_SETTING "XcpCanIfDaqConfigOptionsEvent2=10_ms_task,10 ms,1,1,1,1,7,0xFF" DEVICE_SETTING "XcpCanIfDaqConfigOptionsEvent3=10_ms_task,10 ms,2,1,1,1,7,0xFF" DEVICE_SETTING "XcpCanIfDaqConfigOptionsEvent4=10_ms_task,10 ms,3,1,1,1,7,0xFF" DEVICE_SETTING "XcpCanIfDaqConfigOptionsEvent5=10_ms_task,10 ms,4,1,1,1,7,0xFF" DEVICE_SETTING "XcpCanIfDaqConfigOptionsEvent6=10_ms_task,10 ms,5,1,1,1,7,0xFF" DEVICE_SETTING "XcpCanIfDaqConfigOptionsEvent7=10_ms_task,10 ms,6,1,1,1,7,0xFF" DEVICE_SETTING "XcpCanIfDaqConfigOptionsEvent8=10_ms_task,10 ms,7,1,1,1,7,0xFF" DEVICE_SETTING "XcpCanIfDaqConfigOptionsEvent9=10_ms_task,10 ms,8,1,1,1,7,0xFF" DEVICE_SETTING "XcpCanIfDaqConfigOptionsEvent10=10_ms_task,10 ms,9,1,1,1,7,0xFF" DEVICE_SETTING "XcpCanIfDaqEventDefaultEventList1=0" DEVICE_SETTING "XcpCanIfDaqEventDefaultEventList2=1" DEVICE_SETTING "XcpCanIfDaqEventDefaultEventList3=2" DEVICE_SETTING "XcpCanIfDaqEventDefaultEventList4=3" DEVICE_SETTING "XcpCanIfDaqEventDefaultEventList5=4" DEVICE_SETTING "XcpCanIfDaqEventDefaultEventList6=5" DEVICE_SETTING "XcpCanIfDaqEventDefaultEventList7=6" DEVICE_SETTING "XcpCanIfDaqEventDefaultEventList8=7" DEVICE_SETTING "XcpCanIfDaqEventDefaultEventList9=8" DEVICE_SETTING "XcpCanIfDaqEventDefaultEventList10=9" DEVICE_SETTING "XcpProtocolOptionalCmds=12,0xf8,0xf7,0xf6,0xf5,0xf3,0xda,0xd9,0xd8,0xd7,0xd0,0xd1,0xd2" DEVICE_SETTING "XcpDaqConfigOptionsTimestamp=1,2,7,0" DEVICE_SETTING "XcpCanIfProtocolSeedAndKey=SeedDLL.dll" DEVICE_SETTING "XcpPgmConfig=1,3,8" DEVICE_SETTING "XcpPgm=1,1,8,10,0,0" DEVICE_SETTING "StructureNameOption=1" DEVICE_SETTING "XcpPgmNumSector=3" DEVICE_SETTING "XcpPgmConfigSector1=APPL_FLASH,0,0x00080000,0xA0000,0,0,0" DEVICE_SETTING "XcpPgmConfigSector2=CAL_FLASH,1,0x00120000,0x20000,1,1,0" DEVICE_SETTING "XcpPgmConfigSector3=CAL_SEG,2,0x00120000,0x17D9C,2,2,0" /*XCP_Header_End*/ /* PROTOCOL_HEADER_END */ /end IF_DATA
/*
* MOD_COMMON keyword is used to specify general description data for the module
* which are then used as standard in this module
*/
/begin MOD_COMMON "Mod Common Comment Here" DEPOSIT ABSOLUTE BYTE_ORDER MSB_FIRST /end MOD_COMMON
/* MOD_PAR : management data to be specified for an device */
/begin MOD_PAR "MOD PAR Comment Goes Here" /end MOD_PAR
/* OVERVIEW */
/* MATLAB_SECTION_END_1*/
/end MODULE
/end PROJECT
