/* ASAP2 file: ECU_BATU.a2l */
/* Author : Sebnem Saliha Cakiroglu */ ASAP2_VERSION 1 6
/begin PROJECT ECEMTAG_CR8 ""
/begin MODULE DIM ""
/begin IF_DATA VISION /*
* Size cal par_start to checksum(not included)
* Application area : 0x80000-0x1A0000 (0x180000-0x1A0000 is default cal area)
* CAL_SEG area : 0x1C0000-0x1E0000
*/
 /begin MEMORY_REGION CAL_SEG 0x001A0000 0x15db0 0x6 0 /end MEMORY_REGION
 /begin MEMORY_REGION APPL_FLASH 0x00080000 0x120000 0x1 0 /end MEMORY_REGION
 /begin MEMORY_REGION CAL_FLASH 0x001A0000 0x20000 0x1 0 /end MEMORY_REGION
 /* PROTOCOL_HEADER_START */ /*XCP_Header_Start*/ DEVICE_SETTING "XcpEcuOverrideFlags=0x10" DEVICE_SETTING "XcpNumSegments=3" DEVICE_SETTING "SkipPingAfterSync=TRUE" DEVICE_SETTING "XcpDaqPollingMode=0" DEVICE_SETTING "XcpCanIfDaqPollingMode=0" DEVICE_SETTING "EcuByteOrder=1" DEVICE_SETTING "XcpSegment1Page1=0,3,3,3,0" DEVICE_SETTING "XcpCanIfProtocolVersion=0x0100" DEVICE_SETTING "XcpSegment1Config=Code01,0,1,0,0" DEVICE_SETTING "XcpSegment2NumPages=1" DEVICE_SETTING "XcpSegment2Config=Code02,0,1,0,0" DEVICE_SETTING "XcpCanIfProtocolOptionalCmds=12,0xf8,0xf7,0xf6,0xf5,0xf3,0xda,0xd9,0xd8,0xd7,0xd0,0xd1,0xd2" DEVICE_SETTING "XcpCanIfConfig=1000000,75,1,9,1,1" DEVICE_SETTING "XcpSegment3Page1=0,3,3,3,0" DEVICE_SETTING "GroupSeparator=#" DEVICE_SETTING "XcpCanIfDaqConfig=0,10,10,0,0,0,0,1,10,2" DEVICE_SETTING "XcpDaqConfig=0,10,10,0,0,0,0,1,10,2" DEVICE_SETTING "XcpDaqConfigOptionsNumEvents=10" DEVICE_SETTING "XcpCanIfDaqConfigOptionsTimestamp=1,2,7,0" DEVICE_SETTING "XcpCanIfProtocolTiming=2000,3000,800,800,3000,800,3000" DEVICE_SETTING "XcpSegment3NumPages=1" DEVICE_SETTING "XcpCanIfDaqConfigOptionsNumEvents=10" DEVICE_SETTING "XcpProtocolConfig=8,8,0,1" DEVICE_SETTING "XcpStoreSuppport=1" DEVICE_SETTING "XcpProtocolVersion=0x0100" DEVICE_SETTING "XcpProtocolTiming=2000,3000,800,800,3000,800,3000" DEVICE_SETTING "XcpProtocolSeedAndKey=SeedDLL.dll" DEVICE_SETTING "SyncDownloadRegionsOnly=TRUE" DEVICE_SETTING "XcpSegment2Page1=0,3,3,3,0" DEVICE_SETTING "XcpPagConfig=1,0" DEVICE_SETTING "XcpCanIfProtocolConfig=8,8,0,1" DEVICE_SETTING "XcpCanIfDaqConfigOptions=1,1,0" DEVICE_SETTING "XcpCanIfDaqConfigOptionsDaqList1=0,1,10,0,0,0,0" DEVICE_SETTING "XcpCanIfDaqConfigOptionsDaqList2=1,1,10,0,10,0,0" DEVICE_SETTING "XcpCanIfDaqConfigOptionsDaqList3=2,1,10,0,20,0,0" DEVICE_SETTING "XcpCanIfDaqConfigOptionsDaqList4=3,1,10,0,30,0,0" DEVICE_SETTING "XcpCanIfDaqConfigOptionsDaqList5=4,1,10,0,40,0,0" DEVICE_SETTING "XcpCanIfDaqConfigOptionsDaqList6=5,1,10,0,50,0,0" DEVICE_SETTING "XcpCanIfDaqConfigOptionsDaqList7=6,1,10,0,60,0,0" DEVICE_SETTING "XcpCanIfDaqConfigOptionsDaqList8=7,1,10,0,70,0,0" DEVICE_SETTING "XcpCanIfDaqConfigOptionsDaqList9=8,1,10,0,80,0,0" DEVICE_SETTING "XcpCanIfDaqConfigOptionsDaqList10=9,1,10,0,90,0,0" DEVICE_SETTING "XcpDaqConfigOptionsDaqList1=0,1,10,0,0,0,0" DEVICE_SETTING "XcpDaqConfigOptionsDaqList2=1,1,10,0,10,0,0" DEVICE_SETTING "XcpDaqConfigOptionsDaqList3=2,1,10,0,20,0,0" DEVICE_SETTING "XcpDaqConfigOptionsDaqList4=3,1,10,0,30,0,0" DEVICE_SETTING "XcpDaqConfigOptionsDaqList5=4,1,10,0,40,0,0" DEVICE_SETTING "XcpDaqConfigOptionsDaqList6=5,1,10,0,50,0,0" DEVICE_SETTING "XcpDaqConfigOptionsDaqList7=6,1,10,0,60,0,0" DEVICE_SETTING "XcpDaqConfigOptionsDaqList8=7,1,10,0,70,0,0" DEVICE_SETTING "XcpDaqConfigOptionsDaqList9=8,1,10,0,80,0,0" DEVICE_SETTING "XcpDaqConfigOptionsDaqList10=9,1,10,0,90,0,0" DEVICE_SETTING "XcpCanIfDaqConfigOptionsNumDaqLists=10" DEVICE_SETTING "XcpDaqConfigOptions=1,0,0" DEVICE_SETTING "XcpDaqConfigOptionsNumDaqLists=10" DEVICE_SETTING "XcpCanIfCanIds=0x0100,1,0x661,0x667,8" DEVICE_SETTING "XcpCanIfDaqConfigOptionsEvent1=10_ms_task,10 ms,0,1,1,1,7,0xFF" DEVICE_SETTING "XcpCanIfDaqConfigOptionsEvent2=10_ms_task,10 ms,1,1,1,1,7,0xFF" DEVICE_SETTING "XcpCanIfDaqConfigOptionsEvent3=10_ms_task,10 ms,2,1,1,1,7,0xFF" DEVICE_SETTING "XcpCanIfDaqConfigOptionsEvent4=10_ms_task,10 ms,3,1,1,1,7,0xFF" DEVICE_SETTING "XcpCanIfDaqConfigOptionsEvent5=10_ms_task,10 ms,4,1,1,1,7,0xFF" DEVICE_SETTING "XcpCanIfDaqConfigOptionsEvent6=10_ms_task,10 ms,5,1,1,1,7,0xFF" DEVICE_SETTING "XcpCanIfDaqConfigOptionsEvent7=10_ms_task,10 ms,6,1,1,1,7,0xFF" DEVICE_SETTING "XcpCanIfDaqConfigOptionsEvent8=10_ms_task,10 ms,7,1,1,1,7,0xFF" DEVICE_SETTING "XcpCanIfDaqConfigOptionsEvent9=10_ms_task,10 ms,8,1,1,1,7,0xFF" DEVICE_SETTING "XcpCanIfDaqConfigOptionsEvent10=10_ms_task,10 ms,9,1,1,1,7,0xFF" DEVICE_SETTING "XcpCanIfDaqEventDefaultEventList1=0" DEVICE_SETTING "XcpCanIfDaqEventDefaultEventList2=1" DEVICE_SETTING "XcpCanIfDaqEventDefaultEventList3=2" DEVICE_SETTING "XcpCanIfDaqEventDefaultEventList4=3" DEVICE_SETTING "XcpCanIfDaqEventDefaultEventList5=4" DEVICE_SETTING "XcpCanIfDaqEventDefaultEventList6=5" DEVICE_SETTING "XcpCanIfDaqEventDefaultEventList7=6" DEVICE_SETTING "XcpCanIfDaqEventDefaultEventList8=7" DEVICE_SETTING "XcpCanIfDaqEventDefaultEventList9=8" DEVICE_SETTING "XcpCanIfDaqEventDefaultEventList10=9" DEVICE_SETTING "XcpProtocolOptionalCmds=12,0xf8,0xf7,0xf6,0xf5,0xf3,0xda,0xd9,0xd8,0xd7,0xd0,0xd1,0xd2" DEVICE_SETTING "XcpDaqConfigOptionsTimestamp=1,2,7,0" DEVICE_SETTING "XcpCanIfProtocolSeedAndKey=SeedDLL.dll" DEVICE_SETTING "XcpPgmConfig=1,3,8" DEVICE_SETTING "XcpPgm=1,1,8,10,0,0" DEVICE_SETTING "StructureNameOption=1" DEVICE_SETTING "XcpPgmNumSector=3" DEVICE_SETTING "XcpPgmConfigSector1=APPL_FLASH,0,0x00080000,0xA0000,0,0,0" DEVICE_SETTING "XcpPgmConfigSector2=CAL_FLASH,1,0x00120000,0x20000,1,1,0" DEVICE_SETTING "XcpPgmConfigSector3=CAL_SEG,2,0x00120000,0x17D9C,2,2,0" /*XCP_Header_End*/ /* PROTOCOL_HEADER_END */ /end IF_DATA
/*
* MOD_COMMON keyword is used to specify general description data for the module
* which are then used as standard in this module
*/
/begin MOD_COMMON "Mod Common Comment Here" DEPOSIT ABSOLUTE BYTE_ORDER MSB_FIRST /end MOD_COMMON
/* MOD_PAR : management data to be specified for an device */
/begin MOD_PAR "MOD PAR Comment Goes Here" /end MOD_PAR
/* OVERVIEW */
/begin MEASUREMENT product_type "product_engine_type" UBYTE CM_ProductType 1 100 0 10 FORMAT "%20.0" ECU_ADDRESS 0x00080146 /* @ECU_Address@gstSoftwareIdent.product_engine_type@ */ /end MEASUREMENT
/begin MEASUREMENT sw_ident_start_addr "sw_ident_start_addr" UBYTE NO_COMPU_METHOD 1 100 0 255 FORMAT "%20.0" ECU_ADDRESS 0x0008012C /* @ECU_Address@gstSoftwareIdent@ */ /end MEASUREMENT
/begin MEASUREMENT error_status_change_cnt "Error Status Change Count" ULONG NO_COMPU_METHOD 1 100 0 4294967295 FORMAT "%20.0" ECU_ADDRESS 0x40002AB8 /* @ECU_Address@error_status_change_cnt@ */ /end MEASUREMENT
/begin CHARACTERISTIC EngineHour_Ovv "The desired Engine Hours value to be provided. after that please ovs set!" VALUE 0x400045A4 /* @ECU_Address@EngineHourOvvFlag@ */ ULONG 10000 Duration_h_Scalex1_CM 0 10000 FORMAT "%20.2" /end CHARACTERISTIC
/begin CHARACTERISTIC EngineHour_Ovs "The desired Engine Hours ON/OFF Status " VALUE 0x4000459F /* @ECU_Address@EngineHourOvsFlag@ */ UBYTE 1 NO_COMPU_METHOD 0 1 FORMAT "%20.0" /end CHARACTERISTIC
/begin CHARACTERISTIC EngineHour_Zero_Setting "The Engine Hours  zero Flag " VALUE 0x4000459E /* @ECU_Address@EngineHourZeroFlag@ */ UBYTE 1 NO_COMPU_METHOD 0 1 FORMAT "%20.0" /end CHARACTERISTIC
/begin CHARACTERISTIC Prognostic_Counter_Zero_Setting "The Prognastic Hours  zero Flag " VALUE 0x400045AE /* @ECU_Address@PrognosticCounterZeroFlag@ */ UBYTE 1 NO_COMPU_METHOD 0 1 FORMAT "%20.0" /end CHARACTERISTIC
/begin CHARACTERISTIC OilHour_Zero_Setting "The Oil Hours  zero Flag " VALUE 0x40002A4B /* @ECU_Address@EngineDTC.OilChangeOvsFlag@*/ UBYTE 1 NO_COMPU_METHOD 0 1 FORMAT "%20.0" /end CHARACTERISTIC
/begin CHARACTERISTIC MaintenanceHour_Zero_Setting "The Maintenance Hours  zero Flag " VALUE 0x40002A4C /* @ECU_Address@EngineDTC.EngineMaintenanceOvsFlag@*/ UBYTE 1 NO_COMPU_METHOD 0 1 FORMAT "%20.0" /end CHARACTERISTIC
/begin CHARACTERISTIC Watchdog_IO_Flag "IO Task Watchdog Flag " VALUE 0x400045C8 /* @ECU_Address@TaskWatchdogFlag.Watchdog_IO_Flag@ */ UBYTE 1 NO_COMPU_METHOD 0 1 FORMAT "%20.0" /end CHARACTERISTIC
/begin CHARACTERISTIC OilHour_Ovv "The desired Oil Hours value to be provided. after that please ovs set!" VALUE 0x400045B4 /* @ECU_Address@OilHourOvvFlag@ */ ULONG 10000 NO_COMPU_METHOD 0 10000 FORMAT "%20.0" /end CHARACTERISTIC
/begin CHARACTERISTIC OilHour_Ovs "The desired Oil Hours ON/OFF Status " VALUE 0x400045AF /* @ECU_Address@OilHourOvsFlag@ */ UBYTE 1 NO_COMPU_METHOD 0 1 FORMAT "%20.0" /end CHARACTERISTIC
/begin CHARACTERISTIC OilChangeHours "Oil Change Hour for Engine " VALUE 0x001A05C4 /* @ECU_Address@OilChangeHour@ */ /* mta: */ UWORD 60 NO_COMPU_METHOD 0 65535 FORMAT "%20.0" /end CHARACTERISTIC
/begin CHARACTERISTIC MaintenanceHour_Ovs "The desired Maintenance Hours ON/OFF Status " VALUE 0x400045B0 /* @ECU_Address@MaintenanceOvsFlag@ */ UBYTE 1 NO_COMPU_METHOD 0 1 FORMAT "%20.0" /end CHARACTERISTIC
/begin CHARACTERISTIC Watchdog_CAN_Flag "CAN Task Watchdog Flag " VALUE 0x400045C9 /* @ECU_Address@TaskWatchdogFlag.Watchdog_CAN_Flag@ */ UBYTE 1 NO_COMPU_METHOD 0 1 FORMAT "%20.0" /end CHARACTERISTIC
/begin CHARACTERISTIC Watchdog_ITS_Flag "ITS Task Watchdog Flag " VALUE 0x400045CA /* @ECU_Address@TaskWatchdogFlag.Watchdog_ITS_Flag@ */ UBYTE 1 NO_COMPU_METHOD 0 1 FORMAT "%20.0" /end CHARACTERISTIC
/begin CHARACTERISTIC Watchdog_CCP_Flag "CCP Task Watchdog Flag " VALUE 0x400045CB /* @ECU_Address@TaskWatchdogFlag.Watchdog_CCP_Flag@ */ UBYTE 1 NO_COMPU_METHOD 0 1 FORMAT "%20.0" /end CHARACTERISTIC
/begin CHARACTERISTIC Watchdog_CYCLIC_Flag "CYCLIC Task Watchdog Flag " VALUE 0x400045CC /* @ECU_Address@TaskWatchdogFlag.Watchdog_CYCLIC_Flag@ */ UBYTE 1 NO_COMPU_METHOD 0 1 FORMAT "%20.0" /end CHARACTERISTIC
/begin MEASUREMENT mel_battery_1_5V_err_cnt "mel_battery_1_5V_err_cnt" UWORD NO_COMPU_METHOD 1 100 0 65535 FORMAT "%20.2" ECU_ADDRESS 0x4000A484 /* @ECU_Address@mcu_err_log.mel_battery_1_5V_err_cnt@ */ /end MEASUREMENT
/begin MEASUREMENT EngineHour "Engine Hour Monitoring" ULONG Duration_h_Scalex1_CM 1 100 0 4294967295 FORMAT "%20.2" ECU_ADDRESS 0x4000A508 /* @ECU_Address@engine_param.EngineTimeVar.engine_hour@ */ /end MEASUREMENT
/begin MEASUREMENT OilHour "Engine Oil Hour Monitoring" ULONG NO_COMPU_METHOD 1 100 0 4294967295 FORMAT "%20.0" ECU_ADDRESS 0x4000A50C /* @ECU_Address@engine_param.EngineTimeVar.oil_hour@ */ /end MEASUREMENT
/begin MEASUREMENT Combat_Switch_EngineHour_Record_1 "Combat Switch Status Hour Record 1" ULONG Duration_h_Scalex1_CM 1 100 0 4294967295 FORMAT "%20.2" ECU_ADDRESS 0x4000A4A4 /* @ECU_Address@CombatModeChangeRecord[0].EnginegHour@ */ /end MEASUREMENT
/begin MEASUREMENT Combat_Switch_EngineHour_Record_2 "Combat Switch Status Hour Record 2" ULONG Duration_h_Scalex1_CM 1 100 0 4294967295 FORMAT "%20.2" ECU_ADDRESS 0x4000A4A9 /* @ECU_Address@CombatModeChangeRecord[1].EnginegHour@ */ /end MEASUREMENT
/begin MEASUREMENT Combat_Switch_EngineHour_Record_3 "Combat Switch Status Hour Record 3" ULONG Duration_h_Scalex1_CM 1 100 0 4294967295 FORMAT "%20.2" ECU_ADDRESS 0x4000A4AE /* @ECU_Address@CombatModeChangeRecord[2].EnginegHour@ */ /end MEASUREMENT
/begin MEASUREMENT Combat_Switch_EngineHour_Record_4 "Combat Switch Status Hour Record 4" ULONG Duration_h_Scalex1_CM 1 100 0 4294967295 FORMAT "%20.2" ECU_ADDRESS 0x4000A4B3 /* @ECU_Address@CombatModeChangeRecord[3].EnginegHour@ */ /end MEASUREMENT
/begin MEASUREMENT Combat_Switch_EngineHour_Record_5 "Combat Switch Status Hour Record 5" ULONG Duration_h_Scalex1_CM 1 100 0 4294967295 FORMAT "%20.2" ECU_ADDRESS 0x4000A4B8 /* @ECU_Address@CombatModeChangeRecord[4].EnginegHour@ */ /end MEASUREMENT
/begin MEASUREMENT Combat_Switch_Position_Record_1 "Combat Switch Position Status Record 1" UBYTE NO_COMPU_METHOD 1 100 0 1 FORMAT "%20.0" ECU_ADDRESS 0x4000A4A8 /* @ECU_Address@CombatModeChangeRecord[0].CmbtSwtFlag@ */ /end MEASUREMENT
/begin MEASUREMENT Combat_Switch_Position_Record_2 "Combat Switch Position Status Record 2" UBYTE NO_COMPU_METHOD 1 100 0 1 FORMAT "%20.0" ECU_ADDRESS 0x4000A4AD /* @ECU_Address@CombatModeChangeRecord[1].CmbtSwtFlag@ */ /end MEASUREMENT
/begin MEASUREMENT Combat_Switch_Position_Record_3 "Combat Switch Position Status Record 3" UBYTE NO_COMPU_METHOD 1 100 0 1 FORMAT "%20.0" ECU_ADDRESS 0x4000A4B2 /* @ECU_Address@CombatModeChangeRecord[2].CmbtSwtFlag@ */ /end MEASUREMENT
/begin MEASUREMENT Combat_Switch_Position_Record_4 "Combat Switch Position Status Record 4" UBYTE NO_COMPU_METHOD 1 100 0 1 FORMAT "%20.0" ECU_ADDRESS 0x4000A4B7 /* @ECU_Address@CombatModeChangeRecord[3].CmbtSwtFlag@ */ /end MEASUREMENT
/begin MEASUREMENT Combat_Switch_Position_Record_5 "Combat Switch Position Status Record 5" UBYTE NO_COMPU_METHOD 1 100 0 1 FORMAT "%20.0" ECU_ADDRESS 0x4000A4BC /* @ECU_Address@CombatModeChangeRecord[4].CmbtSwtFlag@ */ /end MEASUREMENT
/begin MEASUREMENT mel_battery_3_3V_err_cnt "mel_battery_3_3V_err_cnt" UWORD NO_COMPU_METHOD 1 100 0 65535 FORMAT "%20.2" ECU_ADDRESS 0x4000A486 /* @ECU_Address@mcu_err_log.mel_battery_3_3V_err_cnt@ */ /end MEASUREMENT
/begin MEASUREMENT mel_battery_5V_err_cnt "mel_battery_5V_err_cnt" UWORD NO_COMPU_METHOD 1 100 0 65535 FORMAT "%20.2" ECU_ADDRESS 0x4000A488 /* @ECU_Address@mcu_err_log.mel_battery_5V_err_cnt@ */ /end MEASUREMENT
/begin MEASUREMENT mel_battery_16V_err_cnt "mel_battery_16V_err_cnt" UWORD NO_COMPU_METHOD 1 100 0 65535 FORMAT "%20.2" ECU_ADDRESS 0x4000A48A /* @ECU_Address@mcu_err_log.mel_battery_16V_err_cnt@ */ /end MEASUREMENT
/begin CHARACTERISTIC mel_battery_err_clear_flag "mel_battery_err_clear_flag" VALUE 0x4000A48E /* @ECU_Address@mcu_err_log.mel_battery_err_clear_flag@ */ UBYTE 255 NO_COMPU_METHOD 0 1 FORMAT "%20.0" /end CHARACTERISTIC
/begin MEASUREMENT mel_board_inv_err_cnt "mel_board_inv_err_cnt" UWORD NO_COMPU_METHOD 1 100 0 65535 FORMAT "%20.2" ECU_ADDRESS 0x4000A48C /* @ECU_Address@mcu_err_log.mel_board_inv_err_cnt@ */ /end MEASUREMENT
/begin CHARACTERISTIC event_id "Event ID" VALUE 0x4000463A /* @ECU_Address@event_id@ */ UWORD 0 NO_COMPU_METHOD 0.0 65535 /end CHARACTERISTIC
/begin CHARACTERISTIC user_id "User ID" VALUE 0x4000463C /* @ECU_Address@user_id@ */ UWORD 0 NO_COMPU_METHOD 0.0 65535 /end CHARACTERISTIC
/begin CHARACTERISTIC conn_date "Connection Date" VALUE 0x40004640 /* @ECU_Address@conn_date@ */ ULONG 0 NO_COMPU_METHOD 0.0 4000000000 /end CHARACTERISTIC
/begin CHARACTERISTIC service_id "Service ID" VALUE 0x40004644 /* @ECU_Address@service_id@ */ UWORD 0 NO_COMPU_METHOD 0.0 65535 /end CHARACTERISTIC
/begin CHARACTERISTIC mel_board_inv_err_clear_flag "mel_board_inv_err_clear_flag" VALUE 0x4000A48F /* @ECU_Address@mcu_err_log.mel_board_inv_err_clear_flag@ */ UBYTE 255 NO_COMPU_METHOD 0 1 FORMAT "%20.0" /end CHARACTERISTIC
/begin MEASUREMENT mel_siu_rsr_pors_cnt "mel_siu_rsr_pors_cnt" UWORD NO_COMPU_METHOD 1 100 0 65535 FORMAT "%20.2" ECU_ADDRESS 0x4000A494 /* @ECU_Address@mcu_err_log.mel_siu_rsr_pors_cnt@ */ /end MEASUREMENT
/begin MEASUREMENT mel_siu_rsr_ers_cnt "mel_siu_rsr_ers_cnt" UWORD NO_COMPU_METHOD 1 100 0 65535 FORMAT "%20.2" ECU_ADDRESS 0x4000A496 /* @ECU_Address@mcu_err_log.mel_siu_rsr_ers_cnt@ */ /end MEASUREMENT
/begin MEASUREMENT mel_siu_rsr_llrs_cnt "mel_siu_rsr_llrs_cnt" UWORD NO_COMPU_METHOD 1 100 0 65535 FORMAT "%20.2" ECU_ADDRESS 0x4000A498 /* @ECU_Address@mcu_err_log.mel_siu_rsr_llrs_cnt@ */ /end MEASUREMENT
/begin MEASUREMENT mel_siu_rsr_lcrs_cnt "mel_siu_rsr_lcrs_cnt" UWORD NO_COMPU_METHOD 1 100 0 65535 FORMAT "%20.2" ECU_ADDRESS 0x4000A49A /* @ECU_Address@mcu_err_log.mel_siu_rsr_lcrs_cnt@ */ /end MEASUREMENT
/begin MEASUREMENT mel_siu_rsr_wdrs_cnt "mel_siu_rsr_wdrs_cnt" UWORD NO_COMPU_METHOD 1 100 0 65535 FORMAT "%20.2" ECU_ADDRESS 0x4000A49C /* @ECU_Address@mcu_err_log.mel_siu_rsr_wdrs_cnt@ */ /end MEASUREMENT
/begin MEASUREMENT mel_siu_rsr_crs_cnt "mel_siu_rsr_crs_cnt" UWORD NO_COMPU_METHOD 1 100 0 65535 FORMAT "%20.2" ECU_ADDRESS 0x4000A49E /* @ECU_Address@mcu_err_log.mel_siu_rsr_crs_cnt@ */ /end MEASUREMENT
/begin MEASUREMENT mel_siu_rsr_ssrs_cnt "mel_siu_rsr_ssrs_cnt" UWORD NO_COMPU_METHOD 1 100 0 65535 FORMAT "%20.2" ECU_ADDRESS 0x4000A4A0 /* @ECU_Address@mcu_err_log.mel_siu_rsr_ssrs_cnt@ */ /end MEASUREMENT
/begin CHARACTERISTIC mel_rsr_err_clear_flag "mel_rsr_err_clear_flag" VALUE 0x4000A4A2 /* @ECU_Address@mcu_err_log.mel_rsr_err_clear_flag@ */ UBYTE 255 NO_COMPU_METHOD 0 1 FORMAT "%20.0" /end CHARACTERISTIC
/begin CHARACTERISTIC injbank_read_period_ms "Injector Bank Read Period in miliseconds" VALUE 0x40002AC4 /* @ECU_Address@gulInjBankReadPeriodMs@ */ ULONG 500 NO_COMPU_METHOD 0 500 FORMAT "%20.0" /end CHARACTERISTIC
/begin CHARACTERISTIC injbank_restart_engine_speed_thd "Injector Bank Restart  Engine Speed threshold" VALUE 0x40002A10 /* @ECU_Address@gulInjRestartEngineSpeedThd@ */ ULONG 900 NO_COMPU_METHOD 0 900 FORMAT "%20.0" /end CHARACTERISTIC
/begin MEASUREMENT CHECK_cam_crank_pattern "Check the cam/crank signal pattern and calibration" UBYTE NO_COMPU_METHOD 1 100 0 4000000000 FORMAT "%20.0" ECU_ADDRESS 0x40002BC6 /* @ECU_Address@gucCamCrankPatternCheck@ */ /end MEASUREMENT
/begin MEASUREMENT CHECK_active_speed_sensor "Check the cam/crank signal pattern and calibration" UBYTE NO_COMPU_METHOD 1 100 0 4000000000 FORMAT "%20.0" ECU_ADDRESS 0x40002A80 /* @ECU_Address@ena_crk_sens2@ */ /end MEASUREMENT
/begin MEASUREMENT CHECK_SI1_DIAG_ADC "Check SI 1 Diagnostic ADC" FLOAT32_IEEE Voltage_CM 1 100 0 10 FORMAT "%20.2" ECU_ADDRESS 0x40009990 /* @ECU_Address@gstAnaIn[58].raw_value@ */ /end MEASUREMENT
/begin MEASUREMENT CHECK_SI2_DIAG_ADC "Check the cam/crank signal pattern and calibration" FLOAT32_IEEE Voltage_CM 1 100 0 10 FORMAT "%20.2" ECU_ADDRESS 0x400099A0 /* @ECU_Address@gstAnaIn[59].raw_value@ */ /end MEASUREMENT
/begin MEASUREMENT CHECK_SI3_DIAG_ADC "Check the cam/crank signal pattern and calibration" FLOAT32_IEEE Voltage_CM 1 100 0 10 FORMAT "%20.2" ECU_ADDRESS 0x400099B0 /* @ECU_Address@gstAnaIn[60].raw_value@ */ /end MEASUREMENT
/begin MEASUREMENT CHECK_SI4_DIAG_ADC "Check the cam/crank signal pattern and calibration" FLOAT32_IEEE Voltage_CM 1 100 0 10 FORMAT "%20.2" ECU_ADDRESS 0x400099C0 /* @ECU_Address@gstAnaIn[61].raw_value@ */ /end MEASUREMENT
/begin MEASUREMENT CYCLIC_task_stack_usage "" ULONG NO_COMPU_METHOD 1 100 0 4000000000 FORMAT "%20.0" ECU_ADDRESS 0x4000B338 /* @ECU_Address@os_stack_analysis_file.task_usage[0]@ */ /end MEASUREMENT
/begin MEASUREMENT CCP_task_stack_usage "" ULONG NO_COMPU_METHOD 1 100 0 4000000000 FORMAT "%20.0" ECU_ADDRESS 0x4000B33C /* @ECU_Address@os_stack_analysis_file.task_usage[1]@ */ /end MEASUREMENT
/begin MEASUREMENT CAN_task_stack_usage "" ULONG NO_COMPU_METHOD 1 100 0 4000000000 FORMAT "%20.0" ECU_ADDRESS 0x4000B340 /* @ECU_Address@os_stack_analysis_file.task_usage[2]@ */ /end MEASUREMENT
/begin MEASUREMENT PERF_task_stack_usage "" ULONG NO_COMPU_METHOD 1 100 0 4000000000 FORMAT "%20.0" ECU_ADDRESS 0x4000B344 /* @ECU_Address@os_stack_analysis_file.task_usage[3]@ */ /end MEASUREMENT
/begin MEASUREMENT REST_task_stack_usage "" ULONG NO_COMPU_METHOD 1 100 0 4000000000 FORMAT "%20.0" ECU_ADDRESS 0x4000B348 /* @ECU_Address@os_stack_analysis_file.task_usage[4]@ */ /end MEASUREMENT
/begin MEASUREMENT IO_task_stack_usage "" ULONG NO_COMPU_METHOD 1 100 0 4000000000 FORMAT "%20.0" ECU_ADDRESS 0x4000B34C /* @ECU_Address@os_stack_analysis_file.task_usage[5]@ */ /end MEASUREMENT
/begin MEASUREMENT ITS_task_stack_usage "" ULONG NO_COMPU_METHOD 1 100 0 4000000000 FORMAT "%20.0" ECU_ADDRESS 0x4000B350 /* @ECU_Address@os_stack_analysis_file.task_usage[6]@ */ /end MEASUREMENT
/begin MEASUREMENT J1939_task_stack_usage "" ULONG NO_COMPU_METHOD 1 100 0 4000000000 FORMAT "%20.0" ECU_ADDRESS 0x4000B354 /* @ECU_Address@os_stack_analysis_file.task_usage[7]@ */ /end MEASUREMENT
/begin MEASUREMENT CANOPEN_task_stack_usage "" ULONG NO_COMPU_METHOD 1 100 0 4000000000 FORMAT "%20.0" ECU_ADDRESS 0x4000B358 /* @ECU_Address@os_stack_analysis_file.task_usage[8]@ */ /end MEASUREMENT
/begin MEASUREMENT INIT_task_stack_usage "" ULONG NO_COMPU_METHOD 1 100 0 4000000000 FORMAT "%20.0" ECU_ADDRESS 0x4000B35C /* @ECU_Address@os_stack_analysis_file.task_usage[9]@ */ /end MEASUREMENT
/begin MEASUREMENT ISR_task_stack_usage "" ULONG NO_COMPU_METHOD 1 100 0 4000000000 FORMAT "%20.0" ECU_ADDRESS 0x4000B360 /* @ECU_Address@os_stack_analysis_file.os_isr_task_usage@ */ /end MEASUREMENT
/begin MEASUREMENT CYCLIC_task_stack_err "" ULONG NO_COMPU_METHOD 1 100 0 4000000000 FORMAT "%20.0" ECU_ADDRESS 0x4000B364 /* @ECU_Address@os_stack_analysis_file.task_stack_error[0]@ */ /end MEASUREMENT
/begin MEASUREMENT CCP_task_stack_err "" ULONG NO_COMPU_METHOD 1 100 0 4000000000 FORMAT "%20.0" ECU_ADDRESS 0x4000B368 /* @ECU_Address@os_stack_analysis_file.task_stack_error[1]@ */ /end MEASUREMENT
/begin MEASUREMENT CAN_task_stack_err "" ULONG NO_COMPU_METHOD 1 100 0 4000000000 FORMAT "%20.0" ECU_ADDRESS 0x4000B36C /* @ECU_Address@os_stack_analysis_file.task_stack_error[2]@ */ /end MEASUREMENT
/begin MEASUREMENT PERF_task_stack_err "" ULONG NO_COMPU_METHOD 1 100 0 4000000000 FORMAT "%20.0" ECU_ADDRESS 0x4000B370 /* @ECU_Address@os_stack_analysis_file.task_stack_error[3]@ */ /end MEASUREMENT
/begin MEASUREMENT WM_bStUsrUClmp30OvRedn "" UBYTE BATU_EcuIntgdSwGend_CM_boolean 0 0 0.0 1.0 ECU_ADDRESS 0x4000438B /* @ECU_Address@WM_bStUsrUClmp30OvRedn@ */ /end MEASUREMENT
/begin MEASUREMENT WM_bAcvUClmp30OvRedn "" UBYTE BATU_EcuIntgdSwGend_CM_boolean 0 0 0.0 1.0 ECU_ADDRESS 0x4000438C /* @ECU_Address@WM_bAcvUClmp30OvRedn@ */ /end MEASUREMENT
/begin MEASUREMENT WM_bTiDeacShtdwnUClmp30OvDeb "" UBYTE BATU_EcuIntgdSwGend_CM_boolean 0 0 0.0 1.0 ECU_ADDRESS 0x4000438D /* @ECU_Address@WM_bTiDeacShtdwnUClmp30OvDeb@ */ /end MEASUREMENT
/begin MEASUREMENT WM_bTiDeacShtdwnUClmp30OvDebRst "" UBYTE BATU_EcuIntgdSwGend_CM_boolean 0 0 0.0 1.0 ECU_ADDRESS 0x4000438E /* @ECU_Address@WM_bTiDeacShtdwnUClmp30OvDebRst@ */ /end MEASUREMENT
/begin MEASUREMENT WM_bTiShtdwnUClmp30OvDeb "" UBYTE BATU_EcuIntgdSwGend_CM_boolean 0 0 0.0 1.0 ECU_ADDRESS 0x4000438F /* @ECU_Address@WM_bTiShtdwnUClmp30OvDeb@ */ /end MEASUREMENT
/begin MEASUREMENT WM_bTiShtdwnUClmp30OvDebSet "" UBYTE BATU_EcuIntgdSwGend_CM_boolean 0 0 0.0 1.0 ECU_ADDRESS 0x40004390 /* @ECU_Address@WM_bTiShtdwnUClmp30OvDebSet@ */ /end MEASUREMENT
/begin MEASUREMENT WM_bTiShtdwnUClmp30OvDebSetOutp "" UBYTE BATU_EcuIntgdSwGend_CM_boolean 0 0 0.0 1.0 ECU_ADDRESS 0x40004391 /* @ECU_Address@WM_bTiShtdwnUClmp30OvDebSetOutp@ */ /end MEASUREMENT
/begin MEASUREMENT WM_bTiNEngDeacShtdwnUClmp30OvDeb "" UBYTE BATU_EcuIntgdSwGend_CM_boolean 0 0 0.0 1.0 ECU_ADDRESS 0x40004392 /* @ECU_Address@WM_bTiNEngDeacShtdwnUClmp30OvDeb@ */ /end MEASUREMENT
/begin MEASUREMENT WM_bTiNEngShtdwnUClmp30OvRst "" UBYTE BATU_EcuIntgdSwGend_CM_boolean 0 0 0.0 1.0 ECU_ADDRESS 0x40004393 /* @ECU_Address@WM_bTiNEngShtdwnUClmp30OvRst@ */ /end MEASUREMENT
/begin MEASUREMENT WM_bTiNEngDeacShtdwnUClmp30OvDebRst "" UBYTE BATU_EcuIntgdSwGend_CM_boolean 0 0 0.0 1.0 ECU_ADDRESS 0x40004394 /* @ECU_Address@WM_bTiNEngDeacShtdwnUClmp30OvDebRst@ */ /end MEASUREMENT
/begin MEASUREMENT WM_bTiNEngAcvShtdwnUClmp30OvDeb "" UBYTE BATU_EcuIntgdSwGend_CM_boolean 0 0 0.0 1.0 ECU_ADDRESS 0x40004395 /* @ECU_Address@WM_bTiNEngAcvShtdwnUClmp30OvDeb@ */ /end MEASUREMENT
/begin MEASUREMENT WM_bTiNEngAcvShtdwnUClmp30OvDebSet "" UBYTE BATU_EcuIntgdSwGend_CM_boolean 0 0 0.0 1.0 ECU_ADDRESS 0x40004396 /* @ECU_Address@WM_bTiNEngAcvShtdwnUClmp30OvDebSet@ */ /end MEASUREMENT
/begin MEASUREMENT WM_bTiNEngAcvShtdwnUClmp30OvDebSetOutp "" UBYTE BATU_EcuIntgdSwGend_CM_boolean 0 0 0.0 1.0 ECU_ADDRESS 0x40004397 /* @ECU_Address@WM_bTiNEngAcvShtdwnUClmp30OvDebSetOutp@ */ /end MEASUREMENT
/begin MEASUREMENT WM_bStUsrUClmp30OvShtdwn "" UBYTE BATU_EcuIntgdSwGend_CM_boolean 0 0 0.0 1.0 ECU_ADDRESS 0x40004398 /* @ECU_Address@WM_bStUsrUClmp30OvShtdwn@ */ /end MEASUREMENT
/begin MEASUREMENT WM_bAcvUClmp30OvShtdwn "" UBYTE BATU_EcuIntgdSwGend_CM_boolean 0 0 0.0 1.0 ECU_ADDRESS 0x40004399 /* @ECU_Address@WM_bAcvUClmp30OvShtdwn@ */ /end MEASUREMENT
/begin MEASUREMENT WM_bTiDeacWarnUClmp30OvDeb "" UBYTE BATU_EcuIntgdSwGend_CM_boolean 0 0 0.0 1.0 ECU_ADDRESS 0x4000439A /* @ECU_Address@WM_bTiDeacWarnUClmp30OvDeb@ */ /end MEASUREMENT
/begin MEASUREMENT WM_bTiDeacWarnUClmp30OvDebRst "" UBYTE BATU_EcuIntgdSwGend_CM_boolean 0 0 0.0 1.0 ECU_ADDRESS 0x4000439B /* @ECU_Address@WM_bTiDeacWarnUClmp30OvDebRst@ */ /end MEASUREMENT
/begin MEASUREMENT WM_bTiWarnUClmp30OvDeb "" UBYTE BATU_EcuIntgdSwGend_CM_boolean 0 0 0.0 1.0 ECU_ADDRESS 0x4000439C /* @ECU_Address@WM_bTiWarnUClmp30OvDeb@ */ /end MEASUREMENT
/begin MEASUREMENT WM_bTiWarnUClmp30OvDebSet "" UBYTE BATU_EcuIntgdSwGend_CM_boolean 0 0 0.0 1.0 ECU_ADDRESS 0x4000439D /* @ECU_Address@WM_bTiWarnUClmp30OvDebSet@ */ /end MEASUREMENT
/begin MEASUREMENT WM_bTiWarnUClmp30OvDebSetOutp "" UBYTE BATU_EcuIntgdSwGend_CM_boolean 0 0 0.0 1.0 ECU_ADDRESS 0x4000439E /* @ECU_Address@WM_bTiWarnUClmp30OvDebSetOutp@ */ /end MEASUREMENT
/begin MEASUREMENT WM_bTiNEngDeacWarnUClmp30OvDeb "" UBYTE BATU_EcuIntgdSwGend_CM_boolean 0 0 0.0 1.0 ECU_ADDRESS 0x4000439F /* @ECU_Address@WM_bTiNEngDeacWarnUClmp30OvDeb@ */ /end MEASUREMENT
/begin MEASUREMENT WM_bTiNEngWarnUClmp30OvRst "" UBYTE BATU_EcuIntgdSwGend_CM_boolean 0 0 0.0 1.0 ECU_ADDRESS 0x400043A0 /* @ECU_Address@WM_bTiNEngWarnUClmp30OvRst@ */ /end MEASUREMENT
/begin MEASUREMENT WM_bTiNEngDeacWarnUClmp30OvDebRst "" UBYTE BATU_EcuIntgdSwGend_CM_boolean 0 0 0.0 1.0 ECU_ADDRESS 0x400043A1 /* @ECU_Address@WM_bTiNEngDeacWarnUClmp30OvDebRst@ */ /end MEASUREMENT
/begin MEASUREMENT WM_bTiNEngAcvWarnUClmp30OvDeb "" UBYTE BATU_EcuIntgdSwGend_CM_boolean 0 0 0.0 1.0 ECU_ADDRESS 0x400043A2 /* @ECU_Address@WM_bTiNEngAcvWarnUClmp30OvDeb@ */ /end MEASUREMENT
/begin MEASUREMENT WM_bTiNEngAcvWarnUClmp30OvDebSet "" UBYTE BATU_EcuIntgdSwGend_CM_boolean 0 0 0.0 1.0 ECU_ADDRESS 0x400043A3 /* @ECU_Address@WM_bTiNEngAcvWarnUClmp30OvDebSet@ */ /end MEASUREMENT
/begin MEASUREMENT WM_bTiNEngAcvWarnUClmp30OvDebSetOutp "" UBYTE BATU_EcuIntgdSwGend_CM_boolean 0 0 0.0 1.0 ECU_ADDRESS 0x400043A4 /* @ECU_Address@WM_bTiNEngAcvWarnUClmp30OvDebSetOutp@ */ /end MEASUREMENT
/begin MEASUREMENT WM_bStUsrUClmp30OvWarn "" UBYTE BATU_EcuIntgdSwGend_CM_boolean 0 0 0.0 1.0 ECU_ADDRESS 0x400043A5 /* @ECU_Address@WM_bStUsrUClmp30OvWarn@ */ /end MEASUREMENT
/begin MEASUREMENT WM_bAcvUClmp30OvWarn "" UBYTE BATU_EcuIntgdSwGend_CM_boolean 0 0 0.0 1.0 ECU_ADDRESS 0x400043A6 /* @ECU_Address@WM_bAcvUClmp30OvWarn@ */ /end MEASUREMENT
/begin MEASUREMENT WM_bTiDeacRednUClmp30UndDeb "" UBYTE BATU_EcuIntgdSwGend_CM_boolean 0 0 0.0 1.0 ECU_ADDRESS 0x400043A7 /* @ECU_Address@WM_bTiDeacRednUClmp30UndDeb@ */ /end MEASUREMENT
/begin MEASUREMENT WM_bTiDeacRednUClmp30UndDebRst "" UBYTE BATU_EcuIntgdSwGend_CM_boolean 0 0 0.0 1.0 ECU_ADDRESS 0x400043A8 /* @ECU_Address@WM_bTiDeacRednUClmp30UndDebRst@ */ /end MEASUREMENT
/begin MEASUREMENT WM_bTiRednUClmp30UndDeb "" UBYTE BATU_EcuIntgdSwGend_CM_boolean 0 0 0.0 1.0 ECU_ADDRESS 0x400043A9 /* @ECU_Address@WM_bTiRednUClmp30UndDeb@ */ /end MEASUREMENT
/begin MEASUREMENT WM_bTiRednUClmp30UndDebSet "" UBYTE BATU_EcuIntgdSwGend_CM_boolean 0 0 0.0 1.0 ECU_ADDRESS 0x400043AA /* @ECU_Address@WM_bTiRednUClmp30UndDebSet@ */ /end MEASUREMENT
/begin MEASUREMENT WM_bTiRednUClmp30UndDebSetOutp "" UBYTE BATU_EcuIntgdSwGend_CM_boolean 0 0 0.0 1.0 ECU_ADDRESS 0x400043AB /* @ECU_Address@WM_bTiRednUClmp30UndDebSetOutp@ */ /end MEASUREMENT
/begin MEASUREMENT WM_bTiNEngDeacRednUClmp30UndDeb "" UBYTE BATU_EcuIntgdSwGend_CM_boolean 0 0 0.0 1.0 ECU_ADDRESS 0x400043AC /* @ECU_Address@WM_bTiNEngDeacRednUClmp30UndDeb@ */ /end MEASUREMENT
/begin MEASUREMENT WM_bTiNEngAcvRednUClmp30UndRst "" UBYTE BATU_EcuIntgdSwGend_CM_boolean 0 0 0.0 1.0 ECU_ADDRESS 0x400043AD /* @ECU_Address@WM_bTiNEngAcvRednUClmp30UndRst@ */ /end MEASUREMENT
/begin MEASUREMENT WM_bTiNEngDeacRednUClmp30UndDebRst "" UBYTE BATU_EcuIntgdSwGend_CM_boolean 0 0 0.0 1.0 ECU_ADDRESS 0x400043AE /* @ECU_Address@WM_bTiNEngDeacRednUClmp30UndDebRst@ */ /end MEASUREMENT
/begin MEASUREMENT WM_bTiNEngAcvRednUClmp30UndDeb "" UBYTE BATU_EcuIntgdSwGend_CM_boolean 0 0 0.0 1.0 ECU_ADDRESS 0x400043AF /* @ECU_Address@WM_bTiNEngAcvRednUClmp30UndDeb@ */ /end MEASUREMENT
/begin MEASUREMENT WM_bTiNEngAcvRednUClmp30UndDebSet "" UBYTE BATU_EcuIntgdSwGend_CM_boolean 0 0 0.0 1.0 ECU_ADDRESS 0x400043B0 /* @ECU_Address@WM_bTiNEngAcvRednUClmp30UndDebSet@ */ /end MEASUREMENT
/begin MEASUREMENT WM_bTiNEngAcvRednUClmp30UndDebSetOutp "" UBYTE BATU_EcuIntgdSwGend_CM_boolean 0 0 0.0 1.0 ECU_ADDRESS 0x400043B1 /* @ECU_Address@WM_bTiNEngAcvRednUClmp30UndDebSetOutp@ */ /end MEASUREMENT
/begin MEASUREMENT WM_bStUsrUClmp30UndRedn "" UBYTE BATU_EcuIntgdSwGend_CM_boolean 0 0 0.0 1.0 ECU_ADDRESS 0x400043B2 /* @ECU_Address@WM_bStUsrUClmp30UndRedn@ */ /end MEASUREMENT
/begin MEASUREMENT WM_bAcvUClmp30UndRedn "" UBYTE BATU_EcuIntgdSwGend_CM_boolean 0 0 0.0 1.0 ECU_ADDRESS 0x400043B3 /* @ECU_Address@WM_bAcvUClmp30UndRedn@ */ /end MEASUREMENT
/begin MEASUREMENT WM_bTiDeacShtdwnUClmp30UndDeb "" UBYTE BATU_EcuIntgdSwGend_CM_boolean 0 0 0.0 1.0 ECU_ADDRESS 0x400043B4 /* @ECU_Address@WM_bTiDeacShtdwnUClmp30UndDeb@ */ /end MEASUREMENT
/begin MEASUREMENT WM_bTiDeacShtdwnUClmp30UndDebRst "" UBYTE BATU_EcuIntgdSwGend_CM_boolean 0 0 0.0 1.0 ECU_ADDRESS 0x400043B5 /* @ECU_Address@WM_bTiDeacShtdwnUClmp30UndDebRst@ */ /end MEASUREMENT
/begin MEASUREMENT WM_bTiShtdwnUClmp30UndDeb "" UBYTE BATU_EcuIntgdSwGend_CM_boolean 0 0 0.0 1.0 ECU_ADDRESS 0x400043B6 /* @ECU_Address@WM_bTiShtdwnUClmp30UndDeb@ */ /end MEASUREMENT
/begin MEASUREMENT WM_bTiShtdwnUClmp30UndDebSet "" UBYTE BATU_EcuIntgdSwGend_CM_boolean 0 0 0.0 1.0 ECU_ADDRESS 0x400043B7 /* @ECU_Address@WM_bTiShtdwnUClmp30UndDebSet@ */ /end MEASUREMENT
/begin MEASUREMENT WM_bTiShtdwnUClmp30UndDebSetOut "" UBYTE BATU_EcuIntgdSwGend_CM_boolean 0 0 0.0 1.0 ECU_ADDRESS 0x400043B8 /* @ECU_Address@WM_bTiShtdwnUClmp30UndDebSetOut@ */ /end MEASUREMENT
/begin MEASUREMENT WM_bTiNEngDeacShtdwnUClmp30UndDeb "" UBYTE BATU_EcuIntgdSwGend_CM_boolean 0 0 0.0 1.0 ECU_ADDRESS 0x400043B9 /* @ECU_Address@WM_bTiNEngDeacShtdwnUClmp30UndDeb@ */ /end MEASUREMENT
/begin MEASUREMENT WM_bTiNEngAcvShtdwnUClmp30UndRst "" UBYTE BATU_EcuIntgdSwGend_CM_boolean 0 0 0.0 1.0 ECU_ADDRESS 0x400043BA /* @ECU_Address@WM_bTiNEngAcvShtdwnUClmp30UndRst@ */ /end MEASUREMENT
/begin MEASUREMENT WM_bTiNEngDeacShtdwnUClmp30UndDebRst "" UBYTE BATU_EcuIntgdSwGend_CM_boolean 0 0 0.0 1.0 ECU_ADDRESS 0x400043BB /* @ECU_Address@WM_bTiNEngDeacShtdwnUClmp30UndDebRst@ */ /end MEASUREMENT
/begin MEASUREMENT WM_bTiNEngAcvShtdwnUClmp30UndDeb "" UBYTE BATU_EcuIntgdSwGend_CM_boolean 0 0 0.0 1.0 ECU_ADDRESS 0x400043BC /* @ECU_Address@WM_bTiNEngAcvShtdwnUClmp30UndDeb@ */ /end MEASUREMENT
/begin MEASUREMENT WM_bTiNEngAcvShtdwnUClmp30UndDebSet "" UBYTE BATU_EcuIntgdSwGend_CM_boolean 0 0 0.0 1.0 ECU_ADDRESS 0x400043BD /* @ECU_Address@WM_bTiNEngAcvShtdwnUClmp30UndDebSet@ */ /end MEASUREMENT
/begin MEASUREMENT WM_bStUsrUClmp30UndShtdwn "" UBYTE BATU_EcuIntgdSwGend_CM_boolean 0 0 0.0 1.0 ECU_ADDRESS 0x400043BE /* @ECU_Address@WM_bStUsrUClmp30UndShtdwn@ */ /end MEASUREMENT
/begin MEASUREMENT WM_bAcvUClmp30UndShtdwn "" UBYTE BATU_EcuIntgdSwGend_CM_boolean 0 0 0.0 1.0 ECU_ADDRESS 0x400043BF /* @ECU_Address@WM_bAcvUClmp30UndShtdwn@ */ /end MEASUREMENT
/begin MEASUREMENT WM_bTiDeacWarnUClmp30UndDeb "" UBYTE BATU_EcuIntgdSwGend_CM_boolean 0 0 0.0 1.0 ECU_ADDRESS 0x400043C0 /* @ECU_Address@WM_bTiDeacWarnUClmp30UndDeb@ */ /end MEASUREMENT
/begin MEASUREMENT WM_bTiDeacWarnUClmp30UndDebRst "" UBYTE BATU_EcuIntgdSwGend_CM_boolean 0 0 0.0 1.0 ECU_ADDRESS 0x400043C1 /* @ECU_Address@WM_bTiDeacWarnUClmp30UndDebRst@ */ /end MEASUREMENT
/begin MEASUREMENT WM_bTiWarnUClmp30UndDeb "" UBYTE BATU_EcuIntgdSwGend_CM_boolean 0 0 0.0 1.0 ECU_ADDRESS 0x400043C2 /* @ECU_Address@WM_bTiWarnUClmp30UndDeb@ */ /end MEASUREMENT
/begin MEASUREMENT WM_bTiWarnUClmp30UndDebSet "" UBYTE BATU_EcuIntgdSwGend_CM_boolean 0 0 0.0 1.0 ECU_ADDRESS 0x400043C3 /* @ECU_Address@WM_bTiWarnUClmp30UndDebSet@ */ /end MEASUREMENT
/begin MEASUREMENT WM_bTiWarnUClmp30UndDebSetOut "" UBYTE BATU_EcuIntgdSwGend_CM_boolean 0 0 0.0 1.0 ECU_ADDRESS 0x400043C4 /* @ECU_Address@WM_bTiWarnUClmp30UndDebSetOut@ */ /end MEASUREMENT
/begin MEASUREMENT WM_bTiNEngDeacWarnUClmp30UndDeb "" UBYTE BATU_EcuIntgdSwGend_CM_boolean 0 0 0.0 1.0 ECU_ADDRESS 0x400043C5 /* @ECU_Address@WM_bTiNEngDeacWarnUClmp30UndDeb@ */ /end MEASUREMENT
/begin MEASUREMENT WM_bTiNEngAcvWarnUClmp30UndRst "" UBYTE BATU_EcuIntgdSwGend_CM_boolean 0 0 0.0 1.0 ECU_ADDRESS 0x400043C6 /* @ECU_Address@WM_bTiNEngAcvWarnUClmp30UndRst@ */ /end MEASUREMENT
/begin MEASUREMENT WM_bTiNEngDeacWarnUClmp30UndDebRst "" UBYTE BATU_EcuIntgdSwGend_CM_boolean 0 0 0.0 1.0 ECU_ADDRESS 0x400043C7 /* @ECU_Address@WM_bTiNEngDeacWarnUClmp30UndDebRst@ */ /end MEASUREMENT
/begin MEASUREMENT WM_bTiNEngAcvWarnUClmp30UndDeb "" UBYTE BATU_EcuIntgdSwGend_CM_boolean 0 0 0.0 1.0 ECU_ADDRESS 0x400043C8 /* @ECU_Address@WM_bTiNEngAcvWarnUClmp30UndDeb@ */ /end MEASUREMENT
/begin MEASUREMENT WM_bTiNEngAcvWarnUClmp30UndDebSet "" UBYTE BATU_EcuIntgdSwGend_CM_boolean 0 0 0.0 1.0 ECU_ADDRESS 0x400043C9 /* @ECU_Address@WM_bTiNEngAcvWarnUClmp30UndDebSet@ */ /end MEASUREMENT
/begin MEASUREMENT WM_bTiNEngAcvWarnUClmp30UndDebSetOutp "" UBYTE BATU_EcuIntgdSwGend_CM_boolean 0 0 0.0 1.0 ECU_ADDRESS 0x400043CA /* @ECU_Address@WM_bTiNEngAcvWarnUClmp30UndDebSetOutp@ */ /end MEASUREMENT
/begin MEASUREMENT WM_bStUsrUClmp30UndWarn "" UBYTE BATU_EcuIntgdSwGend_CM_boolean 0 0 0.0 1.0 ECU_ADDRESS 0x400043CB /* @ECU_Address@WM_bStUsrUClmp30UndWarn@ */ /end MEASUREMENT
/begin MEASUREMENT WM_bAcvUClmp30UndWarn "" UBYTE BATU_EcuIntgdSwGend_CM_boolean 0 0 0.0 1.0 ECU_ADDRESS 0x400043CC /* @ECU_Address@WM_bAcvUClmp30UndWarn@ */ /end MEASUREMENT
/begin MEASUREMENT WM_bTiDeacRednErrCylMisfDeb "" UBYTE BATU_EcuIntgdSwGend_CM_boolean 0 0 0.0 1.0 ECU_ADDRESS 0x400043CD /* @ECU_Address@WM_bTiDeacRednErrCylMisfDeb@ */ /end MEASUREMENT
/begin MEASUREMENT WM_bTiDeacRednErrCylMisfDebRst "" UBYTE BATU_EcuIntgdSwGend_CM_boolean 0 0 0.0 1.0 ECU_ADDRESS 0x400043CE /* @ECU_Address@WM_bTiDeacRednErrCylMisfDebRst@ */ /end MEASUREMENT
/begin MEASUREMENT WM_bTiRednErrCylMisfDebSet "" UBYTE BATU_EcuIntgdSwGend_CM_boolean 0 0 0.0 1.0 ECU_ADDRESS 0x400043CF /* @ECU_Address@WM_bTiRednErrCylMisfDebSet@ */ /end MEASUREMENT
/begin MEASUREMENT WM_bTiRednErrCylMisfDebSetOutp "" UBYTE BATU_EcuIntgdSwGend_CM_boolean 0 0 0.0 1.0 ECU_ADDRESS 0x400043D0 /* @ECU_Address@WM_bTiRednErrCylMisfDebSetOutp@ */ /end MEASUREMENT
/begin MEASUREMENT WM_bTiNEngDeacRednErrCylMisfDeb "" UBYTE BATU_EcuIntgdSwGend_CM_boolean 0 0 0.0 1.0 ECU_ADDRESS 0x400043D1 /* @ECU_Address@WM_bTiNEngDeacRednErrCylMisfDeb@ */ /end MEASUREMENT
/begin MEASUREMENT WM_bTiNEngDeacRednErrCylMisfDebRst "" UBYTE BATU_EcuIntgdSwGend_CM_boolean 0 0 0.0 1.0 ECU_ADDRESS 0x400043D2 /* @ECU_Address@WM_bTiNEngDeacRednErrCylMisfDebRst@ */ /end MEASUREMENT
/begin MEASUREMENT WM_bTiNEngAcvRednErrCylMisfDeb "" UBYTE BATU_EcuIntgdSwGend_CM_boolean 0 0 0.0 1.0 ECU_ADDRESS 0x400043D3 /* @ECU_Address@WM_bTiNEngAcvRednErrCylMisfDeb@ */ /end MEASUREMENT
/begin MEASUREMENT WM_bTiNEngAcvRednErrCylMisfDebSet "" UBYTE BATU_EcuIntgdSwGend_CM_boolean 0 0 0.0 1.0 ECU_ADDRESS 0x400043D4 /* @ECU_Address@WM_bTiNEngAcvRednErrCylMisfDebSet@ */ /end MEASUREMENT
/begin MEASUREMENT WM_bTiNEngAcvRednErrCylMisfDebSetOutp "" UBYTE BATU_EcuIntgdSwGend_CM_boolean 0 0 0.0 1.0 ECU_ADDRESS 0x400043D5 /* @ECU_Address@WM_bTiNEngAcvRednErrCylMisfDebSetOutp@ */ /end MEASUREMENT
/begin MEASUREMENT WM_bStUsrErrCylMisfRedn "" UBYTE BATU_EcuIntgdSwGend_CM_boolean 0 0 0.0 1.0 ECU_ADDRESS 0x400043D6 /* @ECU_Address@WM_bStUsrErrCylMisfRedn@ */ /end MEASUREMENT
/begin MEASUREMENT WM_bAcvErrCylMisfRedn "" UBYTE BATU_EcuIntgdSwGend_CM_boolean 0 0 0.0 1.0 ECU_ADDRESS 0x400043D7 /* @ECU_Address@WM_bAcvErrCylMisfRedn@ */ /end MEASUREMENT
/begin MEASUREMENT WM_bTiDeacShtdwnErrCylMisfDeb "" UBYTE BATU_EcuIntgdSwGend_CM_boolean 0 0 0.0 1.0 ECU_ADDRESS 0x400043D8 /* @ECU_Address@WM_bTiDeacShtdwnErrCylMisfDeb@ */ /end MEASUREMENT
/begin MEASUREMENT WM_bTiDeacShtdwnErrCylMisfDebRst "" UBYTE BATU_EcuIntgdSwGend_CM_boolean 0 0 0.0 1.0 ECU_ADDRESS 0x400043D9 /* @ECU_Address@WM_bTiDeacShtdwnErrCylMisfDebRst@ */ /end MEASUREMENT
/begin MEASUREMENT WM_bTiShtdwnErrCylMisfDebSet "" UBYTE BATU_EcuIntgdSwGend_CM_boolean 0 0 0.0 1.0 ECU_ADDRESS 0x400043DA /* @ECU_Address@WM_bTiShtdwnErrCylMisfDebSet@ */ /end MEASUREMENT
/begin MEASUREMENT WM_bTiShtdwnErrCylMisfDebSetOutp "" UBYTE BATU_EcuIntgdSwGend_CM_boolean 0 0 0.0 1.0 ECU_ADDRESS 0x400043DB /* @ECU_Address@WM_bTiShtdwnErrCylMisfDebSetOutp@ */ /end MEASUREMENT
/begin MEASUREMENT WM_bTiNEngDeacShtdwnErrCylMisfDeb "" UBYTE BATU_EcuIntgdSwGend_CM_boolean 0 0 0.0 1.0 ECU_ADDRESS 0x400043DC /* @ECU_Address@WM_bTiNEngDeacShtdwnErrCylMisfDeb@ */ /end MEASUREMENT
/begin MEASUREMENT WM_bTiNEngDeacShtdwnErrCylMisfDebRst "" UBYTE BATU_EcuIntgdSwGend_CM_boolean 0 0 0.0 1.0 ECU_ADDRESS 0x400043DD /* @ECU_Address@WM_bTiNEngDeacShtdwnErrCylMisfDebRst@ */ /end MEASUREMENT
/begin MEASUREMENT WM_bTiNEngAcvShtdwnErrCylMisfDeb "" UBYTE BATU_EcuIntgdSwGend_CM_boolean 0 0 0.0 1.0 ECU_ADDRESS 0x400043DE /* @ECU_Address@WM_bTiNEngAcvShtdwnErrCylMisfDeb@ */ /end MEASUREMENT
/begin MEASUREMENT WM_bTiNEngAcvShtdwnErrCylMisfDebSet "" UBYTE BATU_EcuIntgdSwGend_CM_boolean 0 0 0.0 1.0 ECU_ADDRESS 0x400043DF /* @ECU_Address@WM_bTiNEngAcvShtdwnErrCylMisfDebSet@ */ /end MEASUREMENT
/begin MEASUREMENT WM_bTiNEngAcvShtdwnErrCylMisfDebSetOutp "" UBYTE BATU_EcuIntgdSwGend_CM_boolean 0 0 0.0 1.0 ECU_ADDRESS 0x400043E0 /* @ECU_Address@WM_bTiNEngAcvShtdwnErrCylMisfDebSetOutp@ */ /end MEASUREMENT
/begin MEASUREMENT WM_bStUsrErrCylMisfShtdwn "" UBYTE BATU_EcuIntgdSwGend_CM_boolean 0 0 0.0 1.0 ECU_ADDRESS 0x400043E1 /* @ECU_Address@WM_bStUsrErrCylMisfShtdwn@ */ /end MEASUREMENT
/begin MEASUREMENT WM_bAcvErrCylMisfShtdwn "" UBYTE BATU_EcuIntgdSwGend_CM_boolean 0 0 0.0 1.0 ECU_ADDRESS 0x400043E2 /* @ECU_Address@WM_bAcvErrCylMisfShtdwn@ */ /end MEASUREMENT
/begin MEASUREMENT WM_bTiDeacWarnErrCylMisfDeb "" UBYTE BATU_EcuIntgdSwGend_CM_boolean 0 0 0.0 1.0 ECU_ADDRESS 0x400043E3 /* @ECU_Address@WM_bTiDeacWarnErrCylMisfDeb@ */ /end MEASUREMENT
/begin MEASUREMENT WM_bTiDeacWarnErrCylMisfDebRst "" UBYTE BATU_EcuIntgdSwGend_CM_boolean 0 0 0.0 1.0 ECU_ADDRESS 0x400043E4 /* @ECU_Address@WM_bTiDeacWarnErrCylMisfDebRst@ */ /end MEASUREMENT
/begin MEASUREMENT WM_bTiWarnErrCylMisfDebSet "" UBYTE BATU_EcuIntgdSwGend_CM_boolean 0 0 0.0 1.0 ECU_ADDRESS 0x400043E5 /* @ECU_Address@WM_bTiWarnErrCylMisfDebSet@ */ /end MEASUREMENT
/begin MEASUREMENT WM_bTiWarnErrCylMisfDebSetOutp "" UBYTE BATU_EcuIntgdSwGend_CM_boolean 0 0 0.0 1.0 ECU_ADDRESS 0x400043E6 /* @ECU_Address@WM_bTiWarnErrCylMisfDebSetOutp@ */ /end MEASUREMENT
/begin MEASUREMENT WM_bTiNEngDeacWarnErrCylMisfDeb "" UBYTE BATU_EcuIntgdSwGend_CM_boolean 0 0 0.0 1.0 ECU_ADDRESS 0x400043E7 /* @ECU_Address@WM_bTiNEngDeacWarnErrCylMisfDeb@ */ /end MEASUREMENT
/begin MEASUREMENT WM_bTiNEngDeacWarnErrCylMisfDebRst "" UBYTE BATU_EcuIntgdSwGend_CM_boolean 0 0 0.0 1.0 ECU_ADDRESS 0x400043E8 /* @ECU_Address@WM_bTiNEngDeacWarnErrCylMisfDebRst@ */ /end MEASUREMENT
/begin MEASUREMENT WM_bTiNEngAcvWarnErrCylMisfDeb "" UBYTE BATU_EcuIntgdSwGend_CM_boolean 0 0 0.0 1.0 ECU_ADDRESS 0x400043E9 /* @ECU_Address@WM_bTiNEngAcvWarnErrCylMisfDeb@ */ /end MEASUREMENT
/begin MEASUREMENT WM_bTiNEngAcvWarnErrCylMisfDebSet "" UBYTE BATU_EcuIntgdSwGend_CM_boolean 0 0 0.0 1.0 ECU_ADDRESS 0x400043EA /* @ECU_Address@WM_bTiNEngAcvWarnErrCylMisfDebSet@ */ /end MEASUREMENT
/begin MEASUREMENT WM_bTiNEngAcvWarnErrCylMisfDebSetOutp "" UBYTE BATU_EcuIntgdSwGend_CM_boolean 0 0 0.0 1.0 ECU_ADDRESS 0x400043EB /* @ECU_Address@WM_bTiNEngAcvWarnErrCylMisfDebSetOutp@ */ /end MEASUREMENT
/begin MEASUREMENT WM_bStUsrErrCylMisfWarn "" UBYTE BATU_EcuIntgdSwGend_CM_boolean 0 0 0.0 1.0 ECU_ADDRESS 0x400043EC /* @ECU_Address@WM_bStUsrErrCylMisfWarn@ */ /end MEASUREMENT
/begin MEASUREMENT WM_bAcvErrCylMisfWarn "" UBYTE BATU_EcuIntgdSwGend_CM_boolean 0 0 0.0 1.0 ECU_ADDRESS 0x400043ED /* @ECU_Address@WM_bAcvErrCylMisfWarn@ */ /end MEASUREMENT
/begin MEASUREMENT WM_bTiDeacRednNTrbChrgOvDeb "" UBYTE BATU_EcuIntgdSwGend_CM_boolean 0 0 0.0 1.0 ECU_ADDRESS 0x400043EE /* @ECU_Address@WM_bTiDeacRednNTrbChrgOvDeb@ */ /end MEASUREMENT
/begin MEASUREMENT WM_bTiDeacRednNTrbChrgOvDebRst "" UBYTE BATU_EcuIntgdSwGend_CM_boolean 0 0 0.0 1.0 ECU_ADDRESS 0x400043EF /* @ECU_Address@WM_bTiDeacRednNTrbChrgOvDebRst@ */ /end MEASUREMENT
/begin MEASUREMENT WM_bTiRednNTrbChrgOvDeb "" UBYTE BATU_EcuIntgdSwGend_CM_boolean 0 0 0.0 1.0 ECU_ADDRESS 0x400043F0 /* @ECU_Address@WM_bTiRednNTrbChrgOvDeb@ */ /end MEASUREMENT
/begin MEASUREMENT WM_bTiRednNTrbChrgOvDebSet "" UBYTE BATU_EcuIntgdSwGend_CM_boolean 0 0 0.0 1.0 ECU_ADDRESS 0x400043F1 /* @ECU_Address@WM_bTiRednNTrbChrgOvDebSet@ */ /end MEASUREMENT
/begin MEASUREMENT WM_bTiRednNTrbChrgOvDebSetOutp "" UBYTE BATU_EcuIntgdSwGend_CM_boolean 0 0 0.0 1.0 ECU_ADDRESS 0x400043F2 /* @ECU_Address@WM_bTiRednNTrbChrgOvDebSetOutp@ */ /end MEASUREMENT
/begin MEASUREMENT WM_bTiNEngDeacRednNTrbChrgOvDeb "" UBYTE BATU_EcuIntgdSwGend_CM_boolean 0 0 0.0 1.0 ECU_ADDRESS 0x400043F3 /* @ECU_Address@WM_bTiNEngDeacRednNTrbChrgOvDeb@ */ /end MEASUREMENT
/begin MEASUREMENT WM_bTiNEngAcvRednNTrbChrgOvRst "" UBYTE BATU_EcuIntgdSwGend_CM_boolean 0 0 0.0 1.0 ECU_ADDRESS 0x400043F4 /* @ECU_Address@WM_bTiNEngAcvRednNTrbChrgOvRst@ */ /end MEASUREMENT
/begin MEASUREMENT WM_bTiNEngDeacRednNTrbChrgOvDebRst "" UBYTE BATU_EcuIntgdSwGend_CM_boolean 0 0 0.0 1.0 ECU_ADDRESS 0x400043F5 /* @ECU_Address@WM_bTiNEngDeacRednNTrbChrgOvDebRst@ */ /end MEASUREMENT
/begin MEASUREMENT WM_bTiNEngAcvRednNTrbChrgOvDeb "" UBYTE BATU_EcuIntgdSwGend_CM_boolean 0 0 0.0 1.0 ECU_ADDRESS 0x400043F6 /* @ECU_Address@WM_bTiNEngAcvRednNTrbChrgOvDeb@ */ /end MEASUREMENT
/begin MEASUREMENT WM_bTiNEngAcvRednNTrbChrgOvDebSet "" UBYTE BATU_EcuIntgdSwGend_CM_boolean 0 0 0.0 1.0 ECU_ADDRESS 0x400043F7 /* @ECU_Address@WM_bTiNEngAcvRednNTrbChrgOvDebSet@ */ /end MEASUREMENT
/begin MEASUREMENT WM_bTiNEngAcvRednNTrbChrgOvDebSetOutp "" UBYTE BATU_EcuIntgdSwGend_CM_boolean 0 0 0.0 1.0 ECU_ADDRESS 0x400043F8 /* @ECU_Address@WM_bTiNEngAcvRednNTrbChrgOvDebSetOutp@ */ /end MEASUREMENT
/begin MEASUREMENT WM_bStUsrNTrbChrgOvRedn "" UBYTE BATU_EcuIntgdSwGend_CM_boolean 0 0 0.0 1.0 ECU_ADDRESS 0x400043F9 /* @ECU_Address@WM_bStUsrNTrbChrgOvRedn@ */ /end MEASUREMENT
/begin MEASUREMENT WM_bAcvNTrbChrgOvRedn "" UBYTE BATU_EcuIntgdSwGend_CM_boolean 0 0 0.0 1.0 ECU_ADDRESS 0x400043FA /* @ECU_Address@WM_bAcvNTrbChrgOvRedn@ */ /end MEASUREMENT
/begin MEASUREMENT WM_bTiDeacShtdwnNTrbChrgOvDeb "" UBYTE BATU_EcuIntgdSwGend_CM_boolean 0 0 0.0 1.0 ECU_ADDRESS 0x400043FB /* @ECU_Address@WM_bTiDeacShtdwnNTrbChrgOvDeb@ */ /end MEASUREMENT
/begin MEASUREMENT WM_bTiDeacShtdwnNTrbChrgOvDebRst "" UBYTE BATU_EcuIntgdSwGend_CM_boolean 0 0 0.0 1.0 ECU_ADDRESS 0x400043FC /* @ECU_Address@WM_bTiDeacShtdwnNTrbChrgOvDebRst@ */ /end MEASUREMENT
/begin MEASUREMENT WM_bTiShtdwnNTrbChrgOvDeb "" UBYTE BATU_EcuIntgdSwGend_CM_boolean 0 0 0.0 1.0 ECU_ADDRESS 0x400043FD /* @ECU_Address@WM_bTiShtdwnNTrbChrgOvDeb@ */ /end MEASUREMENT
/begin MEASUREMENT WM_bTiShtdwnNTrbChrgOvDebSet "" UBYTE BATU_EcuIntgdSwGend_CM_boolean 0 0 0.0 1.0 ECU_ADDRESS 0x400043FE /* @ECU_Address@WM_bTiShtdwnNTrbChrgOvDebSet@ */ /end MEASUREMENT
/begin MEASUREMENT WM_bTiShtdwnNTrbChrgOvDebSetOutp "" UBYTE BATU_EcuIntgdSwGend_CM_boolean 0 0 0.0 1.0 ECU_ADDRESS 0x400043FF /* @ECU_Address@WM_bTiShtdwnNTrbChrgOvDebSetOutp@ */ /end MEASUREMENT
/begin MEASUREMENT WM_bTiNEngDeacShtdwnNTrbChrgOvDeb "" UBYTE BATU_EcuIntgdSwGend_CM_boolean 0 0 0.0 1.0 ECU_ADDRESS 0x40004400 /* @ECU_Address@WM_bTiNEngDeacShtdwnNTrbChrgOvDeb@ */ /end MEASUREMENT
/begin MEASUREMENT WM_bTiNEngAcvShtdwnNTrbChrgOvRst "" UBYTE BATU_EcuIntgdSwGend_CM_boolean 0 0 0.0 1.0 ECU_ADDRESS 0x40004401 /* @ECU_Address@WM_bTiNEngAcvShtdwnNTrbChrgOvRst@ */ /end MEASUREMENT
/begin MEASUREMENT WM_bTiNEngDeacShtdwnNTrbChrgOvDebRst "" UBYTE BATU_EcuIntgdSwGend_CM_boolean 0 0 0.0 1.0 ECU_ADDRESS 0x40004402 /* @ECU_Address@WM_bTiNEngDeacShtdwnNTrbChrgOvDebRst@ */ /end MEASUREMENT
/begin MEASUREMENT WM_bTiNEngAcvShtdwnNTrbChrgOvDeb "" UBYTE BATU_EcuIntgdSwGend_CM_boolean 0 0 0.0 1.0 ECU_ADDRESS 0x40004403 /* @ECU_Address@WM_bTiNEngAcvShtdwnNTrbChrgOvDeb@ */ /end MEASUREMENT
/begin MEASUREMENT WM_bTiNEngAcvShtdwnNTrbChrgOvDebSet "" UBYTE BATU_EcuIntgdSwGend_CM_boolean 0 0 0.0 1.0 ECU_ADDRESS 0x40004404 /* @ECU_Address@WM_bTiNEngAcvShtdwnNTrbChrgOvDebSet@ */ /end MEASUREMENT
/begin MEASUREMENT WM_bTiNEngAcvShtdwnNTrbChrgOvDebSetOutp "" UBYTE BATU_EcuIntgdSwGend_CM_boolean 0 0 0.0 1.0 ECU_ADDRESS 0x40004405 /* @ECU_Address@WM_bTiNEngAcvShtdwnNTrbChrgOvDebSetOutp@ */ /end MEASUREMENT
/begin MEASUREMENT WM_bStUsrNTrbChrgOvShtdwn "" UBYTE BATU_EcuIntgdSwGend_CM_boolean 0 0 0.0 1.0 ECU_ADDRESS 0x40004406 /* @ECU_Address@WM_bStUsrNTrbChrgOvShtdwn@ */ /end MEASUREMENT
/begin MEASUREMENT WM_bAcvNTrbChrgOvShtdwn "" UBYTE BATU_EcuIntgdSwGend_CM_boolean 0 0 0.0 1.0 ECU_ADDRESS 0x40004407 /* @ECU_Address@WM_bAcvNTrbChrgOvShtdwn@ */ /end MEASUREMENT
/begin MEASUREMENT WM_bTiDeacWarnNTrbChrgOvDeb "" UBYTE BATU_EcuIntgdSwGend_CM_boolean 0 0 0.0 1.0 ECU_ADDRESS 0x40004408 /* @ECU_Address@WM_bTiDeacWarnNTrbChrgOvDeb@ */ /end MEASUREMENT
/begin MEASUREMENT WM_bTiDeacWarnNTrbChrgOvDebRst "" UBYTE BATU_EcuIntgdSwGend_CM_boolean 0 0 0.0 1.0 ECU_ADDRESS 0x40004409 /* @ECU_Address@WM_bTiDeacWarnNTrbChrgOvDebRst@ */ /end MEASUREMENT
/begin MEASUREMENT WM_bTiWarnNTrbChrgOvDeb "" UBYTE BATU_EcuIntgdSwGend_CM_boolean 0 0 0.0 1.0 ECU_ADDRESS 0x4000440A /* @ECU_Address@WM_bTiWarnNTrbChrgOvDeb@ */ /end MEASUREMENT
/begin MEASUREMENT WM_bTiWarnNTrbChrgOvDebSet "" UBYTE BATU_EcuIntgdSwGend_CM_boolean 0 0 0.0 1.0 ECU_ADDRESS 0x4000440B /* @ECU_Address@WM_bTiWarnNTrbChrgOvDebSet@ */ /end MEASUREMENT
/begin MEASUREMENT WM_bTiWarnNTrbChrgOvDebSetOutp "" UBYTE BATU_EcuIntgdSwGend_CM_boolean 0 0 0.0 1.0 ECU_ADDRESS 0x4000440C /* @ECU_Address@WM_bTiWarnNTrbChrgOvDebSetOutp@ */ /end MEASUREMENT
/begin MEASUREMENT WM_bTiNEngDeacWarnNTrbChrgOvDeb "" UBYTE BATU_EcuIntgdSwGend_CM_boolean 0 0 0.0 1.0 ECU_ADDRESS 0x4000440D /* @ECU_Address@WM_bTiNEngDeacWarnNTrbChrgOvDeb@ */ /end MEASUREMENT
/begin MEASUREMENT WM_bTiNEngAcvWarnNTrbChrgOvRst "" UBYTE BATU_EcuIntgdSwGend_CM_boolean 0 0 0.0 1.0 ECU_ADDRESS 0x4000440E /* @ECU_Address@WM_bTiNEngAcvWarnNTrbChrgOvRst@ */ /end MEASUREMENT
/begin MEASUREMENT WM_bTiNEngDeacWarnNTrbChrgOvDebRst "" UBYTE BATU_EcuIntgdSwGend_CM_boolean 0 0 0.0 1.0 ECU_ADDRESS 0x4000440F /* @ECU_Address@WM_bTiNEngDeacWarnNTrbChrgOvDebRst@ */ /end MEASUREMENT
/begin MEASUREMENT WM_bTiNEngAcvWarnNTrbChrgOvDeb "" UBYTE BATU_EcuIntgdSwGend_CM_boolean 0 0 0.0 1.0 ECU_ADDRESS 0x40004410 /* @ECU_Address@WM_bTiNEngAcvWarnNTrbChrgOvDeb@ */ /end MEASUREMENT
/begin MEASUREMENT WM_bTiNEngAcvWarnNTrbChrgOvDebSet "" UBYTE BATU_EcuIntgdSwGend_CM_boolean 0 0 0.0 1.0 ECU_ADDRESS 0x40004411 /* @ECU_Address@WM_bTiNEngAcvWarnNTrbChrgOvDebSet@ */ /end MEASUREMENT
/begin MEASUREMENT WM_bTiNEngAcvWarnNTrbChrgOvDebSetOutp "" UBYTE BATU_EcuIntgdSwGend_CM_boolean 0 0 0.0 1.0 ECU_ADDRESS 0x40004412 /* @ECU_Address@WM_bTiNEngAcvWarnNTrbChrgOvDebSetOutp@ */ /end MEASUREMENT
/begin MEASUREMENT WM_bStUsrNTrbChrgOvWarn "" UBYTE BATU_EcuIntgdSwGend_CM_boolean 0 0 0.0 1.0 ECU_ADDRESS 0x40004413 /* @ECU_Address@WM_bStUsrNTrbChrgOvWarn@ */ /end MEASUREMENT
/begin MEASUREMENT WM_bAcvNTrbChrgOvWarn "" UBYTE BATU_EcuIntgdSwGend_CM_boolean 0 0 0.0 1.0 ECU_ADDRESS 0x40004414 /* @ECU_Address@WM_bAcvNTrbChrgOvWarn@ */ /end MEASUREMENT
/begin MEASUREMENT WM_bTiDeacRednNTrbChrgUndDeb "" UBYTE BATU_EcuIntgdSwGend_CM_boolean 0 0 0.0 1.0 ECU_ADDRESS 0x40004415 /* @ECU_Address@WM_bTiDeacRednNTrbChrgUndDeb@ */ /end MEASUREMENT
/begin MEASUREMENT WM_bTiDeacRednNTrbChrgUndDebRst "" UBYTE BATU_EcuIntgdSwGend_CM_boolean 0 0 0.0 1.0 ECU_ADDRESS 0x40004416 /* @ECU_Address@WM_bTiDeacRednNTrbChrgUndDebRst@ */ /end MEASUREMENT
/begin MEASUREMENT WM_bTiRednNTrbChrgUndDeb "" UBYTE BATU_EcuIntgdSwGend_CM_boolean 0 0 0.0 1.0 ECU_ADDRESS 0x40004417 /* @ECU_Address@WM_bTiRednNTrbChrgUndDeb@ */ /end MEASUREMENT
/begin MEASUREMENT WM_bTiRednNTrbChrgUndDebSet "" UBYTE BATU_EcuIntgdSwGend_CM_boolean 0 0 0.0 1.0 ECU_ADDRESS 0x40004418 /* @ECU_Address@WM_bTiRednNTrbChrgUndDebSet@ */ /end MEASUREMENT
/begin MEASUREMENT WM_bTiRednNTrbChrgUndDebSetOutp "" UBYTE BATU_EcuIntgdSwGend_CM_boolean 0 0 0.0 1.0 ECU_ADDRESS 0x40004419 /* @ECU_Address@WM_bTiRednNTrbChrgUndDebSetOutp@ */ /end MEASUREMENT
/begin MEASUREMENT WM_bTiNEngDeacRednNTrbChrgUndDeb "" UBYTE BATU_EcuIntgdSwGend_CM_boolean 0 0 0.0 1.0 ECU_ADDRESS 0x4000441A /* @ECU_Address@WM_bTiNEngDeacRednNTrbChrgUndDeb@ */ /end MEASUREMENT
/begin MEASUREMENT WM_bTiNEngAcvRednNTrbChrgUndRst "" UBYTE BATU_EcuIntgdSwGend_CM_boolean 0 0 0.0 1.0 ECU_ADDRESS 0x4000441B /* @ECU_Address@WM_bTiNEngAcvRednNTrbChrgUndRst@ */ /end MEASUREMENT
/begin MEASUREMENT WM_bTiNEngDeacRednNTrbChrgUndDebRst "" UBYTE BATU_EcuIntgdSwGend_CM_boolean 0 0 0.0 1.0 ECU_ADDRESS 0x4000441C /* @ECU_Address@WM_bTiNEngDeacRednNTrbChrgUndDebRst@ */ /end MEASUREMENT
/begin MEASUREMENT WM_bTiNEngAcvRednNTrbChrgUndDeb "" UBYTE BATU_EcuIntgdSwGend_CM_boolean 0 0 0.0 1.0 ECU_ADDRESS 0x4000441D /* @ECU_Address@WM_bTiNEngAcvRednNTrbChrgUndDeb@ */ /end MEASUREMENT
/begin MEASUREMENT WM_bTiNEngAcvRednNTrbChrgUndDebSet "" UBYTE BATU_EcuIntgdSwGend_CM_boolean 0 0 0.0 1.0 ECU_ADDRESS 0x4000441E /* @ECU_Address@WM_bTiNEngAcvRednNTrbChrgUndDebSet@ */ /end MEASUREMENT
/begin MEASUREMENT WM_bTiNEngAcvRednNTrbChrgUndDebSetOutp "" UBYTE BATU_EcuIntgdSwGend_CM_boolean 0 0 0.0 1.0 ECU_ADDRESS 0x4000441F /* @ECU_Address@WM_bTiNEngAcvRednNTrbChrgUndDebSetOutp@ */ /end MEASUREMENT
/begin MEASUREMENT WM_bStUsrNTrbChrgUndRedn "" UBYTE BATU_EcuIntgdSwGend_CM_boolean 0 0 0.0 1.0 ECU_ADDRESS 0x40004420 /* @ECU_Address@WM_bStUsrNTrbChrgUndRedn@ */ /end MEASUREMENT
/begin MEASUREMENT WM_bAcvNTrbChrgUndRedn "" UBYTE BATU_EcuIntgdSwGend_CM_boolean 0 0 0.0 1.0 ECU_ADDRESS 0x40004421 /* @ECU_Address@WM_bAcvNTrbChrgUndRedn@ */ /end MEASUREMENT
/begin MEASUREMENT WM_bTiDeacShtdwnNTrbChrgUndDeb "" UBYTE BATU_EcuIntgdSwGend_CM_boolean 0 0 0.0 1.0 ECU_ADDRESS 0x40004422 /* @ECU_Address@WM_bTiDeacShtdwnNTrbChrgUndDeb@ */ /end MEASUREMENT
/begin MEASUREMENT WM_bTiDeacShtdwnNTrbChrgUndDebRst "" UBYTE BATU_EcuIntgdSwGend_CM_boolean 0 0 0.0 1.0 ECU_ADDRESS 0x40004423 /* @ECU_Address@WM_bTiDeacShtdwnNTrbChrgUndDebRst@ */ /end MEASUREMENT
/begin MEASUREMENT WM_bTiShtdwnNTrbChrgUndDeb "" UBYTE BATU_EcuIntgdSwGend_CM_boolean 0 0 0.0 1.0 ECU_ADDRESS 0x40004424 /* @ECU_Address@WM_bTiShtdwnNTrbChrgUndDeb@ */ /end MEASUREMENT
/begin MEASUREMENT WM_bTiShtdwnNTrbChrgUndDebSet "" UBYTE BATU_EcuIntgdSwGend_CM_boolean 0 0 0.0 1.0 ECU_ADDRESS 0x40004425 /* @ECU_Address@WM_bTiShtdwnNTrbChrgUndDebSet@ */ /end MEASUREMENT
/begin MEASUREMENT WM_bTiShtdwnNTrbChrgUndDebSetOutp "" UBYTE BATU_EcuIntgdSwGend_CM_boolean 0 0 0.0 1.0 ECU_ADDRESS 0x40004426 /* @ECU_Address@WM_bTiShtdwnNTrbChrgUndDebSetOutp@ */ /end MEASUREMENT
/begin MEASUREMENT WM_bTiNEngDeacShtdwnNTrbChrgUndDeb "" UBYTE BATU_EcuIntgdSwGend_CM_boolean 0 0 0.0 1.0 ECU_ADDRESS 0x40004427 /* @ECU_Address@WM_bTiNEngDeacShtdwnNTrbChrgUndDeb@ */ /end MEASUREMENT
/begin MEASUREMENT WM_bTiNEngAcvShtdwnNTrbChrgUndRst "" UBYTE BATU_EcuIntgdSwGend_CM_boolean 0 0 0.0 1.0 ECU_ADDRESS 0x40004428 /* @ECU_Address@WM_bTiNEngAcvShtdwnNTrbChrgUndRst@ */ /end MEASUREMENT
/begin MEASUREMENT WM_bTiNEngDeacShtdwnNTrbChrgUndDebRst "" UBYTE BATU_EcuIntgdSwGend_CM_boolean 0 0 0.0 1.0 ECU_ADDRESS 0x40004429 /* @ECU_Address@WM_bTiNEngDeacShtdwnNTrbChrgUndDebRst@ */ /end MEASUREMENT
/begin MEASUREMENT WM_bTiNEngAcvShtdwnNTrbChrgUndDeb "" UBYTE BATU_EcuIntgdSwGend_CM_boolean 0 0 0.0 1.0 ECU_ADDRESS 0x4000442A /* @ECU_Address@WM_bTiNEngAcvShtdwnNTrbChrgUndDeb@ */ /end MEASUREMENT
/begin MEASUREMENT WM_bTiNEngAcvShtdwnNTrbChrgUndDebSet "" UBYTE BATU_EcuIntgdSwGend_CM_boolean 0 0 0.0 1.0 ECU_ADDRESS 0x4000442B /* @ECU_Address@WM_bTiNEngAcvShtdwnNTrbChrgUndDebSet@ */ /end MEASUREMENT
/begin MEASUREMENT WM_bTiNEngAcvShtdwnNTrbChrgUndDebSetOutp "" UBYTE BATU_EcuIntgdSwGend_CM_boolean 0 0 0.0 1.0 ECU_ADDRESS 0x4000442C /* @ECU_Address@WM_bTiNEngAcvShtdwnNTrbChrgUndDebSetOutp@ */ /end MEASUREMENT
/begin MEASUREMENT WM_bStUsrNTrbChrgUndShtdwn "" UBYTE BATU_EcuIntgdSwGend_CM_boolean 0 0 0.0 1.0 ECU_ADDRESS 0x4000442D /* @ECU_Address@WM_bStUsrNTrbChrgUndShtdwn@ */ /end MEASUREMENT
/begin MEASUREMENT WM_bAcvNTrbChrgUndShtdwn "" UBYTE BATU_EcuIntgdSwGend_CM_boolean 0 0 0.0 1.0 ECU_ADDRESS 0x4000442E /* @ECU_Address@WM_bAcvNTrbChrgUndShtdwn@ */ /end MEASUREMENT
/begin MEASUREMENT WM_bTiDeacWarnNTrbChrgUndUndDeb "" UBYTE BATU_EcuIntgdSwGend_CM_boolean 0 0 0.0 1.0 ECU_ADDRESS 0x4000442F /* @ECU_Address@WM_bTiDeacWarnNTrbChrgUndUndDeb@ */ /end MEASUREMENT
/begin MEASUREMENT WM_bTiDeacWarnNTrbChrgUndDebRst "" UBYTE BATU_EcuIntgdSwGend_CM_boolean 0 0 0.0 1.0 ECU_ADDRESS 0x40004430 /* @ECU_Address@WM_bTiDeacWarnNTrbChrgUndDebRst@ */ /end MEASUREMENT
/begin MEASUREMENT WM_bTiWarnNTrbChrgUndDeb "" UBYTE BATU_EcuIntgdSwGend_CM_boolean 0 0 0.0 1.0 ECU_ADDRESS 0x40004431 /* @ECU_Address@WM_bTiWarnNTrbChrgUndDeb@ */ /end MEASUREMENT
/begin MEASUREMENT WM_bTiWarnNTrbChrgUndDebSet "" UBYTE BATU_EcuIntgdSwGend_CM_boolean 0 0 0.0 1.0 ECU_ADDRESS 0x40004432 /* @ECU_Address@WM_bTiWarnNTrbChrgUndDebSet@ */ /end MEASUREMENT
/begin MEASUREMENT WM_bTiWarnNTrbChrgUndDebSetOutp "" UBYTE BATU_EcuIntgdSwGend_CM_boolean 0 0 0.0 1.0 ECU_ADDRESS 0x40004433 /* @ECU_Address@WM_bTiWarnNTrbChrgUndDebSetOutp@ */ /end MEASUREMENT
/begin MEASUREMENT WM_bTiNEngDeacWarnNTrbChrgUndDeb "" UBYTE BATU_EcuIntgdSwGend_CM_boolean 0 0 0.0 1.0 ECU_ADDRESS 0x40004434 /* @ECU_Address@WM_bTiNEngDeacWarnNTrbChrgUndDeb@ */ /end MEASUREMENT
/begin MEASUREMENT WM_bTiNEngAcvWarnNTrbChrgUndRst "" UBYTE BATU_EcuIntgdSwGend_CM_boolean 0 0 0.0 1.0 ECU_ADDRESS 0x40004435 /* @ECU_Address@WM_bTiNEngAcvWarnNTrbChrgUndRst@ */ /end MEASUREMENT
/begin MEASUREMENT WM_bTiNEngDeacWarnNTrbChrgUndDebRst "" UBYTE BATU_EcuIntgdSwGend_CM_boolean 0 0 0.0 1.0 ECU_ADDRESS 0x40004436 /* @ECU_Address@WM_bTiNEngDeacWarnNTrbChrgUndDebRst@ */ /end MEASUREMENT
/begin MEASUREMENT WM_bTiNEngAcvWarnNTrbChrgUndDeb "" UBYTE BATU_EcuIntgdSwGend_CM_boolean 0 0 0.0 1.0 ECU_ADDRESS 0x40004437 /* @ECU_Address@WM_bTiNEngAcvWarnNTrbChrgUndDeb@ */ /end MEASUREMENT
/begin MEASUREMENT WM_bTiNEngAcvWarnNTrbChrgUndDebSet "" UBYTE BATU_EcuIntgdSwGend_CM_boolean 0 0 0.0 1.0 ECU_ADDRESS 0x40004438 /* @ECU_Address@WM_bTiNEngAcvWarnNTrbChrgUndDebSet@ */ /end MEASUREMENT
/begin MEASUREMENT WM_bTiNEngAcvWarnNTrbChrgUndDebSetOutp "" UBYTE BATU_EcuIntgdSwGend_CM_boolean 0 0 0.0 1.0 ECU_ADDRESS 0x40004439 /* @ECU_Address@WM_bTiNEngAcvWarnNTrbChrgUndDebSetOutp@ */ /end MEASUREMENT
/begin MEASUREMENT WM_bStUsrNTrbChrgUndWarn "" UBYTE BATU_EcuIntgdSwGend_CM_boolean 0 0 0.0 1.0 ECU_ADDRESS 0x4000443A /* @ECU_Address@WM_bStUsrNTrbChrgUndWarn@ */ /end MEASUREMENT
/begin MEASUREMENT WM_bAcvNTrbChrgUndWarn "" UBYTE BATU_EcuIntgdSwGend_CM_boolean 0 0 0.0 1.0 ECU_ADDRESS 0x4000443B /* @ECU_Address@WM_bAcvNTrbChrgUndWarn@ */ /end MEASUREMENT
/begin MEASUREMENT WM_bInhEngStrtForSbmg "" UBYTE BATU_EcuIntgdSwGend_CM_boolean 0 0 0.0 1.0 ECU_ADDRESS 0x4000443C /* @ECU_Address@WM_bInhEngStrtForSbmg@ */ /end MEASUREMENT
/begin MEASUREMENT WM_bTiAcvnErrFmuADebOutp "" UBYTE BATU_EcuIntgdSwGend_CM_boolean 0 0 0.0 1.0 ECU_ADDRESS 0x4000443D /* @ECU_Address@WM_bTiAcvnErrFmuADebOutp@ */ /end MEASUREMENT
/begin MEASUREMENT WM_bTiAcvnErrFmuBDebOutp "" UBYTE BATU_EcuIntgdSwGend_CM_boolean 0 0 0.0 1.0 ECU_ADDRESS 0x4000443E /* @ECU_Address@WM_bTiAcvnErrFmuBDebOutp@ */ /end MEASUREMENT
/begin MEASUREMENT WM_bInhErrElectFailFmu "" UBYTE BATU_EcuIntgdSwGend_CM_boolean 0 0 0.0 1.0 ECU_ADDRESS 0x4000443F /* @ECU_Address@WM_bInhErrElectFailFmu@ */ /end MEASUREMENT
/begin MEASUREMENT WM_bTiAcvnErrPCVADebOutp "" UBYTE BATU_EcuIntgdSwGend_CM_boolean 0 0 0.0 1.0 ECU_ADDRESS 0x40004440 /* @ECU_Address@WM_bTiAcvnErrPCVADebOutp@ */ /end MEASUREMENT
/begin MEASUREMENT WM_bTiAcvnErrPCVBDebOutp "" UBYTE BATU_EcuIntgdSwGend_CM_boolean 0 0 0.0 1.0 ECU_ADDRESS 0x40004441 /* @ECU_Address@WM_bTiAcvnErrPCVBDebOutp@ */ /end MEASUREMENT
/begin MEASUREMENT WM_bInhErrElectFailPCV "" UBYTE BATU_EcuIntgdSwGend_CM_boolean 0 0 0.0 1.0 ECU_ADDRESS 0x40004442 /* @ECU_Address@WM_bInhErrElectFailPCV@ */ /end MEASUREMENT
/begin MEASUREMENT WM_bInhErrElectFailPreTest "" UBYTE BATU_EcuIntgdSwGend_CM_boolean 0 0 0.0 1.0 ECU_ADDRESS 0x40004443 /* @ECU_Address@WM_bInhErrElectFailPreTest@ */ /end MEASUREMENT
/begin MEASUREMENT WM_bTiAcvnLvlCooltDeb "" UBYTE BATU_EcuIntgdSwGend_CM_boolean 0 0 0.0 1.0 ECU_ADDRESS 0x40004444 /* @ECU_Address@WM_bTiAcvnLvlCooltDeb@ */ /end MEASUREMENT
/begin MEASUREMENT WM_bTiAcvnLvlCooltDebOutp "" UBYTE BATU_EcuIntgdSwGend_CM_boolean 0 0 0.0 1.0 ECU_ADDRESS 0x40004445 /* @ECU_Address@WM_bTiAcvnLvlCooltDebOutp@ */ /end MEASUREMENT
/begin MEASUREMENT WM_bTiAcvnLvlFuDeb "" UBYTE BATU_EcuIntgdSwGend_CM_boolean 0 0 0.0 1.0 ECU_ADDRESS 0x40004446 /* @ECU_Address@WM_bTiAcvnLvlFuDeb@ */ /end MEASUREMENT
/begin MEASUREMENT WM_bTiAcvnLvlFuDebOutp "" UBYTE BATU_EcuIntgdSwGend_CM_boolean 0 0 0.0 1.0 ECU_ADDRESS 0x40004447 /* @ECU_Address@WM_bTiAcvnLvlFuDebOutp@ */ /end MEASUREMENT
/begin MEASUREMENT WM_bTiAcvnLvlOilDeb "" UBYTE BATU_EcuIntgdSwGend_CM_boolean 0 0 0.0 1.0 ECU_ADDRESS 0x40004448 /* @ECU_Address@WM_bTiAcvnLvlOilDeb@ */ /end MEASUREMENT
/begin MEASUREMENT WM_bTiAcvnLvlOilDebOutp "" UBYTE BATU_EcuIntgdSwGend_CM_boolean 0 0 0.0 1.0 ECU_ADDRESS 0x40004449 /* @ECU_Address@WM_bTiAcvnLvlOilDebOutp@ */ /end MEASUREMENT
/begin MEASUREMENT WM_bInhEngStrtPreTest "" UBYTE BATU_EcuIntgdSwGend_CM_boolean 0 0 0.0 1.0 ECU_ADDRESS 0x4000444A /* @ECU_Address@WM_bInhEngStrtPreTest@ */ /end MEASUREMENT
/begin MEASUREMENT WM_bInhEngStrt "" UBYTE BATU_EcuIntgdSwGend_CM_boolean 0 0 0.0 1.0 ECU_ADDRESS 0x4000444B /* @ECU_Address@WM_bInhEngStrt@ */ /end MEASUREMENT
/begin MEASUREMENT TL_bEnaTmrNEngAcvForTCooltHi "Timer Enable Condition for Coolant High Temperature Limit Activation" UBYTE BATU_EcuIntgdSwGend_CM_boolean 0 0 0.0 1.0 ECU_ADDRESS 0x4000444C /* @ECU_Address@TL_bEnaTmrNEngAcvForTCooltHi@ */ /end MEASUREMENT
/begin MEASUREMENT TL_bComplDebNEngAcvForTCooltHi "Engine Dependent Activation Timer Out for Exhaust Left Temperature" UBYTE BATU_EcuIntgdSwGend_CM_boolean 0 0 0.0 1.0 ECU_ADDRESS 0x4000444D /* @ECU_Address@TL_bComplDebNEngAcvForTCooltHi@ */ /end MEASUREMENT
/begin MEASUREMENT TL_bEnaTmrNEngAcvForTFu "Timer Enable Condition for Fuel Temperature Limit Activation" UBYTE BATU_EcuIntgdSwGend_CM_boolean 0 0 0.0 1.0 ECU_ADDRESS 0x4000444E /* @ECU_Address@TL_bEnaTmrNEngAcvForTFu@ */ /end MEASUREMENT
/begin MEASUREMENT TL_bComplDebNEngAcvForTFu "Engine Dependent Activation Timer Out for Compressor Inlet Temperature" UBYTE BATU_EcuIntgdSwGend_CM_boolean 0 0 0.0 1.0 ECU_ADDRESS 0x4000444F /* @ECU_Address@TL_bComplDebNEngAcvForTFu@ */ /end MEASUREMENT
/begin MEASUREMENT TL_bEnaTmrNEngAcvForNExhTrbChrg "Timer Enable Condition for Turbo Charger Limit Activation" UBYTE BATU_EcuIntgdSwGend_CM_boolean 0 0 0.0 1.0 ECU_ADDRESS 0x40004450 /* @ECU_Address@TL_bEnaTmrNEngAcvForNExhTrbChrg@ */ /end MEASUREMENT
/begin MEASUREMENT TL_bComplDebNEngAcvForNExhTrbChrg "Engine Dependent Activation Timer Out for Turbo Charger Speed" UBYTE BATU_EcuIntgdSwGend_CM_boolean 0 0 0.0 1.0 ECU_ADDRESS 0x40004451 /* @ECU_Address@TL_bComplDebNEngAcvForNExhTrbChrg@ */ /end MEASUREMENT
/begin MEASUREMENT TL_bEnaTmrNEngAcvForPAirBoost "Timer Enable Condition for Air Boost Pressure Limit Activation" UBYTE BATU_EcuIntgdSwGend_CM_boolean 0 0 0.0 1.0 ECU_ADDRESS 0x40004452 /* @ECU_Address@TL_bEnaTmrNEngAcvForPAirBoost@ */ /end MEASUREMENT
/begin MEASUREMENT TL_bComplDebNEngAcvForPAirBoost "Engine Dependent Activation Timer Out for Air Boost Pressure" UBYTE BATU_EcuIntgdSwGend_CM_boolean 0 0 0.0 1.0 ECU_ADDRESS 0x40004453 /* @ECU_Address@TL_bComplDebNEngAcvForPAirBoost@ */ /end MEASUREMENT
/begin MEASUREMENT TL_bEnaTmrNEngAcvForTAirBoost "Timer Enable Condition for Air Boost Temperature Limit Activation" UBYTE BATU_EcuIntgdSwGend_CM_boolean 0 0 0.0 1.0 ECU_ADDRESS 0x40004454 /* @ECU_Address@TL_bEnaTmrNEngAcvForTAirBoost@ */ /end MEASUREMENT
/begin MEASUREMENT TL_bComplDebNEngAcvForTAirBoost "Engine Dependent Activation Timer Out for Air Boost Temperature" UBYTE BATU_EcuIntgdSwGend_CM_boolean 0 0 0.0 1.0 ECU_ADDRESS 0x40004455 /* @ECU_Address@TL_bComplDebNEngAcvForTAirBoost@ */ /end MEASUREMENT
/begin MEASUREMENT TL_bEnaTmrNEngAcvForTInltCmpr "Timer Enable Condition for Compressor Inlet Temperature Limit Activation" UBYTE BATU_EcuIntgdSwGend_CM_boolean 0 0 0.0 1.0 ECU_ADDRESS 0x40004456 /* @ECU_Address@TL_bEnaTmrNEngAcvForTInltCmpr@ */ /end MEASUREMENT
/begin MEASUREMENT TL_bComplDebNEngAcvForTInltCmpr "Engine Dependent Activation Timer Out for Oil Temperature" UBYTE BATU_EcuIntgdSwGend_CM_boolean 0 0 0.0 1.0 ECU_ADDRESS 0x40004457 /* @ECU_Address@TL_bComplDebNEngAcvForTInltCmpr@ */ /end MEASUREMENT
/begin MEASUREMENT TL_bEnaTmrNEngAcvForPAirAmb "Timer Enable Condition for Ambient Pressure Limit Activation" UBYTE BATU_EcuIntgdSwGend_CM_boolean 0 0 0.0 1.0 ECU_ADDRESS 0x40004458 /* @ECU_Address@TL_bEnaTmrNEngAcvForPAirAmb@ */ /end MEASUREMENT
/begin MEASUREMENT TL_bComplDebNEngAcvForPAirAmb "Engine Dependent Activation Timer Out for Ambient Air Pressure" UBYTE BATU_EcuIntgdSwGend_CM_boolean 0 0 0.0 1.0 ECU_ADDRESS 0x40004459 /* @ECU_Address@TL_bComplDebNEngAcvForPAirAmb@ */ /end MEASUREMENT
/begin MEASUREMENT TL_bEnaTmrNEngAcvForTOil "Timer Enable Condition for Oil Temperature Limit Activation" UBYTE BATU_EcuIntgdSwGend_CM_boolean 0 0 0.0 1.0 ECU_ADDRESS 0x4000445A /* @ECU_Address@TL_bEnaTmrNEngAcvForTOil@ */ /end MEASUREMENT
/begin MEASUREMENT TL_bComplDebNEngAcvForTOil "Engine Speed Dependent Activation Timer Out for Battery Voltage" UBYTE BATU_EcuIntgdSwGend_CM_boolean 0 0 0.0 1.0 ECU_ADDRESS 0x4000445B /* @ECU_Address@TL_bComplDebNEngAcvForTOil@ */ /end MEASUREMENT
/begin MEASUREMENT TL_bEnaTmrNEngAcvForMAirFlow "Timer Enable Condition for Mass Air Flow Limit Activation" UBYTE BATU_EcuIntgdSwGend_CM_boolean 0 0 0.0 1.0 ECU_ADDRESS 0x4000445C /* @ECU_Address@TL_bEnaTmrNEngAcvForMAirFlow@ */ /end MEASUREMENT
/begin MEASUREMENT TL_bComplDebNEngAcvForMAirFlow "Engine Dependent Activation Timer Out for Mass Air Flow" UBYTE BATU_EcuIntgdSwGend_CM_boolean 0 0 0.0 1.0 ECU_ADDRESS 0x4000445D /* @ECU_Address@TL_bComplDebNEngAcvForMAirFlow@ */ /end MEASUREMENT
/begin MEASUREMENT TL_bEnaTmrNEngAcvForTCmprOutlt "Timer Enable Condition for Compressor Outlet Temperature Limit Activation" UBYTE BATU_EcuIntgdSwGend_CM_boolean 0 0 0.0 1.0 ECU_ADDRESS 0x4000445E /* @ECU_Address@TL_bEnaTmrNEngAcvForTCmprOutlt@ */ /end MEASUREMENT
/begin MEASUREMENT TL_bComplDebNEngAcvForTCmprOutlt "Engine Dependent Activation Timer Out for Coolant High Temperature" UBYTE BATU_EcuIntgdSwGend_CM_boolean 0 0 0.0 1.0 ECU_ADDRESS 0x4000445F /* @ECU_Address@TL_bComplDebNEngAcvForTCmprOutlt@ */ /end MEASUREMENT
/begin MEASUREMENT TL_bEnaTmrNEngAcvForTExhRi "Timer Enable Condition for Exhaust Right Temperature Limit Activation" UBYTE BATU_EcuIntgdSwGend_CM_boolean 0 0 0.0 1.0 ECU_ADDRESS 0x40004460 /* @ECU_Address@TL_bEnaTmrNEngAcvForTExhRi@ */ /end MEASUREMENT
/begin MEASUREMENT TL_bComplDebNEngAcvForTExhRi "Engine Dependent Activation Timer Out for Fuel Temperature" UBYTE BATU_EcuIntgdSwGend_CM_boolean 0 0 0.0 1.0 ECU_ADDRESS 0x40004461 /* @ECU_Address@TL_bComplDebNEngAcvForTExhRi@ */ /end MEASUREMENT
/begin MEASUREMENT TL_bEnaTmrNEngAcvForTExhLe "Timer Enable Condition for Exhaust Left Temperature Limit Activation" UBYTE BATU_EcuIntgdSwGend_CM_boolean 0 0 0.0 1.0 ECU_ADDRESS 0x40004462 /* @ECU_Address@TL_bEnaTmrNEngAcvForTExhLe@ */ /end MEASUREMENT
/begin MEASUREMENT TL_bComplDebNEngAcvForTExhLe "Engine Dependent Activation Timer Out for Exhaust Right Temperature" UBYTE BATU_EcuIntgdSwGend_CM_boolean 0 0 0.0 1.0 ECU_ADDRESS 0x40004463 /* @ECU_Address@TL_bComplDebNEngAcvForTExhLe@ */ /end MEASUREMENT
/begin MEASUREMENT TL_bEnaTmrNEngAcvForTAmbAir "Timer Enable Condition for Ambient Air Temperature Limit Activation" UBYTE BATU_EcuIntgdSwGend_CM_boolean 0 0 0.0 1.0 ECU_ADDRESS 0x40004464 /* @ECU_Address@TL_bEnaTmrNEngAcvForTAmbAir@ */ /end MEASUREMENT
/begin MEASUREMENT TL_bComplDebNEngAcvForTAmbAir "Engine Dependent Activation Timer Out for Compressor Outlet Temperature" UBYTE BATU_EcuIntgdSwGend_CM_boolean 0 0 0.0 1.0 ECU_ADDRESS 0x40004465 /* @ECU_Address@TL_bComplDebNEngAcvForTAmbAir@ */ /end MEASUREMENT
/begin MEASUREMENT TL_bEnaTmrNEngAcvForUBatt "Timer Enable Condition for Battery Voltage Limit Activation" UBYTE BATU_EcuIntgdSwGend_CM_boolean 0 0 0.0 1.0 ECU_ADDRESS 0x40004466 /* @ECU_Address@TL_bEnaTmrNEngAcvForUBatt@ */ /end MEASUREMENT
/begin MEASUREMENT TL_bComplDebNEngAcvForUBatt "Engine Speed Dependent Deactivation Timer Out for Air Filter Clogging" UBYTE BATU_EcuIntgdSwGend_CM_boolean 0 0 0.0 1.0 ECU_ADDRESS 0x40004467 /* @ECU_Address@TL_bComplDebNEngAcvForUBatt@ */ /end MEASUREMENT
/begin MEASUREMENT TL_bEnaTmrNEngAcvForPwrSply "Timer Enable Condition for Battery Voltage Limit Activation" UBYTE BATU_EcuIntgdSwGend_CM_boolean 0 0 0.0 1.0 ECU_ADDRESS 0x40004468 /* @ECU_Address@TL_bEnaTmrNEngAcvForPwrSply@ */ /end MEASUREMENT
/begin MEASUREMENT TL_bComplDebNEngAcvForPwrSply "Battery Voltage Dependent Activation Timer Out for Battery Voltage" UBYTE BATU_EcuIntgdSwGend_CM_boolean 0 0 0.0 1.0 ECU_ADDRESS 0x40004469 /* @ECU_Address@TL_bComplDebNEngAcvForPwrSply@ */ /end MEASUREMENT
/begin MEASUREMENT TL_bEnaTmrNEngAcvForAirFilClgg "Timer Enable Condition for Air Filter Clogging Limit Activation" UBYTE BATU_EcuIntgdSwGend_CM_boolean 0 0 0.0 1.0 ECU_ADDRESS 0x4000446A /* @ECU_Address@TL_bEnaTmrNEngAcvForAirFilClgg@ */ /end MEASUREMENT
/begin MEASUREMENT TL_bComplDebNEngAcvForAirFilClgg "Engine Dependent Activation Timer Out for Air Filter Clogging" UBYTE BATU_EcuIntgdSwGend_CM_boolean 0 0 0.0 1.0 ECU_ADDRESS 0x4000446B /* @ECU_Address@TL_bComplDebNEngAcvForAirFilClgg@ */ /end MEASUREMENT
/begin MEASUREMENT TL_bAcvTqLimnForAirFilClgg "Torque Limitation Active Signal for Air Filter Clogging" UBYTE BATU_EcuIntgdSwGend_CM_boolean 0 0 0.0 1.0 ECU_ADDRESS 0x4000446C /* @ECU_Address@TL_bAcvTqLimnForAirFilClgg@ */ /end MEASUREMENT
/begin MEASUREMENT TL_bEnaTmrNEngAcvForFineAirFilClgg "" UBYTE BATU_EcuIntgdSwGend_CM_boolean 0 0 0.0 1.0 ECU_ADDRESS 0x4000446D /* @ECU_Address@TL_bEnaTmrNEngAcvForFineAirFilClgg@ */ /end MEASUREMENT
/begin MEASUREMENT TL_bComplDebNEngAcvForFineAirFilClgg "" UBYTE BATU_EcuIntgdSwGend_CM_boolean 0 0 0.0 1.0 ECU_ADDRESS 0x4000446E /* @ECU_Address@TL_bComplDebNEngAcvForFineAirFilClgg@ */ /end MEASUREMENT
/begin MEASUREMENT TL_bAcvTqLimnForFineAirFilClgg "" UBYTE BATU_EcuIntgdSwGend_CM_boolean 0 0 0.0 1.0 ECU_ADDRESS 0x4000446F /* @ECU_Address@TL_bAcvTqLimnForFineAirFilClgg@ */ /end MEASUREMENT
/begin MEASUREMENT TrC_CdnSmokeLim "Smoke Limitation Condition Signal" UBYTE BATU_EcuIntgdSwGend_CM_boolean 0 0 0.0 1.0 ECU_ADDRESS 0x40004470 /* @ECU_Address@TrC_CdnSmokeLim@ */ /end MEASUREMENT
/begin MEASUREMENT SC_bAcvStrtr "Starter is Active Flag" UBYTE BATU_EcuIntgdSwGend_CM_boolean 0 0 0.0 1.0 ECU_ADDRESS 0x40004471 /* @ECU_Address@SC_bAcvStrtr@ */ /end MEASUREMENT
/begin MEASUREMENT SC_bRunUpSpdLoCompTi "" UBYTE BATU_EcuIntgdSwGend_CM_boolean 0 0 0.0 1.0 ECU_ADDRESS 0x40004472 /* @ECU_Address@SC_bRunUpSpdLoCompTi@ */ /end MEASUREMENT
/begin MEASUREMENT SC_bEnaStrtSpdLo "Start Speed Low Enable" UBYTE BATU_EcuIntgdSwGend_CM_boolean 0 0 0.0 1.0 ECU_ADDRESS 0x40004473 /* @ECU_Address@SC_bEnaStrtSpdLo@ */ /end MEASUREMENT
/begin MEASUREMENT SC_bAcvStrtOvrHeatProtn "Starter OverHeat Protection" UBYTE BATU_EcuIntgdSwGend_CM_boolean 0 0 0.0 1.0 ECU_ADDRESS 0x40004474 /* @ECU_Address@SC_bAcvStrtOvrHeatProtn@ */ /end MEASUREMENT
/begin MEASUREMENT SC_bEnaOutPinionNotEngd "Timer Enable Out Pinion Not Engaged" UBYTE BATU_EcuIntgdSwGend_CM_boolean 0 0 0.0 1.0 ECU_ADDRESS 0x40004475 /* @ECU_Address@SC_bEnaOutPinionNotEngd@ */ /end MEASUREMENT
/begin MEASUREMENT SC_bPinionNotEngdStrtAtmp "Pinion Not Engaged Starter Attempt" UBYTE BATU_EcuIntgdSwGend_CM_boolean 0 0 0.0 1.0 ECU_ADDRESS 0x40004476 /* @ECU_Address@SC_bPinionNotEngdStrtAtmp@ */ /end MEASUREMENT
/begin MEASUREMENT SC_bPinionNotEngdAtmp "Pinion Not Engaged Starter Attempt" UBYTE BATU_EcuIntgdSwGend_CM_boolean 0 0 0.0 1.0 ECU_ADDRESS 0x40004477 /* @ECU_Address@SC_bPinionNotEngdAtmp@ */ /end MEASUREMENT
/begin MEASUREMENT SC_bAcvStrtrPinionNotEngd "Starter Pinion is Not Engaged Active Flag" UBYTE BATU_EcuIntgdSwGend_CM_boolean 0 0 0.0 1.0 ECU_ADDRESS 0x40004478 /* @ECU_Address@SC_bAcvStrtrPinionNotEngd@ */ /end MEASUREMENT
/begin MEASUREMENT SC_bEnaOutStrtSpdLo "Timer Enable Out Start Speed Low" UBYTE BATU_EcuIntgdSwGend_CM_boolean 0 0 0.0 1.0 ECU_ADDRESS 0x40004479 /* @ECU_Address@SC_bEnaOutStrtSpdLo@ */ /end MEASUREMENT
/begin MEASUREMENT SC_bStrtSpdLoStrtAtmp "Start Speed Low Starter Attempt" UBYTE BATU_EcuIntgdSwGend_CM_boolean 0 0 0.0 1.0 ECU_ADDRESS 0x4000447A /* @ECU_Address@SC_bStrtSpdLoStrtAtmp@ */ /end MEASUREMENT
/begin MEASUREMENT SC_bStrtSpdLoAtmp "Star Speed Low Attempt" UBYTE BATU_EcuIntgdSwGend_CM_boolean 0 0 0.0 1.0 ECU_ADDRESS 0x4000447B /* @ECU_Address@SC_bStrtSpdLoAtmp@ */ /end MEASUREMENT
/begin MEASUREMENT SC_bAcvPinEngdStrtSpdLo "Pinion Engaged Start Speed Low Activation" UBYTE BATU_EcuIntgdSwGend_CM_boolean 0 0 0.0 1.0 ECU_ADDRESS 0x4000447C /* @ECU_Address@SC_bAcvPinEngdStrtSpdLo@ */ /end MEASUREMENT
/begin MEASUREMENT SC_bEnaOutRunUpSpdLo "Timer Enable Out Run Up Speed Low" UBYTE BATU_EcuIntgdSwGend_CM_boolean 0 0 0.0 1.0 ECU_ADDRESS 0x4000447D /* @ECU_Address@SC_bEnaOutRunUpSpdLo@ */ /end MEASUREMENT
/begin MEASUREMENT SC_bRunUpSpdLoStrtAtmp "Run Up Speed Low Starter Attempt" UBYTE BATU_EcuIntgdSwGend_CM_boolean 0 0 0.0 1.0 ECU_ADDRESS 0x4000447E /* @ECU_Address@SC_bRunUpSpdLoStrtAtmp@ */ /end MEASUREMENT
/begin MEASUREMENT SC_bRunUpSpdLoAtmp "Run Up Speed Low Attempt" UBYTE BATU_EcuIntgdSwGend_CM_boolean 0 0 0.0 1.0 ECU_ADDRESS 0x4000447F /* @ECU_Address@SC_bRunUpSpdLoAtmp@ */ /end MEASUREMENT
/begin MEASUREMENT SC_bAcvPinEngdRunUpSpdLo "Pinion Engaged Run Up Speed Low Activation" UBYTE BATU_EcuIntgdSwGend_CM_boolean 0 0 0.0 1.0 ECU_ADDRESS 0x40004480 /* @ECU_Address@SC_bAcvPinEngdRunUpSpdLo@ */ /end MEASUREMENT
/begin MEASUREMENT SC_bAcvDisStrt "Starter is Disabled Flag" UBYTE BATU_EcuIntgdSwGend_CM_boolean 0 0 0.0 1.0 ECU_ADDRESS 0x40004481 /* @ECU_Address@SC_bAcvDisStrt@ */ /end MEASUREMENT
/begin MEASUREMENT SC_NEngRunDeacThd "Debouncer Activation for Deactivation Running Engine Speed Threshold Value" UBYTE BATU_EcuIntgdSwGend_CM_boolean 0 0 0.0 1.0 ECU_ADDRESS 0x40004482 /* @ECU_Address@SC_NEngRunDeacThd@ */ /end MEASUREMENT
/begin MEASUREMENT SC_bNEngRunDeacThd "Debouncer Flag for Deactivation Engine Speed Threshold" UBYTE BATU_EcuIntgdSwGend_CM_boolean 0 0 0.0 1.0 ECU_ADDRESS 0x40004483 /* @ECU_Address@SC_bNEngRunDeacThd@ */ /end MEASUREMENT
/begin MEASUREMENT SC_NEngStrtrInhThd "Debouncer Activation for Start Inhibition Engine Speed Threshold" UBYTE BATU_EcuIntgdSwGend_CM_boolean 0 0 0.0 1.0 ECU_ADDRESS 0x40004484 /* @ECU_Address@SC_NEngStrtrInhThd@ */ /end MEASUREMENT
/begin MEASUREMENT SC_bNEngStrtrInhThd "Debouncer Flag for Start Inhibition Engine Speed Threshold" UBYTE BATU_EcuIntgdSwGend_CM_boolean 0 0 0.0 1.0 ECU_ADDRESS 0x40004485 /* @ECU_Address@SC_bNEngStrtrInhThd@ */ /end MEASUREMENT
/begin MEASUREMENT SC_bAcvEngRunng "Engine is Running Flag" UBYTE BATU_EcuIntgdSwGend_CM_boolean 0 0 0.0 1.0 ECU_ADDRESS 0x40004486 /* @ECU_Address@SC_bAcvEngRunng@ */ /end MEASUREMENT
/begin MEASUREMENT SC_bAcvStrtrLock "Starter Locking is Active Flag" UBYTE BATU_EcuIntgdSwGend_CM_boolean 0 0 0.0 1.0 ECU_ADDRESS 0x40004487 /* @ECU_Address@SC_bAcvStrtrLock@ */ /end MEASUREMENT
/begin MEASUREMENT SC_EnaAcvnStrtr "Enable Starter Activation" UBYTE BATU_EcuIntgdSwGend_CM_boolean 0 0 0.0 1.0 ECU_ADDRESS 0x40004488 /* @ECU_Address@SC_EnaAcvnStrtr@ */ /end MEASUREMENT
/begin MEASUREMENT SC_bEnaAcvnStrtr "Enable Starter Activation" UBYTE BATU_EcuIntgdSwGend_CM_boolean 0 0 0.0 1.0 ECU_ADDRESS 0x40004489 /* @ECU_Address@SC_bEnaAcvnStrtr@ */ /end MEASUREMENT
/begin MEASUREMENT SC_bEnaAcvnStrtrTiEna "" UBYTE BATU_EcuIntgdSwGend_CM_boolean 0 0 0.0 1.0 ECU_ADDRESS 0x4000448A /* @ECU_Address@SC_bEnaAcvnStrtrTiEna@ */ /end MEASUREMENT
/begin MEASUREMENT SC_bAcvDDPinEngdRunUpSpdLo "" UBYTE BATU_EcuIntgdSwGend_CM_boolean 0 0 0.0 1.0 ECU_ADDRESS 0x4000448B /* @ECU_Address@SC_bAcvDDPinEngdRunUpSpdLo@ */ /end MEASUREMENT
/begin MEASUREMENT SC_bAcvDDStrtrNotTurn "" UBYTE BATU_EcuIntgdSwGend_CM_boolean 0 0 0.0 1.0 ECU_ADDRESS 0x4000448C /* @ECU_Address@SC_bAcvDDStrtrNotTurn@ */ /end MEASUREMENT
/begin MEASUREMENT SC_bAcvEngAlrdyRunng "Engine is Already Running Flag" UBYTE BATU_EcuIntgdSwGend_CM_boolean 0 0 0.0 1.0 ECU_ADDRESS 0x4000448D /* @ECU_Address@SC_bAcvEngAlrdyRunng@ */ /end MEASUREMENT
/begin MEASUREMENT SC_bAcvPinionEngd "Pinion Engaged" UBYTE BATU_EcuIntgdSwGend_CM_boolean 0 0 0.0 1.0 ECU_ADDRESS 0x4000448E /* @ECU_Address@SC_bAcvPinionEngd@ */ /end MEASUREMENT
/begin MEASUREMENT SC_bAcvDDPinionNotEngd "" UBYTE BATU_EcuIntgdSwGend_CM_boolean 0 0 0.0 1.0 ECU_ADDRESS 0x4000448F /* @ECU_Address@SC_bAcvDDPinionNotEngd@ */ /end MEASUREMENT
/begin MEASUREMENT SC_bStrtSpdLoCheck "Start Speed Low Check" UBYTE BATU_EcuIntgdSwGend_CM_boolean 0 0 0.0 1.0 ECU_ADDRESS 0x40004490 /* @ECU_Address@SC_bStrtSpdLoCheck@ */ /end MEASUREMENT
/begin MEASUREMENT SC_bStrtSpdLoTiEna "Start Speed Low Timer Enable" UBYTE BATU_EcuIntgdSwGend_CM_boolean 0 0 0.0 1.0 ECU_ADDRESS 0x40004491 /* @ECU_Address@SC_bStrtSpdLoTiEna@ */ /end MEASUREMENT
/begin MEASUREMENT SC_bStrtSpdLoCompTiRst "Start Speed Low Comp Reset Timer" UBYTE BATU_EcuIntgdSwGend_CM_boolean 0 0 0.0 1.0 ECU_ADDRESS 0x40004492 /* @ECU_Address@SC_bStrtSpdLoCompTiRst@ */ /end MEASUREMENT
/begin MEASUREMENT SC_bNEngRunUpSpdLo "Run Speed Low Engine Speed Dependent Activation" UBYTE BATU_EcuIntgdSwGend_CM_boolean 0 0 0.0 1.0 ECU_ADDRESS 0x40004493 /* @ECU_Address@SC_bNEngRunUpSpdLo@ */ /end MEASUREMENT
/begin MEASUREMENT SC_bEnaRunUpSpdLo "Run Up Speed Low Enable" UBYTE BATU_EcuIntgdSwGend_CM_boolean 0 0 0.0 1.0 ECU_ADDRESS 0x40004494 /* @ECU_Address@SC_bEnaRunUpSpdLo@ */ /end MEASUREMENT
/begin MEASUREMENT SC_bRunUpSpdLoTiEna "Run Up Speed Low Timer Enable" UBYTE BATU_EcuIntgdSwGend_CM_boolean 0 0 0.0 1.0 ECU_ADDRESS 0x40004495 /* @ECU_Address@SC_bRunUpSpdLoTiEna@ */ /end MEASUREMENT
/begin MEASUREMENT SC_bRunUpSpdLoCompTiRst "Run Up Speed Low Comp Reset Timer Flag" UBYTE BATU_EcuIntgdSwGend_CM_boolean 0 0 0.0 1.0 ECU_ADDRESS 0x40004496 /* @ECU_Address@SC_bRunUpSpdLoCompTiRst@ */ /end MEASUREMENT
/begin MEASUREMENT SC_bEnaPinionNotEngd "Pinion Not Engaged Enable" UBYTE BATU_EcuIntgdSwGend_CM_boolean 0 0 0.0 1.0 ECU_ADDRESS 0x40004497 /* @ECU_Address@SC_bEnaPinionNotEngd@ */ /end MEASUREMENT
/begin MEASUREMENT SC_bAcvPinionNotEngd "Pinion Not Engaged" UBYTE BATU_EcuIntgdSwGend_CM_boolean 0 0 0.0 1.0 ECU_ADDRESS 0x40004498 /* @ECU_Address@SC_bAcvPinionNotEngd@ */ /end MEASUREMENT
/begin MEASUREMENT SC_bAcvPinionNotEngdTiEna "Timer Elapsed Time Threshold Active Flag for Pinion is Not Engaged" UBYTE BATU_EcuIntgdSwGend_CM_boolean 0 0 0.0 1.0 ECU_ADDRESS 0x40004499 /* @ECU_Address@SC_bAcvPinionNotEngdTiEna@ */ /end MEASUREMENT
/begin MEASUREMENT SC_bPinionNotEngdCheck "Pinion Not Engaged Check" UBYTE BATU_EcuIntgdSwGend_CM_boolean 0 0 0.0 1.0 ECU_ADDRESS 0x4000449A /* @ECU_Address@SC_bPinionNotEngdCheck@ */ /end MEASUREMENT
/begin MEASUREMENT SC_bPinionNotEngdCompTiRst "Pinion Not Engaged Comp Reset Timer Flag" UBYTE BATU_EcuIntgdSwGend_CM_boolean 0 0 0.0 1.0 ECU_ADDRESS 0x4000449B /* @ECU_Address@SC_bPinionNotEngdCompTiRst@ */ /end MEASUREMENT
/begin MEASUREMENT SC_NEngAcvStrtLock "Debouncer Activation for Starter Locking Engine Speed Threshold" UBYTE BATU_EcuIntgdSwGend_CM_boolean 0 0 0.0 1.0 ECU_ADDRESS 0x4000449C /* @ECU_Address@SC_NEngAcvStrtLock@ */ /end MEASUREMENT
/begin MEASUREMENT SC_bComplDebNEngStrtLock "Debouncer Flag for Starter Locking" UBYTE BATU_EcuIntgdSwGend_CM_boolean 0 0 0.0 1.0 ECU_ADDRESS 0x4000449D /* @ECU_Address@SC_bComplDebNEngStrtLock@ */ /end MEASUREMENT
/begin MEASUREMENT RPG_bNEngThdAcvnPRail "Debouncer Activation for Rail Pressure Correction Activation wrt Comparision with Engine Speed" UBYTE BATU_EcuIntgdSwGend_CM_boolean 0 0 0.0 1.0 ECU_ADDRESS 0x4000449E /* @ECU_Address@RPG_bNEngThdAcvnPRail@ */ /end MEASUREMENT
/begin MEASUREMENT RPG_bCompNEngThdAcvnPRail "Debouncer Flag for Rail Pressure Correction Activation wrt Comparision with Engine Speed" UBYTE BATU_EcuIntgdSwGend_CM_boolean 0 0 0.0 1.0 ECU_ADDRESS 0x4000449F /* @ECU_Address@RPG_bCompNEngThdAcvnPRail@ */ /end MEASUREMENT
/begin MEASUREMENT RPG_bCoeffKiRst "" UBYTE BATU_EcuIntgdSwGend_CM_boolean 0 0 0.0 1.0 ECU_ADDRESS 0x400044A0 /* @ECU_Address@RPG_bCoeffKiRst@ */ /end MEASUREMENT
/begin MEASUREMENT PHC_bGridHeatrFault "Grid Heater Fault" UBYTE BATU_EcuIntgdSwGend_CM_boolean 0 0 0.0 1.0 ECU_ADDRESS 0x400044A1 /* @ECU_Address@PHC_bGridHeatrFault@ */ /end MEASUREMENT
/begin MEASUREMENT PHC_bAcvPreAcvnGridHeatr "Grid Heater is Active Flag Before Starter" UBYTE BATU_EcuIntgdSwGend_CM_boolean 0 0 0.0 1.0 ECU_ADDRESS 0x400044A2 /* @ECU_Address@PHC_bAcvPreAcvnGridHeatr@ */ /end MEASUREMENT
/begin MEASUREMENT PHC_bAcvPostAcvnGridHeatr "Grid Heater Activation with After Starter" UBYTE BATU_EcuIntgdSwGend_CM_boolean 0 0 0.0 1.0 ECU_ADDRESS 0x400044A3 /* @ECU_Address@PHC_bAcvPostAcvnGridHeatr@ */ /end MEASUREMENT
/begin MEASUREMENT PHC_bAcvGridHeatr "Grid Heater is Active Flag " UBYTE BATU_EcuIntgdSwGend_CM_boolean 0 0 0.0 1.0 ECU_ADDRESS 0x400044A4 /* @ECU_Address@PHC_bAcvGridHeatr@ */ /end MEASUREMENT
/begin MEASUREMENT PHC_bErrAcvGridHeatrOffSts "" UBYTE BATU_EcuIntgdSwGend_CM_boolean 0 0 0.0 1.0 ECU_ADDRESS 0x400044A5 /* @ECU_Address@PHC_bErrAcvGridHeatrOffSts@ */ /end MEASUREMENT
/begin MEASUREMENT PHC_bErrAcvGridHeatrOnSts "" UBYTE BATU_EcuIntgdSwGend_CM_boolean 0 0 0.0 1.0 ECU_ADDRESS 0x400044A6 /* @ECU_Address@PHC_bErrAcvGridHeatrOnSts@ */ /end MEASUREMENT
/begin MEASUREMENT PHC_bErrAcvGridHeatr "Grid Heater Error Detection" UBYTE BATU_EcuIntgdSwGend_CM_boolean 0 0 0.0 1.0 ECU_ADDRESS 0x400044A7 /* @ECU_Address@PHC_bErrAcvGridHeatr@ */ /end MEASUREMENT
/begin MEASUREMENT PHC_bDeacGridHeat "Grid Heater Deactivation" UBYTE BATU_EcuIntgdSwGend_CM_boolean 0 0 0.0 1.0 ECU_ADDRESS 0x400044A8 /* @ECU_Address@PHC_bDeacGridHeat@ */ /end MEASUREMENT
/begin MEASUREMENT PHC_bDisaPreAcvnGridHeatr "Grid Heater is Disabled Before Starter" UBYTE BATU_EcuIntgdSwGend_CM_boolean 0 0 0.0 1.0 ECU_ADDRESS 0x400044A9 /* @ECU_Address@PHC_bDisaPreAcvnGridHeatr@ */ /end MEASUREMENT
/begin MEASUREMENT PHC_bTiAcvnPreAcvnGridHeatr "Grid Heater Before Starter Activation Timer Enable" UBYTE BATU_EcuIntgdSwGend_CM_boolean 0 0 0.0 1.0 ECU_ADDRESS 0x400044AA /* @ECU_Address@PHC_bTiAcvnPreAcvnGridHeatr@ */ /end MEASUREMENT
/begin MEASUREMENT PHC_bTiDisaPreAcvnGridHeatr "Grid Heater Before Starter Deactivation Timer Enable" UBYTE BATU_EcuIntgdSwGend_CM_boolean 0 0 0.0 1.0 ECU_ADDRESS 0x400044AB /* @ECU_Address@PHC_bTiDisaPreAcvnGridHeatr@ */ /end MEASUREMENT
/begin MEASUREMENT PHC_bAcvPreAcvnGridHeatrTiEna "" UBYTE BATU_EcuIntgdSwGend_CM_boolean 0 0 0.0 1.0 ECU_ADDRESS 0x400044AC /* @ECU_Address@PHC_bAcvPreAcvnGridHeatrTiEna@ */ /end MEASUREMENT
/begin MEASUREMENT PHC_bDisaPostAcvnGridHeatr "Grid Heater is Disabled After Starter" UBYTE BATU_EcuIntgdSwGend_CM_boolean 0 0 0.0 1.0 ECU_ADDRESS 0x400044AD /* @ECU_Address@PHC_bDisaPostAcvnGridHeatr@ */ /end MEASUREMENT
/begin MEASUREMENT IC_bAcvPltAllwd "Pilot Injection Allowance Flag" UBYTE BATU_EcuIntgdSwGend_CM_boolean 0 0 0.0 1.0 ECU_ADDRESS 0x400044AE /* @ECU_Address@IC_bAcvPltAllwd@ */ /end MEASUREMENT
/begin MEASUREMENT FRC_bTCooltHiCoolgFan "Fan Maximum Speed Request According to Coolant High Temperature" UBYTE BATU_EcuIntgdSwGend_CM_boolean 0 0 0.0 1.0 ECU_ADDRESS 0x400044AF /* @ECU_Address@FRC_bTCooltHiCoolgFan@ */ /end MEASUREMENT
/begin MEASUREMENT FRC_bTCooltLoCoolgFan "Fan Maximum Speed Request According to Coolant Low Temperature" UBYTE BATU_EcuIntgdSwGend_CM_boolean 0 0 0.0 1.0 ECU_ADDRESS 0x400044B0 /* @ECU_Address@FRC_bTCooltLoCoolgFan@ */ /end MEASUREMENT
/begin MEASUREMENT FRC_bTAirBoostCoolgFan "Fan Maximum Speed Request According to Air Boost Temperature" UBYTE BATU_EcuIntgdSwGend_CM_boolean 0 0 0.0 1.0 ECU_ADDRESS 0x400044B1 /* @ECU_Address@FRC_bTAirBoostCoolgFan@ */ /end MEASUREMENT
/begin MEASUREMENT FRC_bTOilCoolgFan "Fan Maximum Speed Request According to Oil Temperature" UBYTE BATU_EcuIntgdSwGend_CM_boolean 0 0 0.0 1.0 ECU_ADDRESS 0x400044B2 /* @ECU_Address@FRC_bTOilCoolgFan@ */ /end MEASUREMENT
/begin MEASUREMENT FRC_bTFuCoolgFan "Fan Maximum Speed Request According to Fuel Temperature" UBYTE BATU_EcuIntgdSwGend_CM_boolean 0 0 0.0 1.0 ECU_ADDRESS 0x400044B3 /* @ECU_Address@FRC_bTFuCoolgFan@ */ /end MEASUREMENT
/begin MEASUREMENT FRC_bReqCoolgFanMax "Fan Maximum Speed Request" UBYTE BATU_EcuIntgdSwGend_CM_boolean 0 0 0.0 1.0 ECU_ADDRESS 0x400044B4 /* @ECU_Address@FRC_bReqCoolgFanMax@ */ /end MEASUREMENT
/begin MEASUREMENT FRC_bEnaCoolgFanClsd "Accelerator Pedal State Timer Activation" UBYTE BATU_EcuIntgdSwGend_CM_boolean 0 0 0.0 1.0 ECU_ADDRESS 0x400044B5 /* @ECU_Address@FRC_bEnaCoolgFanClsd@ */ /end MEASUREMENT
/begin MEASUREMENT FRC_bNEngMinThd "Fan Minimum Speed Request According to Engine Speed" UBYTE BATU_EcuIntgdSwGend_CM_boolean 0 0 0.0 1.0 ECU_ADDRESS 0x400044B6 /* @ECU_Address@FRC_bNEngMinThd@ */ /end MEASUREMENT
/begin MEASUREMENT FRC_bReqCoolgFanClsd "Fan Minimum Speed Request" UBYTE BATU_EcuIntgdSwGend_CM_boolean 0 0 0.0 1.0 ECU_ADDRESS 0x400044B7 /* @ECU_Address@FRC_bReqCoolgFanClsd@ */ /end MEASUREMENT
/begin MEASUREMENT FRC_bStAccrLvl3 "Fan Minimum Speed Request According to Accelerator Pedal State 3" UBYTE BATU_EcuIntgdSwGend_CM_boolean 0 0 0.0 1.0 ECU_ADDRESS 0x400044B8 /* @ECU_Address@FRC_bStAccrLvl3@ */ /end MEASUREMENT
/begin MEASUREMENT FRC_VVehMinFanRpmThd "Fan Minimum Speed Request  According to Vehicle Speed" UBYTE BATU_EcuIntgdSwGend_CM_boolean 0 0 0.0 1.0 ECU_ADDRESS 0x400044B9 /* @ECU_Address@FRC_VVehMinFanRpmThd@ */ /end MEASUREMENT
/begin MEASUREMENT FRC_bComplStAccrLvl3 "Accelerator Pedal State Debouncer Activation" UBYTE BATU_EcuIntgdSwGend_CM_boolean 0 0 0.0 1.0 ECU_ADDRESS 0x400044BA /* @ECU_Address@FRC_bComplStAccrLvl3@ */ /end MEASUREMENT
/begin MEASUREMENT EOP_bAcvCdstFan "" UBYTE BATU_EcuIntgdSwGend_CM_boolean 0 0 0.0 1.0 ECU_ADDRESS 0x400095A1 /* @ECU_Address@gucBinOut[37]@ */ /end MEASUREMENT
/begin MEASUREMENT EOP_bAcvGridHeatr "Output processing Active flag  GridHeatr" UBYTE BATU_EcuIntgdSwGend_CM_boolean 0 0 0.0 1.0 ECU_ADDRESS 0x4000959E /* @ECU_Address@gucBinOut[34]@ */ /end MEASUREMENT
/begin MEASUREMENT EOP_bErrAccrTotLoss "Output processing Error flag  Accelerator " UBYTE BATU_EcuIntgdSwGend_CM_boolean 0 0 0.0 1.0 ECU_ADDRESS 0x400044BB /* @ECU_Address@EOP_bErrAccrTotLoss@ */ /end MEASUREMENT
/begin MEASUREMENT EOP_bErrCamCrankTotLoss "" UBYTE BATU_EcuIntgdSwGend_CM_boolean 0 0 0.0 1.0 ECU_ADDRESS 0x400044BC /* @ECU_Address@EOP_bErrCamCrankTotLoss@ */ /end MEASUREMENT
/begin MEASUREMENT EOP_bAcvStrtr "Output processing Active flag  Starter" UBYTE BATU_EcuIntgdSwGend_CM_boolean 0 0 0.0 1.0 ECU_ADDRESS 0x4000959C /* @ECU_Address@gucBinOut[32]@ */ /end MEASUREMENT
/begin MEASUREMENT EOP_bAltOpenReq "" UBYTE BATU_EcuIntgdSwGend_CM_boolean 0 0 0.0 1.0 ECU_ADDRESS 0x400044BD /* @ECU_Address@EOP_bAltOpenReq@ */ /end MEASUREMENT
/begin MEASUREMENT EMS_bTranPwronToStrt "Power-on to Start Mode Transition Flag Signal" UBYTE BATU_EcuIntgdSwGend_CM_boolean 0 0 0.0 1.0 ECU_ADDRESS 0x400044BE /* @ECU_Address@EMS_bTranPwronToStrt@ */ /end MEASUREMENT
/begin MEASUREMENT EMS_bTranStrtToIdlespd "Start to Idle Speed Mode Transition Flag Signal" UBYTE BATU_EcuIntgdSwGend_CM_boolean 0 0 0.0 1.0 ECU_ADDRESS 0x400044BF /* @ECU_Address@EMS_bTranStrtToIdlespd@ */ /end MEASUREMENT
/begin MEASUREMENT EMS_bTranOvspdToStop "Overspeed to Stop Mode Transition Flag Signal" UBYTE BATU_EcuIntgdSwGend_CM_boolean 0 0 0.0 1.0 ECU_ADDRESS 0x400044C0 /* @ECU_Address@EMS_bTranOvspdToStop@ */ /end MEASUREMENT
/begin MEASUREMENT EMS_bTranStrtToStop "Start to Stop Mode Transition Flag Signal" UBYTE BATU_EcuIntgdSwGend_CM_boolean 0 0 0.0 1.0 ECU_ADDRESS 0x400044C1 /* @ECU_Address@EMS_bTranStrtToStop@ */ /end MEASUREMENT
/begin MEASUREMENT EMS_bTranStopToPwrOn "Stop to Power-on Mode Transition Flag Signal" UBYTE BATU_EcuIntgdSwGend_CM_boolean 0 0 0.0 1.0 ECU_ADDRESS 0x400044C2 /* @ECU_Address@EMS_bTranStopToPwrOn@ */ /end MEASUREMENT
/begin MEASUREMENT EMS_bTranIdlespdToOvspd "Idle Speed to Overspeed Mode Transition Flag Signal" UBYTE BATU_EcuIntgdSwGend_CM_boolean 0 0 0.0 1.0 ECU_ADDRESS 0x400044C3 /* @ECU_Address@EMS_bTranIdlespdToOvspd@ */ /end MEASUREMENT
/begin MEASUREMENT EMS_bTranIdlespdToTcuReq "Idle Speed to TCU Speed Request Mode Transition Flag Signal" UBYTE BATU_EcuIntgdSwGend_CM_boolean 0 0 0.0 1.0 ECU_ADDRESS 0x400044C4 /* @ECU_Address@EMS_bTranIdlespdToTcuReq@ */ /end MEASUREMENT
/begin MEASUREMENT EMS_bTranIdlespdToStop "Idle Speed to Stop Mode Transition Flag Signal" UBYTE BATU_EcuIntgdSwGend_CM_boolean 0 0 0.0 1.0 ECU_ADDRESS 0x400044C5 /* @ECU_Address@EMS_bTranIdlespdToStop@ */ /end MEASUREMENT
/begin MEASUREMENT EMS_bTranTcuReqToStop "TCU Speed Request to Stop Mode Transition Flag Signal" UBYTE BATU_EcuIntgdSwGend_CM_boolean 0 0 0.0 1.0 ECU_ADDRESS 0x400044C6 /* @ECU_Address@EMS_bTranTcuReqToStop@ */ /end MEASUREMENT
/begin MEASUREMENT EMS_bTranIdlespdToTq "Idle Speed to Torque Mode Transition Flag Signal" UBYTE BATU_EcuIntgdSwGend_CM_boolean 0 0 0.0 1.0 ECU_ADDRESS 0x400044C7 /* @ECU_Address@EMS_bTranIdlespdToTq@ */ /end MEASUREMENT
/begin MEASUREMENT EMS_bTranTqToIdlespd "Torque to Idle Speed Mode Transition Flag Signal" UBYTE BATU_EcuIntgdSwGend_CM_boolean 0 0 0.0 1.0 ECU_ADDRESS 0x400044C8 /* @ECU_Address@EMS_bTranTqToIdlespd@ */ /end MEASUREMENT
/begin MEASUREMENT EMS_TranTcuReqToOvspd "TCU Speed Request to Overspeed Mode Transition Flag Signal" UBYTE BATU_EcuIntgdSwGend_CM_boolean 0 0 0.0 1.0 ECU_ADDRESS 0x400044C9 /* @ECU_Address@EMS_TranTcuReqToOvspd@ */ /end MEASUREMENT
/begin MEASUREMENT EMS_bTranTqToOvspd "Torque to Overspeed Mode Transition Flag Signal" UBYTE BATU_EcuIntgdSwGend_CM_boolean 0 0 0.0 1.0 ECU_ADDRESS 0x400044CA /* @ECU_Address@EMS_bTranTqToOvspd@ */ /end MEASUREMENT
/begin MEASUREMENT EMS_bTranOvspdToTq "Overspeed to Torque Mode Transition Flag Signal" UBYTE BATU_EcuIntgdSwGend_CM_boolean 0 0 0.0 1.0 ECU_ADDRESS 0x400044CB /* @ECU_Address@EMS_bTranOvspdToTq@ */ /end MEASUREMENT
/begin MEASUREMENT EMS_bTranTqToStop "Torque to Stop Mode Transition Flag Signal" UBYTE BATU_EcuIntgdSwGend_CM_boolean 0 0 0.0 1.0 ECU_ADDRESS 0x400044CC /* @ECU_Address@EMS_bTranTqToStop@ */ /end MEASUREMENT
/begin MEASUREMENT EMS_bTranTqToTcuReq "Torque to TCU Speed Request Mode Transition Flag Signal" UBYTE BATU_EcuIntgdSwGend_CM_boolean 0 0 0.0 1.0 ECU_ADDRESS 0x400044CD /* @ECU_Address@EMS_bTranTqToTcuReq@ */ /end MEASUREMENT
/begin MEASUREMENT EMS_bTranTcuReqToTq "TCU Speed Request to Torque Mode Transition Flag Signal" UBYTE BATU_EcuIntgdSwGend_CM_boolean 0 0 0.0 1.0 ECU_ADDRESS 0x400044CE /* @ECU_Address@EMS_bTranTcuReqToTq@ */ /end MEASUREMENT
/begin MEASUREMENT EIP_bInhEngStrtFromTcu "" UBYTE BATU_EcuIntgdSwGend_CM_boolean 0 0 0.0 1.0 ECU_ADDRESS 0x400044CF /* @ECU_Address@EIP_bInhEngStrtFromTcu@ */ /end MEASUREMENT
/begin MEASUREMENT EIP_PosnEmgcyLvrTow "" UBYTE BATU_EcuIntgdSwGend_CM_boolean 0 0 0.0 1.0 ECU_ADDRESS 0x400044D0 /* @ECU_Address@EIP_PosnEmgcyLvrTow@ */ /end MEASUREMENT
/begin MEASUREMENT EIP_bAcvCrpSwt "" UBYTE BATU_EcuIntgdSwGend_CM_boolean 0 0 0.0 1.0 ECU_ADDRESS 0x400044D1 /* @ECU_Address@EIP_bAcvCrpSwt@ */ /end MEASUREMENT
/begin MEASUREMENT EIP_bEmgcyShtdwnFromTcu "" UBYTE BATU_EcuIntgdSwGend_CM_boolean 0 0 0.0 1.0 ECU_ADDRESS 0x400044D2 /* @ECU_Address@EIP_bEmgcyShtdwnFromTcu@ */ /end MEASUREMENT
/begin MEASUREMENT EIP_bAcvCdstFanFromCAN "" UBYTE BATU_EcuIntgdSwGend_CM_boolean 0 0 0.0 1.0 ECU_ADDRESS 0x400044D3 /* @ECU_Address@EIP_bAcvCdstFanFromCAN@ */ /end MEASUREMENT
/begin MEASUREMENT EIP_bAcvLossCAN "" UBYTE BATU_EcuIntgdSwGend_CM_boolean 0 0 0.0 1.0 ECU_ADDRESS 0x400044D4 /* @ECU_Address@EIP_bAcvLossCAN@ */ /end MEASUREMENT
/begin MEASUREMENT EIP_bAcvEmgcyStop "ECU Input Processing Engine Emergency Stop from TCU" UBYTE BATU_EcuIntgdSwGend_CM_boolean 0 0 0.0 1.0 ECU_ADDRESS 0x400044D5 /* @ECU_Address@EIP_bAcvEmgcyStop@ */ /end MEASUREMENT
/begin MEASUREMENT EIP_bAcvTqLimn "" UBYTE BATU_EcuIntgdSwGend_CM_boolean 0 0 0.0 1.0 ECU_ADDRESS 0x400044D6 /* @ECU_Address@EIP_bAcvTqLimn@ */ /end MEASUREMENT
/begin MEASUREMENT EIP_bPTOActvnFromCAN "PTO Activation Signal From CAN" UBYTE BATU_EcuIntgdSwGend_CM_boolean 0 0 0.0 1.0 ECU_ADDRESS 0x400044D7 /* @ECU_Address@EIP_bPTOActvnFromCAN@ */ /end MEASUREMENT
/begin MEASUREMENT EIP_bInhEngStrtFromCAN "" UBYTE BATU_EcuIntgdSwGend_CM_boolean 0 0 0.0 1.0 ECU_ADDRESS 0x400044D8 /* @ECU_Address@EIP_bInhEngStrtFromCAN@ */ /end MEASUREMENT
/begin MEASUREMENT EIP_bErrAutStrtSwt "" UBYTE BATU_EcuIntgdSwGend_CM_boolean 0 0 0.0 1.0 ECU_ADDRESS 0x400044D9 /* @ECU_Address@EIP_bErrAutStrtSwt@ */ /end MEASUREMENT
/begin MEASUREMENT EIP_bErrImdtStrtSwt "" UBYTE BATU_EcuIntgdSwGend_CM_boolean 0 0 0.0 1.0 ECU_ADDRESS 0x400044DA /* @ECU_Address@EIP_bErrImdtStrtSwt@ */ /end MEASUREMENT
/begin MEASUREMENT EIP_bErrStpSwt "" UBYTE BATU_EcuIntgdSwGend_CM_boolean 0 0 0.0 1.0 ECU_ADDRESS 0x400044DB /* @ECU_Address@EIP_bErrStpSwt@ */ /end MEASUREMENT
/begin MEASUREMENT EIP_bErrCmbtSwt "" UBYTE BATU_EcuIntgdSwGend_CM_boolean 0 0 0.0 1.0 ECU_ADDRESS 0x400044DC /* @ECU_Address@EIP_bErrCmbtSwt@ */ /end MEASUREMENT
/begin MEASUREMENT EIP_bErrCmndrHtchSwt "" UBYTE BATU_EcuIntgdSwGend_CM_boolean 0 0 0.0 1.0 ECU_ADDRESS 0x400044DD /* @ECU_Address@EIP_bErrCmndrHtchSwt@ */ /end MEASUREMENT
/begin MEASUREMENT EIP_bErrSbmgSwt "" UBYTE BATU_EcuIntgdSwGend_CM_boolean 0 0 0.0 1.0 ECU_ADDRESS 0x400044DE /* @ECU_Address@EIP_bErrSbmgSwt@ */ /end MEASUREMENT
/begin MEASUREMENT EIP_bAltFaultFromCAN "" UBYTE BATU_EcuIntgdSwGend_CM_boolean 0 0 0.0 1.0 ECU_ADDRESS 0x400044DF /* @ECU_Address@EIP_bAltFaultFromCAN@ */ /end MEASUREMENT
/begin MEASUREMENT EIP_bEngMILSts "" UBYTE BATU_EcuIntgdSwGend_CM_boolean 0 0 0.0 1.0 ECU_ADDRESS 0x400044E0 /* @ECU_Address@EIP_bEngMILSts@ */ /end MEASUREMENT
/begin MEASUREMENT EIP_bErrPAmbAirRng "" UBYTE BATU_EcuIntgdSwGend_CM_boolean 0 0 0.0 1.0 ECU_ADDRESS 0x400044E1 /* @ECU_Address@EIP_bErrPAmbAirRng@ */ /end MEASUREMENT
/begin MEASUREMENT EIP_bErrPAmbAirGrdt "" UBYTE BATU_EcuIntgdSwGend_CM_boolean 0 0 0.0 1.0 ECU_ADDRESS 0x400044E2 /* @ECU_Address@EIP_bErrPAmbAirGrdt@ */ /end MEASUREMENT
/begin MEASUREMENT EIP_bErrPAmbAirSnsr "" UBYTE BATU_EcuIntgdSwGend_CM_boolean 0 0 0.0 1.0 ECU_ADDRESS 0x400044E3 /* @ECU_Address@EIP_bErrPAmbAirSnsr@ */ /end MEASUREMENT
/begin MEASUREMENT EIP_bErrPCmprInltRng "" UBYTE BATU_EcuIntgdSwGend_CM_boolean 0 0 0.0 1.0 ECU_ADDRESS 0x400044E4 /* @ECU_Address@EIP_bErrPCmprInltRng@ */ /end MEASUREMENT
/begin MEASUREMENT EIP_bErrPCmprInltGrdt "" UBYTE BATU_EcuIntgdSwGend_CM_boolean 0 0 0.0 1.0 ECU_ADDRESS 0x400044E5 /* @ECU_Address@EIP_bErrPCmprInltGrdt@ */ /end MEASUREMENT
/begin MEASUREMENT EIP_bErrPCmprInltSnsr "" UBYTE BATU_EcuIntgdSwGend_CM_boolean 0 0 0.0 1.0 ECU_ADDRESS 0x400044E6 /* @ECU_Address@EIP_bErrPCmprInltSnsr@ */ /end MEASUREMENT
/begin MEASUREMENT EIP_bErrPFineFilBfrRng "" UBYTE BATU_EcuIntgdSwGend_CM_boolean 0 0 0.0 1.0 ECU_ADDRESS 0x400044E7 /* @ECU_Address@EIP_bErrPFineFilBfrRng@ */ /end MEASUREMENT
/begin MEASUREMENT EIP_bErrPFineFilBfrGrdt "" UBYTE BATU_EcuIntgdSwGend_CM_boolean 0 0 0.0 1.0 ECU_ADDRESS 0x400044E8 /* @ECU_Address@EIP_bErrPFineFilBfrGrdt@ */ /end MEASUREMENT
/begin MEASUREMENT EIP_bErrPFineFilBfrSnsr "" UBYTE BATU_EcuIntgdSwGend_CM_boolean 0 0 0.0 1.0 ECU_ADDRESS 0x400044E9 /* @ECU_Address@EIP_bErrPFineFilBfrSnsr@ */ /end MEASUREMENT
/begin MEASUREMENT EIP_bErrPFineFilAftRng "" UBYTE BATU_EcuIntgdSwGend_CM_boolean 0 0 0.0 1.0 ECU_ADDRESS 0x400044EA /* @ECU_Address@EIP_bErrPFineFilAftRng@ */ /end MEASUREMENT
/begin MEASUREMENT EIP_bErrPFineFilAftGrdt "" UBYTE BATU_EcuIntgdSwGend_CM_boolean 0 0 0.0 1.0 ECU_ADDRESS 0x400044EB /* @ECU_Address@EIP_bErrPFineFilAftGrdt@ */ /end MEASUREMENT
/begin MEASUREMENT EIP_bErrPFineFilAftSnsr "" UBYTE BATU_EcuIntgdSwGend_CM_boolean 0 0 0.0 1.0 ECU_ADDRESS 0x400044EC /* @ECU_Address@EIP_bErrPFineFilAftSnsr@ */ /end MEASUREMENT
/begin MEASUREMENT EIP_bErrPFuRng "" UBYTE BATU_EcuIntgdSwGend_CM_boolean 0 0 0.0 1.0 ECU_ADDRESS 0x400044ED /* @ECU_Address@EIP_bErrPFuRng@ */ /end MEASUREMENT
/begin MEASUREMENT EIP_bErrPFuGrdt "" UBYTE BATU_EcuIntgdSwGend_CM_boolean 0 0 0.0 1.0 ECU_ADDRESS 0x400044EE /* @ECU_Address@EIP_bErrPFuGrdt@ */ /end MEASUREMENT
/begin MEASUREMENT EIP_bErrPFuSnsr "" UBYTE BATU_EcuIntgdSwGend_CM_boolean 0 0 0.0 1.0 ECU_ADDRESS 0x400044EF /* @ECU_Address@EIP_bErrPFuSnsr@ */ /end MEASUREMENT
/begin MEASUREMENT EIP_bErrPOilRng "" UBYTE BATU_EcuIntgdSwGend_CM_boolean 0 0 0.0 1.0 ECU_ADDRESS 0x400044F0 /* @ECU_Address@EIP_bErrPOilRng@ */ /end MEASUREMENT
/begin MEASUREMENT EIP_bErrPOilGrdt "" UBYTE BATU_EcuIntgdSwGend_CM_boolean 0 0 0.0 1.0 ECU_ADDRESS 0x400044F1 /* @ECU_Address@EIP_bErrPOilGrdt@ */ /end MEASUREMENT
/begin MEASUREMENT EIP_bErrPOilSnsr "" UBYTE BATU_EcuIntgdSwGend_CM_boolean 0 0 0.0 1.0 ECU_ADDRESS 0x400044F2 /* @ECU_Address@EIP_bErrPOilSnsr@ */ /end MEASUREMENT
/begin MEASUREMENT EIP_bErrPAirBoostRng "" UBYTE BATU_EcuIntgdSwGend_CM_boolean 0 0 0.0 1.0 ECU_ADDRESS 0x400044F3 /* @ECU_Address@EIP_bErrPAirBoostRng@ */ /end MEASUREMENT
/begin MEASUREMENT EIP_bErrPAirBoostGrdt "" UBYTE BATU_EcuIntgdSwGend_CM_boolean 0 0 0.0 1.0 ECU_ADDRESS 0x400044F4 /* @ECU_Address@EIP_bErrPAirBoostGrdt@ */ /end MEASUREMENT
/begin MEASUREMENT EIP_bErrPAirBoostSnsr "" UBYTE BATU_EcuIntgdSwGend_CM_boolean 0 0 0.0 1.0 ECU_ADDRESS 0x400044F5 /* @ECU_Address@EIP_bErrPAirBoostSnsr@ */ /end MEASUREMENT
/begin MEASUREMENT EIP_bErrPRailRng "" UBYTE BATU_EcuIntgdSwGend_CM_boolean 0 0 0.0 1.0 ECU_ADDRESS 0x400044F6 /* @ECU_Address@EIP_bErrPRailRng@ */ /end MEASUREMENT
/begin MEASUREMENT EIP_bErrPRailGrdt "" UBYTE BATU_EcuIntgdSwGend_CM_boolean 0 0 0.0 1.0 ECU_ADDRESS 0x400044F7 /* @ECU_Address@EIP_bErrPRailGrdt@ */ /end MEASUREMENT
/begin MEASUREMENT EIP_bErrPRailSnsr "" UBYTE BATU_EcuIntgdSwGend_CM_boolean 0 0 0.0 1.0 ECU_ADDRESS 0x400044F8 /* @ECU_Address@EIP_bErrPRailSnsr@ */ /end MEASUREMENT
/begin MEASUREMENT EIP_bErrPCooltRng "" UBYTE BATU_EcuIntgdSwGend_CM_boolean 0 0 0.0 1.0 ECU_ADDRESS 0x400044F9 /* @ECU_Address@EIP_bErrPCooltRng@ */ /end MEASUREMENT
/begin MEASUREMENT EIP_bErrPCooltGrdt "" UBYTE BATU_EcuIntgdSwGend_CM_boolean 0 0 0.0 1.0 ECU_ADDRESS 0x400044FA /* @ECU_Address@EIP_bErrPCooltGrdt@ */ /end MEASUREMENT
/begin MEASUREMENT EIP_bErrPCooltSnsr "" UBYTE BATU_EcuIntgdSwGend_CM_boolean 0 0 0.0 1.0 ECU_ADDRESS 0x400044FB /* @ECU_Address@EIP_bErrPCooltSnsr@ */ /end MEASUREMENT
/begin MEASUREMENT EIP_bPercgAccrDervDiffHi "" UBYTE BATU_EcuIntgdSwGend_CM_boolean 0 0 0.0 1.0 ECU_ADDRESS 0x400044FC /* @ECU_Address@EIP_bPercgAccrDervDiffHi@ */ /end MEASUREMENT
/begin MEASUREMENT EIP_bPercgAccrDervDiffLo "" UBYTE BATU_EcuIntgdSwGend_CM_boolean 0 0 0.0 1.0 ECU_ADDRESS 0x400044FD /* @ECU_Address@EIP_bPercgAccrDervDiffLo@ */ /end MEASUREMENT
/begin MEASUREMENT EIP_bErrAccrDervDiff "" UBYTE BATU_EcuIntgdSwGend_CM_boolean 0 0 0.0 1.0 ECU_ADDRESS 0x400044FE /* @ECU_Address@EIP_bErrAccrDervDiff@ */ /end MEASUREMENT
/begin MEASUREMENT EIP_bPercgAccrDiffDetn "" UBYTE BATU_EcuIntgdSwGend_CM_boolean 0 0 0.0 1.0 ECU_ADDRESS 0x400044FF /* @ECU_Address@EIP_bPercgAccrDiffDetn@ */ /end MEASUREMENT
/begin MEASUREMENT EIP_bErrAccrDiff "" UBYTE BATU_EcuIntgdSwGend_CM_boolean 0 0 0.0 1.0 ECU_ADDRESS 0x40004500 /* @ECU_Address@EIP_bErrAccrDiff@ */ /end MEASUREMENT
/begin MEASUREMENT EIP_bErrAccrSnsr1 "" UBYTE BATU_EcuIntgdSwGend_CM_boolean 0 0 0.0 1.0 ECU_ADDRESS 0x40004501 /* @ECU_Address@EIP_bErrAccrSnsr1@ */ /end MEASUREMENT
/begin MEASUREMENT EIP_bErrAccr1Oor "" UBYTE BATU_EcuIntgdSwGend_CM_boolean 0 0 0.0 1.0 ECU_ADDRESS 0x40004502 /* @ECU_Address@EIP_bErrAccr1Oor@ */ /end MEASUREMENT
/begin MEASUREMENT EIP_bErrAccr1 "" UBYTE BATU_EcuIntgdSwGend_CM_boolean 0 0 0.0 1.0 ECU_ADDRESS 0x40004503 /* @ECU_Address@EIP_bErrAccr1@ */ /end MEASUREMENT
/begin MEASUREMENT EIP_bErrAccrSnsr2 "" UBYTE BATU_EcuIntgdSwGend_CM_boolean 0 0 0.0 1.0 ECU_ADDRESS 0x40004504 /* @ECU_Address@EIP_bErrAccrSnsr2@ */ /end MEASUREMENT
/begin MEASUREMENT EIP_bErrAccr2Oor "" UBYTE BATU_EcuIntgdSwGend_CM_boolean 0 0 0.0 1.0 ECU_ADDRESS 0x40004505 /* @ECU_Address@EIP_bErrAccr2Oor@ */ /end MEASUREMENT
/begin MEASUREMENT EIP_bErrAccr2 "" UBYTE BATU_EcuIntgdSwGend_CM_boolean 0 0 0.0 1.0 ECU_ADDRESS 0x40004506 /* @ECU_Address@EIP_bErrAccr2@ */ /end MEASUREMENT
/begin MEASUREMENT EIP_bTranAccrLvl0To1 "" UBYTE BATU_EcuIntgdSwGend_CM_boolean 0 0 0.0 1.0 ECU_ADDRESS 0x40004507 /* @ECU_Address@EIP_bTranAccrLvl0To1@ */ /end MEASUREMENT
/begin MEASUREMENT EIP_bTranAccrLvl1To0 "" UBYTE BATU_EcuIntgdSwGend_CM_boolean 0 0 0.0 1.0 ECU_ADDRESS 0x40004508 /* @ECU_Address@EIP_bTranAccrLvl1To0@ */ /end MEASUREMENT
/begin MEASUREMENT EIP_bTranAccrLvl1To2 "" UBYTE BATU_EcuIntgdSwGend_CM_boolean 0 0 0.0 1.0 ECU_ADDRESS 0x40004509 /* @ECU_Address@EIP_bTranAccrLvl1To2@ */ /end MEASUREMENT
/begin MEASUREMENT EIP_bTranAccrLvl2To1 "" UBYTE BATU_EcuIntgdSwGend_CM_boolean 0 0 0.0 1.0 ECU_ADDRESS 0x4000450A /* @ECU_Address@EIP_bTranAccrLvl2To1@ */ /end MEASUREMENT
/begin MEASUREMENT EIP_bTranAccrLvl2To3 "" UBYTE BATU_EcuIntgdSwGend_CM_boolean 0 0 0.0 1.0 ECU_ADDRESS 0x4000450B /* @ECU_Address@EIP_bTranAccrLvl2To3@ */ /end MEASUREMENT
/begin MEASUREMENT EIP_bTranAccrLvl3To2 "" UBYTE BATU_EcuIntgdSwGend_CM_boolean 0 0 0.0 1.0 ECU_ADDRESS 0x4000450C /* @ECU_Address@EIP_bTranAccrLvl3To2@ */ /end MEASUREMENT
/begin MEASUREMENT EIP_bErrAccrRedncy "" UBYTE BATU_EcuIntgdSwGend_CM_boolean 0 0 0.0 1.0 ECU_ADDRESS 0x4000450D /* @ECU_Address@EIP_bErrAccrRedncy@ */ /end MEASUREMENT
/begin MEASUREMENT EIP_bErrAccrTotLoss "" UBYTE BATU_EcuIntgdSwGend_CM_boolean 0 0 0.0 1.0 ECU_ADDRESS 0x4000450E /* @ECU_Address@EIP_bErrAccrTotLoss@ */ /end MEASUREMENT
/begin MEASUREMENT EIP_bAcvEmgcyShtdwnForOvspd "" UBYTE BATU_EcuIntgdSwGend_CM_boolean 0 0 0.0 1.0 ECU_ADDRESS 0x4000450F /* @ECU_Address@EIP_bAcvEmgcyShtdwnForOvspd@ */ /end MEASUREMENT
/begin MEASUREMENT EIP_bAcvFuCutoffForOvspd "" UBYTE BATU_EcuIntgdSwGend_CM_boolean 0 0 0.0 1.0 ECU_ADDRESS 0x40004510 /* @ECU_Address@EIP_bAcvFuCutoffForOvspd@ */ /end MEASUREMENT
/begin MEASUREMENT EIP_bErrCamsftSnsr "" UBYTE BATU_EcuIntgdSwGend_CM_boolean 0 0 0.0 1.0 ECU_ADDRESS 0x40004511 /* @ECU_Address@EIP_bErrCamsftSnsr@ */ /end MEASUREMENT
/begin MEASUREMENT EIP_bErrCrnksftSnsr1 "" UBYTE BATU_EcuIntgdSwGend_CM_boolean 0 0 0.0 1.0 ECU_ADDRESS 0x40004512 /* @ECU_Address@EIP_bErrCrnksftSnsr1@ */ /end MEASUREMENT
/begin MEASUREMENT EIP_bErrCrnksftSnsr2 "" UBYTE BATU_EcuIntgdSwGend_CM_boolean 0 0 0.0 1.0 ECU_ADDRESS 0x40004513 /* @ECU_Address@EIP_bErrCrnksftSnsr2@ */ /end MEASUREMENT
/begin MEASUREMENT EIP_bErrCamCrankTotLoss "" UBYTE BATU_EcuIntgdSwGend_CM_boolean 0 0 0.0 1.0 ECU_ADDRESS 0x40004514 /* @ECU_Address@EIP_bErrCamCrankTotLoss@ */ /end MEASUREMENT
/begin MEASUREMENT EIP_bErrTAirBoostRng "" UBYTE BATU_EcuIntgdSwGend_CM_boolean 0 0 0.0 1.0 ECU_ADDRESS 0x40004515 /* @ECU_Address@EIP_bErrTAirBoostRng@ */ /end MEASUREMENT
/begin MEASUREMENT EIP_bErrTAirBoostGrdt "" UBYTE BATU_EcuIntgdSwGend_CM_boolean 0 0 0.0 1.0 ECU_ADDRESS 0x40004516 /* @ECU_Address@EIP_bErrTAirBoostGrdt@ */ /end MEASUREMENT
/begin MEASUREMENT EIP_bErrTAirBoostSnsr "" UBYTE BATU_EcuIntgdSwGend_CM_boolean 0 0 0.0 1.0 ECU_ADDRESS 0x40004517 /* @ECU_Address@EIP_bErrTAirBoostSnsr@ */ /end MEASUREMENT
/begin MEASUREMENT EIP_bErrTOilRng "" UBYTE BATU_EcuIntgdSwGend_CM_boolean 0 0 0.0 1.0 ECU_ADDRESS 0x40004518 /* @ECU_Address@EIP_bErrTOilRng@ */ /end MEASUREMENT
/begin MEASUREMENT EIP_bErrTOilGrdt "" UBYTE BATU_EcuIntgdSwGend_CM_boolean 0 0 0.0 1.0 ECU_ADDRESS 0x40004519 /* @ECU_Address@EIP_bErrTOilGrdt@ */ /end MEASUREMENT
/begin MEASUREMENT EIP_bErrTOilCoh "" UBYTE BATU_EcuIntgdSwGend_CM_boolean 0 0 0.0 1.0 ECU_ADDRESS 0x4000451A /* @ECU_Address@EIP_bErrTOilCoh@ */ /end MEASUREMENT
/begin MEASUREMENT EIP_bErrTOilSnsr "" UBYTE BATU_EcuIntgdSwGend_CM_boolean 0 0 0.0 1.0 ECU_ADDRESS 0x4000451B /* @ECU_Address@EIP_bErrTOilSnsr@ */ /end MEASUREMENT
/begin MEASUREMENT EIP_bErrTCooltHiRng "" UBYTE BATU_EcuIntgdSwGend_CM_boolean 0 0 0.0 1.0 ECU_ADDRESS 0x4000451C /* @ECU_Address@EIP_bErrTCooltHiRng@ */ /end MEASUREMENT
/begin MEASUREMENT EIP_bErrTCooltHiGrdt "" UBYTE BATU_EcuIntgdSwGend_CM_boolean 0 0 0.0 1.0 ECU_ADDRESS 0x4000451D /* @ECU_Address@EIP_bErrTCooltHiGrdt@ */ /end MEASUREMENT
/begin MEASUREMENT EIP_bErrTCooltHiSnsr "" UBYTE BATU_EcuIntgdSwGend_CM_boolean 0 0 0.0 1.0 ECU_ADDRESS 0x4000451E /* @ECU_Address@EIP_bErrTCooltHiSnsr@ */ /end MEASUREMENT
/begin MEASUREMENT EIP_bErrTExhRiRng "" UBYTE BATU_EcuIntgdSwGend_CM_boolean 0 0 0.0 1.0 ECU_ADDRESS 0x4000451F /* @ECU_Address@EIP_bErrTExhRiRng@ */ /end MEASUREMENT
/begin MEASUREMENT EIP_bErrTExhRiGrdt "" UBYTE BATU_EcuIntgdSwGend_CM_boolean 0 0 0.0 1.0 ECU_ADDRESS 0x40004520 /* @ECU_Address@EIP_bErrTExhRiGrdt@ */ /end MEASUREMENT
/begin MEASUREMENT EIP_bErrTExhRiSnsr "" UBYTE BATU_EcuIntgdSwGend_CM_boolean 0 0 0.0 1.0 ECU_ADDRESS 0x40004521 /* @ECU_Address@EIP_bErrTExhRiSnsr@ */ /end MEASUREMENT
/begin MEASUREMENT EIP_bErrTCooltLoRng "" UBYTE BATU_EcuIntgdSwGend_CM_boolean 0 0 0.0 1.0 ECU_ADDRESS 0x40004522 /* @ECU_Address@EIP_bErrTCooltLoRng@ */ /end MEASUREMENT
/begin MEASUREMENT EIP_bErrTCooltLoGrdt "" UBYTE BATU_EcuIntgdSwGend_CM_boolean 0 0 0.0 1.0 ECU_ADDRESS 0x40004523 /* @ECU_Address@EIP_bErrTCooltLoGrdt@ */ /end MEASUREMENT
/begin MEASUREMENT EIP_bErrTCooltLoSnsr "" UBYTE BATU_EcuIntgdSwGend_CM_boolean 0 0 0.0 1.0 ECU_ADDRESS 0x40004524 /* @ECU_Address@EIP_bErrTCooltLoSnsr@ */ /end MEASUREMENT
/begin MEASUREMENT EIP_bErrTEcuRng "" UBYTE BATU_EcuIntgdSwGend_CM_boolean 0 0 0.0 1.0 ECU_ADDRESS 0x40004525 /* @ECU_Address@EIP_bErrTEcuRng@ */ /end MEASUREMENT
/begin MEASUREMENT EIP_bErrTEcuGrdt "" UBYTE BATU_EcuIntgdSwGend_CM_boolean 0 0 0.0 1.0 ECU_ADDRESS 0x40004526 /* @ECU_Address@EIP_bErrTEcuGrdt@ */ /end MEASUREMENT
/begin MEASUREMENT EIP_bErrTEcuSnsr "" UBYTE BATU_EcuIntgdSwGend_CM_boolean 0 0 0.0 1.0 ECU_ADDRESS 0x40004527 /* @ECU_Address@EIP_bErrTEcuSnsr@ */ /end MEASUREMENT
/begin MEASUREMENT EIP_bErrTFuRng "" UBYTE BATU_EcuIntgdSwGend_CM_boolean 0 0 0.0 1.0 ECU_ADDRESS 0x40004528 /* @ECU_Address@EIP_bErrTFuRng@ */ /end MEASUREMENT
/begin MEASUREMENT EIP_bErrTFuGrdt "" UBYTE BATU_EcuIntgdSwGend_CM_boolean 0 0 0.0 1.0 ECU_ADDRESS 0x40004529 /* @ECU_Address@EIP_bErrTFuGrdt@ */ /end MEASUREMENT
/begin MEASUREMENT EIP_bErrTFuSnsr "" UBYTE BATU_EcuIntgdSwGend_CM_boolean 0 0 0.0 1.0 ECU_ADDRESS 0x4000452A /* @ECU_Address@EIP_bErrTFuSnsr@ */ /end MEASUREMENT
/begin MEASUREMENT EIP_bErrTAmbAirRng "" UBYTE BATU_EcuIntgdSwGend_CM_boolean 0 0 0.0 1.0 ECU_ADDRESS 0x4000452B /* @ECU_Address@EIP_bErrTAmbAirRng@ */ /end MEASUREMENT
/begin MEASUREMENT EIP_bErrTAmbAirGrdt "" UBYTE BATU_EcuIntgdSwGend_CM_boolean 0 0 0.0 1.0 ECU_ADDRESS 0x4000452C /* @ECU_Address@EIP_bErrTAmbAirGrdt@ */ /end MEASUREMENT
/begin MEASUREMENT EIP_bErrTCmprInltCoh "" UBYTE BATU_EcuIntgdSwGend_CM_boolean 0 0 0.0 1.0 ECU_ADDRESS 0x4000452D /* @ECU_Address@EIP_bErrTCmprInltCoh@ */ /end MEASUREMENT
/begin MEASUREMENT EIP_bErrTAmbAirSnsr "" UBYTE BATU_EcuIntgdSwGend_CM_boolean 0 0 0.0 1.0 ECU_ADDRESS 0x4000452E /* @ECU_Address@EIP_bErrTAmbAirSnsr@ */ /end MEASUREMENT
/begin MEASUREMENT EIP_bErrTCmprInltRng "" UBYTE BATU_EcuIntgdSwGend_CM_boolean 0 0 0.0 1.0 ECU_ADDRESS 0x4000452F /* @ECU_Address@EIP_bErrTCmprInltRng@ */ /end MEASUREMENT
/begin MEASUREMENT EIP_bErrTCmprInltGrdt "" UBYTE BATU_EcuIntgdSwGend_CM_boolean 0 0 0.0 1.0 ECU_ADDRESS 0x40004530 /* @ECU_Address@EIP_bErrTCmprInltGrdt@ */ /end MEASUREMENT
/begin MEASUREMENT EIP_bErrTCmprInltSnsr "" UBYTE BATU_EcuIntgdSwGend_CM_boolean 0 0 0.0 1.0 ECU_ADDRESS 0x40004531 /* @ECU_Address@EIP_bErrTCmprInltSnsr@ */ /end MEASUREMENT
/begin MEASUREMENT EIP_bErrTExhLeRng "" UBYTE BATU_EcuIntgdSwGend_CM_boolean 0 0 0.0 1.0 ECU_ADDRESS 0x40004532 /* @ECU_Address@EIP_bErrTExhLeRng@ */ /end MEASUREMENT
/begin MEASUREMENT EIP_bErrTExhLeGrdt "" UBYTE BATU_EcuIntgdSwGend_CM_boolean 0 0 0.0 1.0 ECU_ADDRESS 0x40004533 /* @ECU_Address@EIP_bErrTExhLeGrdt@ */ /end MEASUREMENT
/begin MEASUREMENT EIP_bErrTExhLeSnsr "" UBYTE BATU_EcuIntgdSwGend_CM_boolean 0 0 0.0 1.0 ECU_ADDRESS 0x40004534 /* @ECU_Address@EIP_bErrTExhLeSnsr@ */ /end MEASUREMENT
/begin MEASUREMENT EIP_bErrLvlCooltRng "" UBYTE BATU_EcuIntgdSwGend_CM_boolean 0 0 0.0 1.0 ECU_ADDRESS 0x40004535 /* @ECU_Address@EIP_bErrLvlCooltRng@ */ /end MEASUREMENT
/begin MEASUREMENT EIP_bErrLvlCooltGrdt "" UBYTE BATU_EcuIntgdSwGend_CM_boolean 0 0 0.0 1.0 ECU_ADDRESS 0x40004536 /* @ECU_Address@EIP_bErrLvlCooltGrdt@ */ /end MEASUREMENT
/begin MEASUREMENT EIP_bErrLvlCooltSnsr "" UBYTE BATU_EcuIntgdSwGend_CM_boolean 0 0 0.0 1.0 ECU_ADDRESS 0x40004537 /* @ECU_Address@EIP_bErrLvlCooltSnsr@ */ /end MEASUREMENT
/begin MEASUREMENT EIP_bErrLvlOilRng "" UBYTE BATU_EcuIntgdSwGend_CM_boolean 0 0 0.0 1.0 ECU_ADDRESS 0x40004538 /* @ECU_Address@EIP_bErrLvlOilRng@ */ /end MEASUREMENT
/begin MEASUREMENT EIP_bErrLvlOilGrdt "" UBYTE BATU_EcuIntgdSwGend_CM_boolean 0 0 0.0 1.0 ECU_ADDRESS 0x40004539 /* @ECU_Address@EIP_bErrLvlOilGrdt@ */ /end MEASUREMENT
/begin MEASUREMENT EIP_bErrLvlOilSnsr "" UBYTE BATU_EcuIntgdSwGend_CM_boolean 0 0 0.0 1.0 ECU_ADDRESS 0x4000453A /* @ECU_Address@EIP_bErrLvlOilSnsr@ */ /end MEASUREMENT
/begin MEASUREMENT EIP_bErrLvlFuRng "" UBYTE BATU_EcuIntgdSwGend_CM_boolean 0 0 0.0 1.0 ECU_ADDRESS 0x4000453B /* @ECU_Address@EIP_bErrLvlFuRng@ */ /end MEASUREMENT
/begin MEASUREMENT EIP_bErrLvlFuGrdt "" UBYTE BATU_EcuIntgdSwGend_CM_boolean 0 0 0.0 1.0 ECU_ADDRESS 0x4000453C /* @ECU_Address@EIP_bErrLvlFuGrdt@ */ /end MEASUREMENT
/begin MEASUREMENT EIP_bErrLvlFuSnsr "" UBYTE BATU_EcuIntgdSwGend_CM_boolean 0 0 0.0 1.0 ECU_ADDRESS 0x4000453D /* @ECU_Address@EIP_bErrLvlFuSnsr@ */ /end MEASUREMENT
/begin MEASUREMENT EIP_bErrUClmp30Rng "" UBYTE BATU_EcuIntgdSwGend_CM_boolean 0 0 0.0 1.0 ECU_ADDRESS 0x4000453E /* @ECU_Address@EIP_bErrUClmp30Rng@ */ /end MEASUREMENT
/begin MEASUREMENT EIP_bErrUClmp30Grdt "" UBYTE BATU_EcuIntgdSwGend_CM_boolean 0 0 0.0 1.0 ECU_ADDRESS 0x4000453F /* @ECU_Address@EIP_bErrUClmp30Grdt@ */ /end MEASUREMENT
/begin MEASUREMENT EIP_bErrUClmp30Snsr "" UBYTE BATU_EcuIntgdSwGend_CM_boolean 0 0 0.0 1.0 ECU_ADDRESS 0x40004540 /* @ECU_Address@EIP_bErrUClmp30Snsr@ */ /end MEASUREMENT
/begin MEASUREMENT EIP_bAcvUClmp30 "" UBYTE BATU_EcuIntgdSwGend_CM_boolean 0 0 0.0 1.0 ECU_ADDRESS 0x40004541 /* @ECU_Address@EIP_bAcvUClmp30@ */ /end MEASUREMENT
/begin MEASUREMENT EIP_bAcvUClmp48 "" UBYTE BATU_EcuIntgdSwGend_CM_boolean 0 0 0.0 1.0 ECU_ADDRESS 0x40004542 /* @ECU_Address@EIP_bAcvUClmp48@ */ /end MEASUREMENT
/begin MEASUREMENT EIP_bAcvUClmp50 "" UBYTE BATU_EcuIntgdSwGend_CM_boolean 0 0 0.0 1.0 ECU_ADDRESS 0x40004543 /* @ECU_Address@EIP_bAcvUClmp50@ */ /end MEASUREMENT
/begin MEASUREMENT EIP_bAcvImdtStrtSwt "" UBYTE BATU_EcuIntgdSwGend_CM_boolean 0 0 0.0 1.0 ECU_ADDRESS 0x40004544 /* @ECU_Address@EIP_bAcvImdtStrtSwt@ */ /end MEASUREMENT
/begin MEASUREMENT EIP_bAcvStpSwt "" UBYTE BATU_EcuIntgdSwGend_CM_boolean 0 0 0.0 1.0 ECU_ADDRESS 0x40004545 /* @ECU_Address@EIP_bAcvStpSwt@ */ /end MEASUREMENT
/begin MEASUREMENT EIP_bAcvCmndrHtchSwt "" UBYTE BATU_EcuIntgdSwGend_CM_boolean 0 0 0.0 1.0 ECU_ADDRESS 0x40004546 /* @ECU_Address@EIP_bAcvCmndrHtchSwt@ */ /end MEASUREMENT
/begin MEASUREMENT EIP_bAcvSbmgSwt "" UBYTE BATU_EcuIntgdSwGend_CM_boolean 0 0 0.0 1.0 ECU_ADDRESS 0x40004547 /* @ECU_Address@EIP_bAcvSbmgSwt@ */ /end MEASUREMENT
/begin MEASUREMENT EIP_bAcvCmbtSwt "" UBYTE BATU_EcuIntgdSwGend_CM_boolean 0 0 0.0 1.0 ECU_ADDRESS 0x40004548 /* @ECU_Address@EIP_bAcvCmbtSwt@ */ /end MEASUREMENT
/begin MEASUREMENT EIP_bAcvAutStrtSwt "" UBYTE BATU_EcuIntgdSwGend_CM_boolean 0 0 0.0 1.0 ECU_ADDRESS 0x40004549 /* @ECU_Address@EIP_bAcvAutStrtSwt@ */ /end MEASUREMENT
/begin MEASUREMENT EIP_bEcuOutShtdwn "" UBYTE BATU_EcuIntgdSwGend_CM_boolean 0 0 0.0 1.0 ECU_ADDRESS 0x4000454A /* @ECU_Address@EIP_bEcuOutShtdwn@ */ /end MEASUREMENT
/begin MEASUREMENT EIP_bAcvIdleModDebOut "" UBYTE BATU_EcuIntgdSwGend_CM_boolean 0 0 0.0 1.0 ECU_ADDRESS 0x4000454B /* @ECU_Address@EIP_bAcvIdleModDebOut@ */ /end MEASUREMENT
/begin MEASUREMENT EIP_bAcvCylBaln "" UBYTE BATU_EcuIntgdSwGend_CM_boolean 0 0 0.0 1.0 ECU_ADDRESS 0x4000454C /* @ECU_Address@EIP_bAcvCylBaln@ */ /end MEASUREMENT
/begin MEASUREMENT EIP_bErrCyl1Misf "" UBYTE BATU_EcuIntgdSwGend_CM_boolean 0 0 0.0 1.0 ECU_ADDRESS 0x4000454D /* @ECU_Address@EIP_bErrCyl1Misf@ */ /end MEASUREMENT
/begin MEASUREMENT EIP_bErrCyl2Misf "" UBYTE BATU_EcuIntgdSwGend_CM_boolean 0 0 0.0 1.0 ECU_ADDRESS 0x4000454E /* @ECU_Address@EIP_bErrCyl2Misf@ */ /end MEASUREMENT
/begin MEASUREMENT EIP_bErrCyl3Misf "" UBYTE BATU_EcuIntgdSwGend_CM_boolean 0 0 0.0 1.0 ECU_ADDRESS 0x4000454F /* @ECU_Address@EIP_bErrCyl3Misf@ */ /end MEASUREMENT
/begin MEASUREMENT EIP_bErrCyl4Misf "" UBYTE BATU_EcuIntgdSwGend_CM_boolean 0 0 0.0 1.0 ECU_ADDRESS 0x40004550 /* @ECU_Address@EIP_bErrCyl4Misf@ */ /end MEASUREMENT
/begin MEASUREMENT EIP_bErrCyl5Misf "" UBYTE BATU_EcuIntgdSwGend_CM_boolean 0 0 0.0 1.0 ECU_ADDRESS 0x40004551 /* @ECU_Address@EIP_bErrCyl5Misf@ */ /end MEASUREMENT
/begin MEASUREMENT EIP_bErrCyl6Misf "" UBYTE BATU_EcuIntgdSwGend_CM_boolean 0 0 0.0 1.0 ECU_ADDRESS 0x40004552 /* @ECU_Address@EIP_bErrCyl6Misf@ */ /end MEASUREMENT
/begin MEASUREMENT EIP_bErrCyl7Misf "" UBYTE BATU_EcuIntgdSwGend_CM_boolean 0 0 0.0 1.0 ECU_ADDRESS 0x40004553 /* @ECU_Address@EIP_bErrCyl7Misf@ */ /end MEASUREMENT
/begin MEASUREMENT EIP_bErrCyl8Misf "" UBYTE BATU_EcuIntgdSwGend_CM_boolean 0 0 0.0 1.0 ECU_ADDRESS 0x40004554 /* @ECU_Address@EIP_bErrCyl8Misf@ */ /end MEASUREMENT
/begin MEASUREMENT EIP_bErrCyl9Misf "" UBYTE BATU_EcuIntgdSwGend_CM_boolean 0 0 0.0 1.0 ECU_ADDRESS 0x40004555 /* @ECU_Address@EIP_bErrCyl9Misf@ */ /end MEASUREMENT
/begin MEASUREMENT EIP_bErrCyl10Misf "" UBYTE BATU_EcuIntgdSwGend_CM_boolean 0 0 0.0 1.0 ECU_ADDRESS 0x40004556 /* @ECU_Address@EIP_bErrCyl10Misf@ */ /end MEASUREMENT
/begin MEASUREMENT EIP_bErrCyl11Misf "" UBYTE BATU_EcuIntgdSwGend_CM_boolean 0 0 0.0 1.0 ECU_ADDRESS 0x40004557 /* @ECU_Address@EIP_bErrCyl11Misf@ */ /end MEASUREMENT
/begin MEASUREMENT EIP_bErrCyl12Misf "" UBYTE BATU_EcuIntgdSwGend_CM_boolean 0 0 0.0 1.0 ECU_ADDRESS 0x40004558 /* @ECU_Address@EIP_bErrCyl12Misf@ */ /end MEASUREMENT
/begin MEASUREMENT EIP_bErrCylMisfWarnBfrDeb "" UBYTE BATU_EcuIntgdSwGend_CM_boolean 0 0 0.0 1.0 ECU_ADDRESS 0x40004559 /* @ECU_Address@EIP_bErrCylMisfWarnBfrDeb@ */ /end MEASUREMENT
/begin MEASUREMENT EIP_bAcvErrCylMisfWarn "" UBYTE BATU_EcuIntgdSwGend_CM_boolean 0 0 0.0 1.0 ECU_ADDRESS 0x4000455A /* @ECU_Address@EIP_bAcvErrCylMisfWarn@ */ /end MEASUREMENT
/begin MEASUREMENT EIP_bErrCylMisfRednBfrDeb "" UBYTE BATU_EcuIntgdSwGend_CM_boolean 0 0 0.0 1.0 ECU_ADDRESS 0x4000455B /* @ECU_Address@EIP_bErrCylMisfRednBfrDeb@ */ /end MEASUREMENT
/begin MEASUREMENT EIP_bAcvErrCylMisfRedn "" UBYTE BATU_EcuIntgdSwGend_CM_boolean 0 0 0.0 1.0 ECU_ADDRESS 0x4000455C /* @ECU_Address@EIP_bAcvErrCylMisfRedn@ */ /end MEASUREMENT
/begin MEASUREMENT EIP_bErrCylMisfShtdwnBfrDeb "" UBYTE BATU_EcuIntgdSwGend_CM_boolean 0 0 0.0 1.0 ECU_ADDRESS 0x4000455D /* @ECU_Address@EIP_bErrCylMisfShtdwnBfrDeb@ */ /end MEASUREMENT
/begin MEASUREMENT EIP_bAcvErrCylMisfShtdwn "" UBYTE BATU_EcuIntgdSwGend_CM_boolean 0 0 0.0 1.0 ECU_ADDRESS 0x4000455E /* @ECU_Address@EIP_bAcvErrCylMisfShtdwn@ */ /end MEASUREMENT
/begin MEASUREMENT EIP_bErrCdstFan "" UBYTE BATU_EcuIntgdSwGend_CM_boolean 0 0 0.0 1.0 ECU_ADDRESS 0x4000455F /* @ECU_Address@EIP_bErrCdstFan@ */ /end MEASUREMENT
/begin MEASUREMENT EIP_bErrGridHeatr "" UBYTE BATU_EcuIntgdSwGend_CM_boolean 0 0 0.0 1.0 ECU_ADDRESS 0x40004560 /* @ECU_Address@EIP_bErrGridHeatr@ */ /end MEASUREMENT
/begin MEASUREMENT EIP_bErrFmuA "" UBYTE BATU_EcuIntgdSwGend_CM_boolean 0 0 0.0 1.0 ECU_ADDRESS 0x40004561 /* @ECU_Address@EIP_bErrFmuA@ */ /end MEASUREMENT
/begin MEASUREMENT EIP_bErrInjr10 "" UBYTE BATU_EcuIntgdSwGend_CM_boolean 0 0 0.0 1.0 ECU_ADDRESS 0x40004562 /* @ECU_Address@EIP_bErrInjr10@ */ /end MEASUREMENT
/begin MEASUREMENT EIP_bErrInjr1 "" UBYTE BATU_EcuIntgdSwGend_CM_boolean 0 0 0.0 1.0 ECU_ADDRESS 0x40004563 /* @ECU_Address@EIP_bErrInjr1@ */ /end MEASUREMENT
/begin MEASUREMENT EIP_bErrInjr2 "" UBYTE BATU_EcuIntgdSwGend_CM_boolean 0 0 0.0 1.0 ECU_ADDRESS 0x40004564 /* @ECU_Address@EIP_bErrInjr2@ */ /end MEASUREMENT
/begin MEASUREMENT EIP_bErrInjr3 "" UBYTE BATU_EcuIntgdSwGend_CM_boolean 0 0 0.0 1.0 ECU_ADDRESS 0x40004565 /* @ECU_Address@EIP_bErrInjr3@ */ /end MEASUREMENT
/begin MEASUREMENT EIP_bErrInjr4 "" UBYTE BATU_EcuIntgdSwGend_CM_boolean 0 0 0.0 1.0 ECU_ADDRESS 0x40004566 /* @ECU_Address@EIP_bErrInjr4@ */ /end MEASUREMENT
/begin MEASUREMENT EIP_bErrInjr5 "" UBYTE BATU_EcuIntgdSwGend_CM_boolean 0 0 0.0 1.0 ECU_ADDRESS 0x40004567 /* @ECU_Address@EIP_bErrInjr5@ */ /end MEASUREMENT
/begin MEASUREMENT EIP_bErrInjr6 "" UBYTE BATU_EcuIntgdSwGend_CM_boolean 0 0 0.0 1.0 ECU_ADDRESS 0x40004568 /* @ECU_Address@EIP_bErrInjr6@ */ /end MEASUREMENT
/begin MEASUREMENT EIP_bErrInjr7 "" UBYTE BATU_EcuIntgdSwGend_CM_boolean 0 0 0.0 1.0 ECU_ADDRESS 0x40004569 /* @ECU_Address@EIP_bErrInjr7@ */ /end MEASUREMENT
/begin MEASUREMENT EIP_bErrInjr8 "" UBYTE BATU_EcuIntgdSwGend_CM_boolean 0 0 0.0 1.0 ECU_ADDRESS 0x4000456A /* @ECU_Address@EIP_bErrInjr8@ */ /end MEASUREMENT
/begin MEASUREMENT EIP_bErrInjr9 "" UBYTE BATU_EcuIntgdSwGend_CM_boolean 0 0 0.0 1.0 ECU_ADDRESS 0x4000456B /* @ECU_Address@EIP_bErrInjr9@ */ /end MEASUREMENT
/begin MEASUREMENT EIP_bErrInjr11 "" UBYTE BATU_EcuIntgdSwGend_CM_boolean 0 0 0.0 1.0 ECU_ADDRESS 0x4000456C /* @ECU_Address@EIP_bErrInjr11@ */ /end MEASUREMENT
/begin MEASUREMENT EIP_bErrInjr12 "" UBYTE BATU_EcuIntgdSwGend_CM_boolean 0 0 0.0 1.0 ECU_ADDRESS 0x4000456D /* @ECU_Address@EIP_bErrInjr12@ */ /end MEASUREMENT
/begin MEASUREMENT EIP_bErrTotInjr "" UBYTE BATU_EcuIntgdSwGend_CM_boolean 0 0 0.0 1.0 ECU_ADDRESS 0x4000456E /* @ECU_Address@EIP_bErrTotInjr@ */ /end MEASUREMENT
/begin MEASUREMENT EIP_bErrInjrShtdwnBfrDeb "" UBYTE BATU_EcuIntgdSwGend_CM_boolean 0 0 0.0 1.0 ECU_ADDRESS 0x4000456F /* @ECU_Address@EIP_bErrInjrShtdwnBfrDeb@ */ /end MEASUREMENT
/begin MEASUREMENT EIP_bAcvErrInjrShtdwn "" UBYTE BATU_EcuIntgdSwGend_CM_boolean 0 0 0.0 1.0 ECU_ADDRESS 0x40004570 /* @ECU_Address@EIP_bAcvErrInjrShtdwn@ */ /end MEASUREMENT
/begin MEASUREMENT EIP_bErrPCVB "" UBYTE BATU_EcuIntgdSwGend_CM_boolean 0 0 0.0 1.0 ECU_ADDRESS 0x40004571 /* @ECU_Address@EIP_bErrPCVB@ */ /end MEASUREMENT
/begin MEASUREMENT EIP_bErrWgA "" UBYTE BATU_EcuIntgdSwGend_CM_boolean 0 0 0.0 1.0 ECU_ADDRESS 0x40004572 /* @ECU_Address@EIP_bErrWgA@ */ /end MEASUREMENT
/begin MEASUREMENT EIP_bErrFmuB "" UBYTE BATU_EcuIntgdSwGend_CM_boolean 0 0 0.0 1.0 ECU_ADDRESS 0x40004573 /* @ECU_Address@EIP_bErrFmuB@ */ /end MEASUREMENT
/begin MEASUREMENT EIP_bErrPCVA "" UBYTE BATU_EcuIntgdSwGend_CM_boolean 0 0 0.0 1.0 ECU_ADDRESS 0x40004574 /* @ECU_Address@EIP_bErrPCVA@ */ /end MEASUREMENT
/begin MEASUREMENT EIP_bErrWgB "" UBYTE BATU_EcuIntgdSwGend_CM_boolean 0 0 0.0 1.0 ECU_ADDRESS 0x40004575 /* @ECU_Address@EIP_bErrWgB@ */ /end MEASUREMENT
/begin MEASUREMENT DTqC_bPTOActvn "PTO Activation" UBYTE BATU_EcuIntgdSwGend_CM_boolean 0 0 0.0 1.0 ECU_ADDRESS 0x40004576 /* @ECU_Address@DTqC_bPTOActvn@ */ /end MEASUREMENT
/begin MEASUREMENT DTqC_IdxGearTrbChrgOil "Gear Position for Turbo Charger Oil Leakage Activation" UBYTE BATU_EcuIntgdSwGend_CM_boolean 0 0 0.0 1.0 ECU_ADDRESS 0x40004577 /* @ECU_Address@DTqC_IdxGearTrbChrgOil@ */ /end MEASUREMENT
/begin MEASUREMENT DTqC_VVehAcvnTrbChrgOilLeakg "Turbo Charger Oil Leakage Activation According to Vehicle Speed" UBYTE BATU_EcuIntgdSwGend_CM_boolean 0 0 0.0 1.0 ECU_ADDRESS 0x40004578 /* @ECU_Address@DTqC_VVehAcvnTrbChrgOilLeakg@ */ /end MEASUREMENT
/begin MEASUREMENT DTqC_bAcvTrbChrgOilLeakg "Turbo Oil Leakage Activation Signal" UBYTE BATU_EcuIntgdSwGend_CM_boolean 0 0 0.0 1.0 ECU_ADDRESS 0x40004579 /* @ECU_Address@DTqC_bAcvTrbChrgOilLeakg@ */ /end MEASUREMENT
/begin MEASUREMENT DTqC_bAcvPwrOnCtlMod "Power-on Control Mode" UBYTE BATU_EcuIntgdSwGend_CM_boolean 0 0 0.0 1.0 ECU_ADDRESS 0x4000457A /* @ECU_Address@DTqC_bAcvPwrOnCtlMod@ */ /end MEASUREMENT
/begin MEASUREMENT DTqC_bAcvStpCtlMod "Stop Control Mode" UBYTE BATU_EcuIntgdSwGend_CM_boolean 0 0 0.0 1.0 ECU_ADDRESS 0x4000457B /* @ECU_Address@DTqC_bAcvStpCtlMod@ */ /end MEASUREMENT
/begin MEASUREMENT DTqC_bAcvIdleSpdCtlModPre "Pre Idle Speed Control Mode " UBYTE BATU_EcuIntgdSwGend_CM_boolean 0 0 0.0 1.0 ECU_ADDRESS 0x4000457C /* @ECU_Address@DTqC_bAcvIdleSpdCtlModPre@ */ /end MEASUREMENT
/begin MEASUREMENT CDFC_bCdstFanFault "" UBYTE BATU_EcuIntgdSwGend_CM_boolean 0 0 0.0 1.0 ECU_ADDRESS 0x4000457D /* @ECU_Address@CDFC_bCdstFanFault@ */ /end MEASUREMENT
/begin MEASUREMENT CDFC_bAcvSbmgCmndr "Submerge and Commander Switch Activation" UBYTE BATU_EcuIntgdSwGend_CM_boolean 0 0 0.0 1.0 ECU_ADDRESS 0x4000457E /* @ECU_Address@CDFC_bAcvSbmgCmndr@ */ /end MEASUREMENT
/begin MEASUREMENT CDFC_bAcvCdstFan "Coarse Dust Fan is Active Flag " UBYTE BATU_EcuIntgdSwGend_CM_boolean 0 0 0.0 1.0 ECU_ADDRESS 0x4000457F /* @ECU_Address@CDFC_bAcvCdstFan@ */ /end MEASUREMENT
/begin MEASUREMENT CDFC_bErrAcvCdstFanOnSts "" UBYTE BATU_EcuIntgdSwGend_CM_boolean 0 0 0.0 1.0 ECU_ADDRESS 0x40004580 /* @ECU_Address@CDFC_bErrAcvCdstFanOnSts@ */ /end MEASUREMENT
/begin MEASUREMENT CDFC_bErrAcvCdstFanOffSts "" UBYTE BATU_EcuIntgdSwGend_CM_boolean 0 0 0.0 1.0 ECU_ADDRESS 0x40004581 /* @ECU_Address@CDFC_bErrAcvCdstFanOffSts@ */ /end MEASUREMENT
/begin MEASUREMENT CDFC_bErrAcvCdstFan "Coarse Dust Fan Error Signal" UBYTE BATU_EcuIntgdSwGend_CM_boolean 0 0 0.0 1.0 ECU_ADDRESS 0x40004582 /* @ECU_Address@CDFC_bErrAcvCdstFan@ */ /end MEASUREMENT
/begin MEASUREMENT AC_bAltFault "" UBYTE BATU_EcuIntgdSwGend_CM_boolean 0 0 0.0 1.0 ECU_ADDRESS 0x40004583 /* @ECU_Address@AC_bAltFault@ */ /end MEASUREMENT
/begin MEASUREMENT AC_bNEngAcvnAltClsReq "Debouncer Output for Activate Alternator Close Request wrt  Engine Speed" UBYTE BATU_EcuIntgdSwGend_CM_boolean 0 0 0.0 1.0 ECU_ADDRESS 0x40004584 /* @ECU_Address@AC_bNEngAcvnAltClsReq@ */ /end MEASUREMENT
/begin MEASUREMENT AC_bNEngAcvnAltOpenReq "Debouncer Output for Activate Alternator Open Request wrt  Engine Speed" UBYTE BATU_EcuIntgdSwGend_CM_boolean 0 0 0.0 1.0 ECU_ADDRESS 0x40004585 /* @ECU_Address@AC_bNEngAcvnAltOpenReq@ */ /end MEASUREMENT
/begin MEASUREMENT AC_bAltOpenReq "Alternator Open Request" UBYTE BATU_EcuIntgdSwGend_CM_boolean 0 0 0.0 1.0 ECU_ADDRESS 0x40004586 /* @ECU_Address@AC_bAltOpenReq@ */ /end MEASUREMENT
/begin MEASUREMENT AC_bAltFaultFromHw "" UBYTE BATU_EcuIntgdSwGend_CM_boolean 0 0 0.0 1.0 ECU_ADDRESS 0x40004587 /* @ECU_Address@AC_bAltFaultFromHw@ */ /end MEASUREMENT
/begin COMPU_METHOD BATU_EcuIntgdSwGend_CM_single_N_m "Q = V" RAT_FUNC "%8.6" "N*m" COEFFS 0 1 0 0 0 1 /end COMPU_METHOD
/begin COMPU_METHOD BATU_EcuIntgdSwGend_CM_single_rpm "Q = V" RAT_FUNC "%8.6" "rpm" COEFFS 0 1 0 0 0 1 /end COMPU_METHOD
/begin COMPU_METHOD BATU_EcuIntgdSwGend_CM_single_degC "Q = V" RAT_FUNC "%8.6" "degC" COEFFS 0 1 0 0 0 1 /end COMPU_METHOD
/begin COMPU_METHOD BATU_EcuIntgdSwGend_CM_single "Q = V" RAT_FUNC "%8.6" "" COEFFS 0 1 0 0 0 1 /end COMPU_METHOD
/begin COMPU_METHOD BATU_EcuIntgdSwGend_CM_single_mbar "Q = V" RAT_FUNC "%8.6" "mbar" COEFFS 0 1 0 0 0 1 /end COMPU_METHOD
/begin COMPU_METHOD BATU_EcuIntgdSwGend_CM_single_mm_3 "Q = V" RAT_FUNC "%8.6" "mm^3" COEFFS 0 1 0 0 0 1 /end COMPU_METHOD
/begin COMPU_METHOD BATU_EcuIntgdSwGend_CM_single_l "Q = V" RAT_FUNC "%8.6" "l" COEFFS 0 1 0 0 0 1 /end COMPU_METHOD
/begin COMPU_METHOD BATU_EcuIntgdSwGend_CM_single__ "Q = V" RAT_FUNC "%8.6" "%" COEFFS 0 1 0 0 0 1 /end COMPU_METHOD
/begin COMPU_METHOD BATU_EcuIntgdSwGend_CM_single_s_0_005 "Q = V" RAT_FUNC "%8.6" "s.0.005" COEFFS 0 1 0 0 0 1 /end COMPU_METHOD
/begin COMPU_METHOD BATU_EcuIntgdSwGend_CM_single_bar "Q = V" RAT_FUNC "%8.6" "bar" COEFFS 0 1 0 0 0 1 /end COMPU_METHOD
/begin COMPU_METHOD BATU_EcuIntgdSwGend_CM_single_V "Q = V" RAT_FUNC "%8.6" "V" COEFFS 0 1 0 0 0 1 /end COMPU_METHOD
/begin COMPU_METHOD BATU_EcuIntgdSwGend_CM_single_rpm_sec "Q = V" RAT_FUNC "%8.6" "rpm/sec" COEFFS 0 1 0 0 0 1 /end COMPU_METHOD
/begin COMPU_METHOD BATU_EcuIntgdSwGend_CM_single_mm_3_stk "Q = V" RAT_FUNC "%8.6" "mm^3/stk" COEFFS 0 1 0 0 0 1 /end COMPU_METHOD
/begin COMPU_METHOD BATU_EcuIntgdSwGend_CM_single_kg_sec "Q = V" RAT_FUNC "%8.6" "kg/sec" COEFFS 0 1 0 0 0 1 /end COMPU_METHOD
/begin COMPU_METHOD BATU_EcuIntgdSwGend_CM_single_km_h "Q = V" RAT_FUNC "%8.6" "km/h" COEFFS 0 1 0 0 0 1 /end COMPU_METHOD
/begin COMPU_METHOD BATU_EcuIntgdSwGend_CM_single_mm_sec "Q = V" RAT_FUNC "%8.6" "mm/sec" COEFFS 0 1 0 0 0 1 /end COMPU_METHOD
/begin COMPU_METHOD BATU_EcuIntgdSwGend_CM_single_mbar_sec "Q = V" RAT_FUNC "%8.6" "mbar/sec" COEFFS 0 1 0 0 0 1 /end COMPU_METHOD
/begin COMPU_METHOD BATU_EcuIntgdSwGend_CM_single_bar_sec "Q = V" RAT_FUNC "%8.6" "bar/sec" COEFFS 0 1 0 0 0 1 /end COMPU_METHOD
/begin COMPU_METHOD BATU_EcuIntgdSwGend_CM_single_C_sec "Q = V" RAT_FUNC "%8.6" "C/sec" COEFFS 0 1 0 0 0 1 /end COMPU_METHOD
/begin COMPU_METHOD BATU_EcuIntgdSwGend_CM_single_V_sec "Q = V" RAT_FUNC "%8.6" "V/sec" COEFFS 0 1 0 0 0 1 /end COMPU_METHOD
/begin COMPU_METHOD BATU_EcuIntgdSwGend_CM_single_s_0_05 "Q = V" RAT_FUNC "%8.6" "s.0.05" COEFFS 0 1 0 0 0 1 /end COMPU_METHOD
/begin COMPU_METHOD BATU_EcuIntgdSwGend_CM_single_l_100km "Q = V" RAT_FUNC "%8.6" "l/100km" COEFFS 0 1 0 0 0 1 /end COMPU_METHOD
/begin COMPU_METHOD BATU_EcuIntgdSwGend_CM_single_Volt "Q = V" RAT_FUNC "%8.6" "Volt" COEFFS 0 1 0 0 0 1 /end COMPU_METHOD
/begin COMPU_METHOD BATU_EcuIntgdSwGend_CM_boolean "Q = V" RAT_FUNC "%1.0" "" COEFFS 0 1 0 0 0 1 /end COMPU_METHOD
/begin COMPU_METHOD BATU_EcuIntgdSwGend_CM_boolean_mbar "Q = V" RAT_FUNC "%1.0" "mbar" COEFFS 0 1 0 0 0 1 /end COMPU_METHOD
/begin COMPU_METHOD BATU_EcuIntgdSwGend_CM_boolean_degC "Q = V" RAT_FUNC "%1.0" "degC" COEFFS 0 1 0 0 0 1 /end COMPU_METHOD
/begin COMPU_METHOD BATU_EcuIntgdSwGend_CM_single_h "Q = V" RAT_FUNC "%8.6" "h" COEFFS 0 1 0 0 0 1 /end COMPU_METHOD
/begin COMPU_METHOD BATU_EcuIntgdSwGend_CM_single_l_h "Q = V" RAT_FUNC "%8.6" "l/h" COEFFS 0 1 0 0 0 1 /end COMPU_METHOD
/begin COMPU_METHOD BATU_EcuIntgdSwGend_CM_single_l_km "Q = V" RAT_FUNC "%8.6" "l/km" COEFFS 0 1 0 0 0 1 /end COMPU_METHOD
/begin COMPU_METHOD BATU_EcuIntgdSwGend_CM_single_km "Q = V" RAT_FUNC "%8.6" "km" COEFFS 0 1 0 0 0 1 /end COMPU_METHOD
/begin GROUP BATU_EcuIntgdSwGend "BATU_EcuIntgdSwGend" /* Root */ ROOT /begin SUB_GROUP Root_ControlSoftware /end SUB_GROUP
 /begin REF_MEASUREMENT INP_AltCurnt INP_AltFaultFromHw INP_CdstFanStsFb INP_EngTqReqLimnFac INP_EngWearHourMem INP_FuelCnsMem INP_GridHeatrRlyFb INP_IdxGearAcv INP_LvlCoolt INP_LvlFu INP_LvlHill INP_LvlOil INP_MeanDifNEngAndCyl1 INP_MeanDifNEngAndCyl10 INP_MeanDifNEngAndCyl11 INP_MeanDifNEngAndCyl12 INP_MeanDifNEngAndCyl2 INP_MeanDifNEngAndCyl3 INP_MeanDifNEngAndCyl4 INP_MeanDifNEngAndCyl5 INP_MeanDifNEngAndCyl6 INP_MeanDifNEngAndCyl7 INP_MeanDifNEngAndCyl8 INP_MeanDifNEngAndCyl9 INP_NCyl10AndCyl1Min INP_NCyl11AndCyl3Min INP_NCyl12AndCyl2Min INP_NCyl7AndCyl5Min INP_NCyl8AndCyl4Min INP_NCyl9AndCyl6Min INP_NEng INP_NEngReq INP_NFan INP_NMeaCylMin INP_PAirBoost INP_PAmbAir INP_PCmprInlt INP_PCoolt INP_PFineFilAft INP_PFineFilBfr INP_PFu INP_POil INP_PRail INP_PTONEngReqFromCAN INP_PercgAccr1 INP_PercgAccr2 INP_PosnEmgcyLvr INP_StEngReq INP_StParkBrk INP_StSrvBrk INP_StSteer INP_TAirBoost INP_TAmbAirFromCAN INP_TCmprInlt INP_TCooltHi INP_TCooltLo INP_TEcu INP_TExhLe INP_TExhRi INP_TFu INP_TOil INP_TTrsmOil INP_UClmp30 INP_VVeh INP_bAcvAutStrtSwt INP_bAcvCdstFanFromCAN INP_bAcvCmbtFromCAN INP_bAcvCmbtSwt INP_bAcvCmndrHtchSwt INP_bAcvCrpSwt INP_bAcvEmgcyStop INP_bAcvImdtStrtSwt INP_bAcvLossCAN INP_bAcvSbmgSwt INP_bAcvStpSwt INP_bAcvTqLimn INP_bAcvUClmp30 INP_bAcvUClmp48 INP_bAcvUClmp50 INP_bAltFaultFromCAN INP_bEcuOutShtdwn INP_bEmgcyShtdwnFromTcu INP_bEngMILSts INP_bErrAccrSnsr1 INP_bErrAccrSnsr2 INP_bErrAutStrtSwt INP_bErrCamsftSnsr INP_bErrCdstFan INP_bErrCmbtSwt INP_bErrCmndrHtchSwt INP_bErrCrnksftSnsr1 INP_bErrCrnksftSnsr2 INP_bErrFmuA INP_bErrFmuB INP_bErrGridHeatr INP_bErrImdtStrtSwt INP_bErrInjr1 INP_bErrInjr10 INP_bErrInjr11 INP_bErrInjr12 INP_bErrInjr2 INP_bErrInjr3 INP_bErrInjr4 INP_bErrInjr5 INP_bErrInjr6 INP_bErrInjr7 INP_bErrInjr8 INP_bErrInjr9 INP_bErrLvlCooltSnsr INP_bErrLvlFuSnsr INP_bErrLvlOilSnsr INP_bErrPAirBoostSnsr INP_bErrPAmbAirSnsr INP_bErrPCVA INP_bErrPCVB INP_bErrPCmprInltSnsr INP_bErrPCooltSnsr INP_bErrPFineFilAftSnsr INP_bErrPFineFilBfrSnsr INP_bErrPFuSnsr INP_bErrPOilSnsr INP_bErrPRailSnsr INP_bErrSbmgSwt INP_bErrStpSwt INP_bErrTAirBoostSnsr INP_bErrTCmprInltSnsr INP_bErrTCooltHiSnsr INP_bErrTCooltLoSnsr INP_bErrTEcuSnsr INP_bErrTExhLeSnsr INP_bErrTExhRiSnsr INP_bErrTFuSnsr INP_bErrTOilSnsr INP_bErrWgA INP_bErrWgB INP_bInhEngStrt INP_bInhEngStrtFromCAN INP_bPTOActvnFromCAN /end REF_MEASUREMENT
/end GROUP
/begin GROUP Root_ControlSoftware "BATU_EcuIntgdSwGend/ControlSoftware"
 /begin SUB_GROUP S1_AltCtl S1_CrsDustFanCtl S1_DesTqClcn S1_EcuInpPrcsg S1_EcuModSeln S1_EcuOutpPrcsg S1_FanReqClcn S1_InjCtl S1_PrhtgCtl S1_RailPGovr S1_StrtrCtl S1_TqCnvn S1_TqLim S1_WarnMong S1_WgtCtl /end SUB_GROUP
/end GROUP
/begin GROUP S1_AltCtl "BATU_EcuIntgdSwGend/ControlSoftware/AltCtl"
 /begin SUB_GROUP S2_Debouncer S2_Debouncer1 S2_Debouncer2 S2_SetRstLtch S2_SetRstLtch1 S2_SetRstLtch2 /end SUB_GROUP
 /begin REF_CHARACTERISTIC AC_AltFaultFromHw_P AC_NEngAcvnAltReq_P AC_NEngDeacAltReq_P AC_NmrSng0_C AC_TiDebAcvnAlt_P AC_TiDebAltFaultFromHw_P AC_TiDebDeacAlt_P AC_bAltOpenReqOvs_P AC_bAltOpenReqOvv_P EG_NmrSng0_C EG_TsSw_C /end REF_CHARACTERISTIC
 /begin REF_MEASUREMENT AC_bAltOpenReq /end REF_MEASUREMENT
/end GROUP
/begin GROUP S1_CrsDustFanCtl "BATU_EcuIntgdSwGend/ControlSoftware/CrsDustFanCtl"
 /begin SUB_GROUP S3_Coarse_Dust_Fan_Activation_Engine_Speed_Dependency S3_Coarse_Dust_Fan_Before_Starter_Activation S3_Debouncer1 S3_Debouncer3 S3_SetRstLtch S3_SetRstLtch1 S3_SetRstLtch2 /end SUB_GROUP
 /begin REF_CHARACTERISTIC CDFC_CdstFanOnStsFbThd_P CDFC_CdstFanStsOffFbThd_P CDFC_NmrSng0_C CDFC_TiCdstFanErrOffStsDeb_P CDFC_TiCdstFanErrOnStsDeb_P CDFC_bAcvCdstFanOvs_P CDFC_bAcvCdstFanOvv_P CDFC_bErrAcvCdstFanOvs_P CDFC_bErrAcvCdstFanOvv_P EG_NmrInt0_C EG_NmrSng0_C EG_TsSw_C /end REF_CHARACTERISTIC
 /begin REF_MEASUREMENT CDFC_bAcvCdstFan CDFC_bAcvSbmgCmndr CDFC_bErrAcvCdstFan /end REF_MEASUREMENT
/end GROUP
/begin GROUP S1_DesTqClcn "BATU_EcuIntgdSwGend/ControlSoftware/DesTqClcn"
 /begin SUB_GROUP S4_Friction_Torque_Calculation S4_Idle_Speed_Reference_Selector S4_Idle_Speed_and_Torque_Control S4_Over_Speed_Control S4_Power_On_Control S4_Start_Control S4_Stop_Control S4_Tcu_Request_for_Speed_Control S4_saturation /end SUB_GROUP
 /begin REF_CHARACTERISTIC DTqC_ModEngCtlIdleSpd_C DTqC_ModEngCtlOvspd_C DTqC_ModEngCtlPwrOn_C DTqC_ModEngCtlStp_C DTqC_ModEngCtlStrt_C DTqC_ModEngCtlTcuReq_C DTqC_ModEngCtlTq_C DTqC_TqIndcdOvs_P DTqC_TqIndcdOvv_P DTqC_TqIndcdSatMax_P DTqC_TqIndcdSatMin_P DTqC_bAcvIdleSpdCtlModPreOvs_P DTqC_bAcvIdleSpdCtlModPreOvv_P DTqC_bAcvPwrOnCtlModOvs_P DTqC_bAcvPwrOnCtlModOvv_P DTqC_bAcvStpCtlModOvs_P DTqC_bAcvStpCtlModOvv_P /end REF_CHARACTERISTIC
 /begin REF_MEASUREMENT DTqC_TqBrk DTqC_bAcvIdleSpdCtlModPre DTqC_bAcvPwrOnCtlMod DTqC_bAcvStpCtlMod /end REF_MEASUREMENT
/end GROUP
/begin GROUP S1_EcuInpPrcsg "BATU_EcuIntgdSwGend/ControlSoftware/EcuInpPrcsg"
 /begin SUB_GROUP S5_Actuator_Defect_Signals S5_Additionals S5_Auxilary_Torque_Loss_Calculation S5_Digital_Inputs S5_Electrical_Contact_Signals S5_Engine_Wear_Hour_ S5_Level_Sensor_Signals S5_Position___Speed_Sensor_Signals S5_Pressure_Sensor_Signals S5_Status_Signal S5_Switch_Defect_Signals S5_Tcu__Can_Signals S5_Temperature_Sensor_Signals /end SUB_GROUP
/end GROUP
/begin GROUP S1_EcuModSeln "BATU_EcuIntgdSwGend/ControlSoftware/EcuModSeln"
 /begin SUB_GROUP S6_Idle_Speed_toTCU_Request_Transition S6_Idle_Speed_toTorque_Transiton S6_Idle_Speed_to_Overspeed_Transition S6_Idle_Speed_to_Stop_Transition S6_Overspeed_toTorque_Transition S6_Overspeed_to_Stop_Transiton S6_Power_On_to_Start_Transiton S6_Start_to_Idle_Speed_Transiiton S6_Start_to_Stop_Transition S6_Stop_to_Power_On_Transition S6_TCU_Request_to_Overspeed_Transition S6_TCU_Request_to_Stop_Transition S6_TCU_Request_to_Torque_Transiiton S6_Torque_to_Idle_Speed_Transition S6_Torque_to_Overspeed_Transition S6_Torque_to_Stop_Transition S6_Torque_to_TCU_Request_Transition /end SUB_GROUP
 /begin REF_MEASUREMENT EMS_ModEngCtl /end REF_MEASUREMENT
/end GROUP
/begin GROUP S1_EcuOutpPrcsg "BATU_EcuIntgdSwGend/ControlSoftware/EcuOutpPrcsg"
 /begin SUB_GROUP S7_AuxiliaryOutputs S7_EcuToTcu S7_InjectionOutputs S7_ValveOutputs /end SUB_GROUP
 /begin REF_CHARACTERISTIC EOP_FuCnsOvs_P EOP_FuCnsOvv_P EOP_StFanReqOvs_P EOP_StFanReqOvv_P EOP_TCooltHiOvs_P EOP_TCooltHiOvv_P EOP_bAcvStrtrOvs_P EOP_bAcvStrtrOvv_P EOP_bAltOpenReqOvs_P EOP_bAltOpenReqOvv_P /end REF_CHARACTERISTIC
 /begin REF_MEASUREMENT EOP_FuCns EOP_StFanReq EOP_TCooltHi EOP_bAcvStrtr EOP_bAltOpenReq /end REF_MEASUREMENT
/end GROUP
/begin GROUP S1_FanReqClcn "BATU_EcuIntgdSwGend/ControlSoftware/FanReqClcn"
 /begin SUB_GROUP S8_Fan_Maximum_Request_Calculation__ S8_Fan_Minimum_Request_Calculation__ /end SUB_GROUP
 /begin REF_CHARACTERISTIC FRC_StFanReqMax_C FRC_StFanReqMin_C FRC_StFanReqNone_C FRC_StFanReqOvs_P FRC_StFanReqOvv_P /end REF_CHARACTERISTIC
 /begin REF_MEASUREMENT FRC_StFanReq /end REF_MEASUREMENT
/end GROUP
/begin GROUP S1_InjCtl "BATU_EcuIntgdSwGend/ControlSoftware/InjCtl"
 /begin SUB_GROUP S9_Calibration_Purpose S9_Cylinder_Balancing S9_Engine_Specific_Quantity_Correction S9_Fuel_Consumption_Calculation S9_Main_Injector_Characteristic_Maps S9_Pilot_Injector_Characteristic_Maps S9_Pre_Injection_Shadowing S9_Start_of_Injection_Angle_for_Pilot_and_Main_Injection /end SUB_GROUP
 /begin REF_CHARACTERISTIC EG_NmrSng12_C IC_DurMaiCyl10DeacBalOvs_P IC_DurMaiCyl11DeacBalOvs_P IC_DurMaiCyl12DeacBalOvs_P IC_DurMaiCyl1DeacBalOvs_P IC_DurMaiCyl2DeacBalOvs_P IC_DurMaiCyl3DeacBalOvs_P IC_DurMaiCyl4DeacBalOvs_P IC_DurMaiCyl5DeacBalOvs_P IC_DurMaiCyl6DeacBalOvs_P IC_DurMaiCyl7DeacBalOvs_P IC_DurMaiCyl8DeacBalOvs_P IC_DurMaiCyl9DeacBalOvs_P IC_MTotFuQntyCorrdOvs_P IC_MTotFuQntyCorrdOvv_P /end REF_CHARACTERISTIC
 /begin REF_MEASUREMENT IC_MMaiFuQntyCorrdCyl1 IC_MMaiFuQntyCorrdCyl10 IC_MMaiFuQntyCorrdCyl11 IC_MMaiFuQntyCorrdCyl12 IC_MMaiFuQntyCorrdCyl2 IC_MMaiFuQntyCorrdCyl3 IC_MMaiFuQntyCorrdCyl4 IC_MMaiFuQntyCorrdCyl5 IC_MMaiFuQntyCorrdCyl6 IC_MMaiFuQntyCorrdCyl7 IC_MMaiFuQntyCorrdCyl8 IC_MMaiFuQntyCorrdCyl9 IC_MTotFuQntyCorrd /end REF_MEASUREMENT
/end GROUP
/begin GROUP S1_PrhtgCtl "BATU_EcuIntgdSwGend/ControlSoftware/PrhtgCtl"
 /begin SUB_GROUP S10_Debouncer S10_Debouncer1 S10_Grid_Heater_Activation_After_Starter S10_Grid_Heater_Activation_Before_Starter S10_SetRstLtch S10_SetRstLtch1 S10_SetRstLtch2 /end SUB_GROUP
 /begin REF_CHARACTERISTIC EG_NmrSng0_C EG_TsSw_C PHC_GridHeatrRlyFbOffStsThd_P PHC_GridHeatrRlyFbOnStsThd_P PHC_NmrSng0_C PHC_TiGridHeatErrOfStsDeb_P PHC_TiGridHeatErrOnStsDeb_P PHC_bAcvGridHeatrOvs_P PHC_bAcvGridHeatrOvv_P PHC_bErrAcvGridHeatrOvs_P PHC_bErrAcvGridHeatrOvv_P /end REF_CHARACTERISTIC
 /begin REF_MEASUREMENT PHC_bAcvGridHeatr PHC_bErrAcvGridHeatr /end REF_MEASUREMENT
/end GROUP
/begin GROUP S1_RailPGovr "BATU_EcuIntgdSwGend/ControlSoftware/RailPGovr"
 /begin SUB_GROUP S11_FMU_Valve_Control S11_Pressure_Control_Valve S11_Rail_Pressure_Control_FeedForward_Map__ S11_Rail_Pressure_PID_Controller S11_Rail_Pressure_Reference_Calculation /end SUB_GROUP
 /begin REF_CHARACTERISTIC RPG_PRailRefOvs_P RPG_PRailRefOvv_P /end REF_CHARACTERISTIC
 /begin REF_MEASUREMENT RPG_PRailRef /end REF_MEASUREMENT
/end GROUP
/begin GROUP S1_StrtrCtl "BATU_EcuIntgdSwGend/ControlSoftware/StrtrCtl"
 /begin SUB_GROUP S12_Enabling___Disabling_Starter S12_Maximum_Allowable_Cranking_Time_Calculation S12_Start_Error_Detect_Algorithms_ S12_Starter_Locking /end SUB_GROUP
 /begin REF_CHARACTERISTIC EG_NmrSng0_C EG_TsSw_C /end REF_CHARACTERISTIC
/end GROUP
/begin GROUP S1_TqCnvn "BATU_EcuIntgdSwGend/ControlSoftware/TqCnvn"
 /begin SUB_GROUP S13_Main_Quantity_Correction S13_N_Map_Interpolation_for_Main_Quantity S13_N_Map_Interpolation_for_Pre_Quantity S13_Pilot_Quantity_Correction S13_Smoke_Limitation /end SUB_GROUP
 /begin REF_CHARACTERISTIC EG_NmrSng0_C /end REF_CHARACTERISTIC
 /begin REF_MEASUREMENT TrC_MMaiFuQntyCorr TrC_MPltFuQntyAllwd TrC_MTotFuQntyCorr /end REF_MEASUREMENT
/end GROUP
/begin GROUP S1_TqLim "BATU_EcuIntgdSwGend/ControlSoftware/TqLim"
 /begin SUB_GROUP S14_Indicated_Torque_Limitation S14_Limp_Mode_Limitation S14_Rate_Limiter_for_Factor_Limitation S14_Reduction_Limitation S14_TCU_Based_Limitation S14_Torque_Based_Limitation S14_Torque_Limitation_Constant_Factor S14_Torque_Limitation_Main_Map S14_Torque_Limitation_Maps /end SUB_GROUP
 /begin REF_CHARACTERISTIC TL_TqFacLimdOvs_P TL_TqFacLimdOvv_P TL_TqLimdForAirFilClggOvs_P TL_TqLimdForAirFilClggOvv_P TL_TqLimdForChokeOvs_P TL_TqLimdForChokeOvv_P TL_TqLimdForEmgcyGearOvs_P TL_TqLimdForEmgcyGearOvv_P TL_TqLimdForFineAirFilClggOvs_P TL_TqLimdForFineAirFilClggOvv_P TL_TqLimdForMAirFlowOvs_P TL_TqLimdForMAirFlowOvv_P TL_TqLimdForNExhTrbChrgOvs_P TL_TqLimdForNExhTrbChrgOvv_P TL_TqLimdForPAirAmbOvs_P TL_TqLimdForPAirAmbOvv_P TL_TqLimdForPAirBoostOvs_P TL_TqLimdForPAirBoostOvv_P TL_TqLimdForPwrSplyOvs_P TL_TqLimdForPwrSplyOvv_P TL_TqLimdForSurgeOvs_P TL_TqLimdForSurgeOvv_P TL_TqLimdForTAirBoostOvs_P TL_TqLimdForTAirBoostOvv_P TL_TqLimdForTAmbAirOvs_P TL_TqLimdForTAmbAirOvv_P TL_TqLimdForTCmprOutltOvs_P TL_TqLimdForTCmprOutltOvv_P TL_TqLimdForTCooltHiOvs_P TL_TqLimdForTCooltHiOvv_P TL_TqLimdForTExhLeOvs_P TL_TqLimdForTExhLeOvv_P TL_TqLimdForTExhRiOvs_P TL_TqLimdForTExhRiOvv_P TL_TqLimdForTFuOvs_P TL_TqLimdForTFuOvv_P TL_TqLimdForTInltCmprOvs_P TL_TqLimdForTInltCmprOvv_P TL_TqLimdForTOilOvs_P TL_TqLimdForTOilOvv_P TL_TqMaiLimdOvs_P TL_TqMaiLimdOvv_P TL_TqMapLimdOvs_P TL_TqMapLimdOvv_P /end REF_CHARACTERISTIC
 /begin REF_MEASUREMENT TL_TqFacLimd TL_TqLimdForAirFilClgg TL_TqLimdForChoke TL_TqLimdForEmgcyGear TL_TqLimdForFineAirFilClgg TL_TqLimdForMAirFlow TL_TqLimdForNExhTrbChrg TL_TqLimdForPAirAmb TL_TqLimdForPAirBoost TL_TqLimdForPwrSply TL_TqLimdForSurge TL_TqLimdForTAirBoost TL_TqLimdForTAmbAir TL_TqLimdForTCmprOutlt TL_TqLimdForTCooltHi TL_TqLimdForTExhLe TL_TqLimdForTExhRi TL_TqLimdForTFu TL_TqLimdForTInltCmpr TL_TqLimdForTOil TL_TqMaiLimd TL_TqMapLimd /end REF_MEASUREMENT
/end GROUP
/begin GROUP S1_WarnMong "BATU_EcuIntgdSwGend/ControlSoftware/WarnMong"
 /begin SUB_GROUP S15_StartInhibitor S15_Warning_Reduction_Shutdown_Functions /end SUB_GROUP
/end GROUP
/* MATLAB_SECTION_END_1 */
/******************************* From MATLAB ***************************************/
/end MODULE
/end PROJECT
